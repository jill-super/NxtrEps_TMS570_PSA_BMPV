[part 2 of 5: package /AUTOSAR/EcucDefs]
AUTOSAR XML (schema 4-0-3)
# The material contained in this specification is protected by copyright and
# other types of Intellectual Property Rights. The commercial exploitation of
# the material contained in this specification requires a license to such
# Intellectual Property Rights.
# This specification may be utilized or reproduced without any modification, in
# any form or by any means, for informational purposes only.
# For any other purpose, no part of the specification may be utilized or
# reproduced, in any form or by any means, without permission in writing from
# the publisher.
# licensed under the same rules as applicable to the AUTOSAR Standard.
package /AUTOSAR/EcucDefs  (continued)
  module definition Com [0..1]: variants link-time/post-build/pre-compile  # Configuration of the AUTOSAR COM module.
    container ComConfig: multiple-configuration-container=true  # This container contains the configuration parameters and sub containers of the AUTOSAR COM module. This container is a MultipleConfigurationContainer, i.e. this container and its sub-containers exist once per configuration set.
      integer ComConfigurationId: 0..4294967295, set at link in variant link-time / post-build in variant post-build / pre-compile in variant pre-compile  # This ID is returned by a call to Com_GetConfigurationId.
      container ComGwMapping [0..*]
        choice container ComGwDestination [1..*]  # Each instance of this choice container allows to define one routing destination either by reference to an already configured COM signal / signal group or by a destination description container.
          container ComGwDestinationDescription [0..1]  # Description of a gateway destination. This container allows defining a gateway destination without the configuration of a complete COM signal. This allows adding / changing gateway relations post build without the configuration of new signals.
            integer ComBitPosition: 0..2031, set at link in variant link-time / post-build in variant post-build / pre-compile in variant pre-compile  # Starting position within the I-PDU. This parameter refers to the position in the I-PDU and not in the shadow buffer. If the endianness conversion is configured to Opaque the parameter ComBitPosition shall define the bit0 of the first byte like in little endian byte order
            enumeration ComSignalEndianness: {BIG_ENDIAN, LITTLE_ENDIAN, OPAQUE}, set at link in variant link-time / post-build in variant post-build / pre-compile in variant pre-compile  # Defines the endianness of the signal's network representation.
            string ComSignalInitValue [0..1]: set at link in variant link-time / post-build in variant post-build / pre-compile in variant pre-compile, default-value=0  # Initial value for this signal. The default value is 0. | In case the ComSignalType is UINT8, UINT16, UINT32, SINT8, SINT16, SINT32 the string shall be interpreted as defined in the chapter Integer Type in the AUTOSAR EcuC specification. In case the ComSignalType is FLOAT32, FLOAT64 the string shall be interpreted as defined in the chapter Float Type in the AUTOSAR EcuC specification. In case the ComSignalType is BOOLEAN the string shall be interpreted as defined in the chapter Boolean Type in the AUTOSAR EcuC specification. In case the ComSignal is a UINT8_N, UINT6_DYN the string shall be interpreted as a decimal representation of the characters separated by blanks, e.g. "97 98 100" means a string "abd", where the char "a" is in byte 0(lowest address), "b" is in byte 1, and "d" is in byte 2 and (highest address).
            enumeration ComTransferProperty [0..1]: {PENDING, TRIGGERED, TRIGGERED_ON_CHANGE, TRIGGERED_ON_CHANGE_WITHOUT_REPETITION, TRIGGERED_WITHOUT_REPETITION}, set at link in variant link-time / post-build in variant post-build / pre-compile in variant pre-compile  # Defines if a write access to this signal can trigger the transmission of the corresponding I-PDU. If the I-PDU is triggered, depends also on the transmission mode of the corresponding I-PDU.
            integer ComUpdateBitPosition [0..1]: 0..2031, set at link in variant link-time / post-build in variant post-build / pre-compile in variant pre-compile  # Bit position of update-bit inside I-PDU. | If this attribute is omitted then there is no update-bit. This setting must be consistently on sender and on receiver side. Range: 0..63 for CAN and LIN 0..2031 for FlexRay
            reference ComGwIPduRef: set at link in variant link-time / post-build in variant post-build / pre-compile in variant pre-compile, destination=ComIPdu  # Reference to an I-PDU of a Signal Gateway source or destination description.
            container ComFilter [0..1]  # This container contains the configuration parameters of the AUTOSAR COM module's Filters. | Note: On sender side the container is used to specify the transmission mode conditions.
              enumeration ComFilterAlgorithm: {ALWAYS, MASKED_NEW_DIFFERS_MASKED_OLD, MASKED_NEW_DIFFERS_X, MASKED_NEW_EQUALS_X, NEVER, NEW_IS_OUTSIDE, NEW_IS_WITHIN, ONE_EVERY_N}, set at link in variant link-time+post-build / pre-compile in variant pre-compile  # The range of values is specified in the [17] specification, chapter 2.2.2, Reception Filtering.
              integer ComFilterMask [0..1]: 0..18446744073709551615, set at link in variant link-time+post-build / pre-compile in variant pre-compile  # The name of this attribute corresponds to the parameter name in the [17] specification of Reception Filtering.
              integer ComFilterMax [0..1]: 0..18446744073709551615, set at link in variant link-time+post-build / pre-compile in variant pre-compile  # The name of this attribute corresponds to the parameter name in the [17] specification of Reception Filtering.
              integer ComFilterMin [0..1]: 0..18446744073709551615, set at link in variant link-time+post-build / pre-compile in variant pre-compile  # The name of this attribute corresponds to the parameter name in the [17] specification of Reception Filtering.
              integer ComFilterOffset [0..1]: 0..18446744073709551615, set at link in variant link-time+post-build / pre-compile in variant pre-compile  # The name of this attribute corresponds to the parameter name in the [17] specification of Reception Filtering. | Range = 0..(ComFilterPeriod-1)
              integer ComFilterPeriod [0..1]: 0..18446744073709551615, set at link in variant link-time / post-build in variant post-build / pre-compile in variant pre-compile  # This parameter defines the period of the ComFilterAlgorithm ONE_EVERY_N.
              integer ComFilterX [0..1]: 0..18446744073709551615, set at link in variant link-time+post-build / pre-compile in variant pre-compile  # The name of this attribute corresponds to the parameter name in the [17] specification of Reception Filtering.
          container ComGwSignal [0..1]  # This container allows specifying a gateway source or destination respectively with a reference to a ComSignal, a ComGroupSignal or a ComSignalGroup.
            choice reference ComGwSignalRef: set at link in variant link-time / post-build in variant post-build / pre-compile in variant pre-compile, destination=[ComGroupSignal, ComSignal, ComSignalGroup]  # Reference to an object of a gateway relation. Either to a ComSignal, ComGroupSignal or to a SignalGroup.
        choice container ComGwSource  # This choice container allows the definition of the gateway source signal either by reference to an already configured COM signal / signal group or by a source description container.
          container ComGwSignal [0..1]  # This container allows specifying a gateway source or destination respectively with a reference to a ComSignal, a ComGroupSignal or a ComSignalGroup.
            choice reference ComGwSignalRef: set at link in variant link-time / post-build in variant post-build / pre-compile in variant pre-compile, destination=[ComGroupSignal, ComSignal, ComSignalGroup]  # Reference to an object of a gateway relation. Either to a ComSignal, ComGroupSignal or to a SignalGroup.
          container ComGwSourceDescription [0..1]  # Description of a gateway source. This container allows defining a gateway source without the configuration of a complete COM signal. This allows adding / changing gateway relations post build without the configuration of new signals.
            integer ComBitPosition: 0..2031, set at link in variant link-time / post-build in variant post-build / pre-compile in variant pre-compile  # Starting position within the I-PDU. This parameter refers to the position in the I-PDU and not in the shadow buffer. If the endianness conversion is configured to Opaque the parameter ComBitPosition shall define the bit0 of the first byte like in little endian byte order
            integer ComBitSize [0..1]: 0..64, set at link in variant link-time / post-build in variant post-build / pre-compile in variant pre-compile  # Size in bits, for non-array signal types. | For ComSignalType UINT8_N and UINT8_DYN this size shall be configured by ComSignalLength.
            enumeration ComSignalEndianness: {BIG_ENDIAN, LITTLE_ENDIAN, OPAQUE}, set at link in variant link-time / post-build in variant post-build / pre-compile in variant pre-compile  # Defines the endianness of the signal's network representation.
            integer ComSignalLength [0..1]: 0..4095, set at link in variant link-time+post-build / pre-compile in variant pre-compile  # Description: | For ComSignalType UINT8_N this parameter specifies the length n in bytes. For ComSignalType UINT8_DYN it specifies the maximum length in bytes. For all other types this parameter shall be ignored. Range: 0..8 for normal CAN/ LIN I-PDUs, 0..254 for normal FlexRay I-PDUs, and 0..4095 for I-PDUs with ComIPduType TP.
            enumeration ComSignalType: {BOOLEAN, FLOAT32, FLOAT64, SINT16, SINT32, SINT8, UINT16, UINT32, UINT8, UINT8_DYN, UINT8_N}, set at link in variant link-time / post-build in variant post-build / pre-compile in variant pre-compile  # The AUTOSAR type of the signal. Whether or not the signal is signed or unsigned can be found by examining the value of this attribute. | This type could also be used to reserved appropriate storage in AUTOSAR COM.
            integer ComUpdateBitPosition [0..1]: 0..2031, set at link in variant link-time / post-build in variant post-build / pre-compile in variant pre-compile  # Bit position of update-bit inside I-PDU. | If this attribute is omitted then there is no update-bit. This setting must be consistently on sender and on receiver side. Range: 0..63 for CAN and LIN 0..2031 for FlexRay
            reference ComGwIPduRef: set at link in variant link-time / post-build in variant post-build / pre-compile in variant pre-compile, destination=ComIPdu  # Reference to an I-PDU of a Signal Gateway source or destination description.
      container ComIPdu [0..*]  # Contains the configuration parameters of the AUTOSAR COM module's I-PDUs.
        function name ComIPduCallout [0..1]: set at pre-compile  # This parameter defines the existence and the name of a callout function for the corresponding I-PDU. If this parameter is omitted no I-PDU callout shall take place for the corresponding I-PDU.
        boolean ComIPduCancellationSupport [0..1]: set at pre-compile, default-value=false  # Defines for I-PDUs with ComIPduType NORMAL: | If the underlying IF-modul supports cancellation of transmit requests. Defines for I-PDUs with ComIPduType TP: If the underlying TP-module supports RX and TX cancellation of ongoing requests.
        enumeration ComIPduDirection: {RECEIVE, SEND}, set at link in variant link-time / post-build in variant post-build / pre-compile in variant pre-compile  # The direction defines if this I-PDU, and therefore the contributing signals and signal groups, shall be sent or received.
        integer ComIPduHandleId [0..1]: 0..65535, set at link in variant link-time+post-build / pre-compile in variant pre-compile, symbolic-name-value=true  # The numerical value used as the ID of this I-PDU. The ComIPduHandleId is required by the API calls to receive I-PDUs from the PduR (ComIP-duDirection: Receive). For Tx-I-PDUs (ComIPduDirection: Send) this handle Id is used by the PduR to confirm the transmission of the ComIPdu. In case no Tx-Confirmation is configured for a Tx-I-PDU, the ComIPduHandleId is not used.
        enumeration ComIPduSignalProcessing: {DEFERRED, IMMEDIATE}, set at link in variant link-time / post-build in variant post-build / pre-compile in variant pre-compile  # For the definition of the two modes Immediate and Deferred.
        function name ComIPduTriggerTransmitCallout: set at pre-compile  # If there is a trigger transmit callout defined for this I-PDU this parameter contains the name of the callout function.
        enumeration ComIPduType: {NORMAL, TP}, set at link in variant link-time / post-build in variant post-build / pre-compile in variant pre-compile  # Defines if this I-PDU is a normal I-PDU that can be sent unfragmented or if this is a large I-PDU that shall be sent via the Transport Protocol of the underlying bus.
        reference ComIPduGroupRef [0..*]: set at link in variant link-time / post-build in variant post-build / pre-compile in variant pre-compile, destination=ComIPduGroup  # Reference to the I-PDU groups this I-PDU belongs to.
        reference ComIPduSignalGroupRef [0..*]: set at link in variant link-time / post-build in variant post-build / pre-compile in variant pre-compile, destination=ComSignalGroup  # References to all signal groups contained in this I-Pdu
        reference ComIPduSignalRef [0..*]: set at link in variant link-time / post-build in variant post-build / pre-compile in variant pre-compile, destination=ComSignal  # References to all signals contained in this I-PDU.
        reference ComPduIdRef: set at link in variant link-time+post-build / pre-compile in variant pre-compile, destination=Pdu  # Reference to the "global" Pdu structure to allow harmonization of handle IDs in the COM-Stack.
        container ComIPduCounter [0..1]  # This optional container contains the configuration parameters of PDU Counter.
          function name ComIPduCounterErrorNotification [0..1]: set at link in variant link-time+post-build / pre-compile in variant pre-compile  # Name of Com_CbkCounterErr callback function to be called. If this | parameter is omitted no I-PDU counter mismatch notification shall take place.
          integer ComIPduCounterSize: 1..8, set at pre-compile  # Size of PDU Counter expressed in bits
          integer ComIPduCounterStartPosition: 0..2031, set at pre-compile  # Position of PDU counter expressed in bits from start position of data content | of I-PDU (SDU). Note that PDU counter is not allowed to cross a byte border. The parameter ComIPduCounterStartPosition shall define the bit0 of the first byte like in little endian byte order.
          integer ComIPduCounterThreshold [0..1]: 0..255, set at pre-compile, default-value=0  # Threshold value of I-PDU counter algorithm, see COM590.
        container ComIPduReplication [0..1]  # This optional container contains the information needed for each I-PDU replicated.
          integer ComIPduReplicationQuorum: 1..3, set at pre-compile  # The number of identical I-PDUs needed for successful voting.
          reference ComIPduReplicaRef [1..2]: set at pre-compile, destination=Pdu  # Reference to replicas PduR PDUs of this IPDU.
        container ComTxIPdu [0..1]  # This container contains additional transmission related configuration parameters of the AUTOSAR COM module's I-PDUs.
          float ComMinimumDelayTime [0..1]: 0..3600, set at link in variant link-time / post-build in variant post-build / pre-compile in variant pre-compile, origin=AUTOSAR_ECUC V3.0  # Defines the Minimum Delay Time (MDT) between successive transmissions of this I-PDU in seconds. The MDT is independent of the possible different transmission modes. There is only one minimum delay time parameter for one I-PDU. The minimum delay timer is not reset by changing the transmission mode. Hence, it is not allowed to violate the minimum delay time by transmission mode changes. It is not possible to monitor the minimum delay time for I-PDUs that are requested using the Com_TriggerTransmit API.
          enumeration ComTxIPduClearUpdateBit [0..1]: {Confirmation, Transmit, TriggerTransmit}, set at link in variant link-time / post-build in variant post-build / pre-compile in variant pre-compile  # Defines when the update-bits of signals or signal groups, contained in this I-PDU, will be cleared.
          integer ComTxIPduUnusedAreasDefault: 0..255, set at link in variant link-time+post-build / pre-compile in variant pre-compile  # The AUTOSAR COM module fills not used areas of an I-PDU with this byte pattern. This attribute is mandatory to avoid undefined behaviour. This byte-pattern will be repeated throughout the I-PDU before any init-values or update-bits were set.
          container ComTxModeFalse [0..1]  # This container contains the configuration parameters of the AUTOSAR COM module's transmission modes in the case the ComFilter evaluates to false.
            container ComTxMode  # This container contains the configuration parameters of the AUTOSAR COM module's transmission modes.
              enumeration ComTxModeMode: {DIRECT, MIXED, NONE, PERIODIC}, set at link in variant link-time / post-build in variant post-build / pre-compile in variant pre-compile  # The available transmission modes described in [18] shall be extended by the additional mode None. | The transmission mode None shall not have any further sub-attributes in the ComTxMode object.
              integer ComTxModeNumberOfRepetitions [0..1]: 0..255, set at link in variant link-time / post-build in variant post-build / pre-compile in variant pre-compile  # Defines the number of repetitions for the transmission mode DIRECT and the event driven part of transmission mode MIXED.
              float ComTxModeRepetitionPeriod [0..1]: 0..3600, set at link in variant link-time / post-build in variant post-build / pre-compile in variant pre-compile  # Defines the repetition period in seconds of the multiple transmissions in case ComTxModeNumberOfRepetitions is configured greater than 1 and ComTxModeMode is configured to DIRECT or MIXED. In case of the mixed transmission mode only the event driven part is affected.
              float ComTxModeTimeOffset [0..1]: 0..3600, set at link in variant link-time / post-build in variant post-build / pre-compile in variant pre-compile  # Defines the period in seconds between the start of the I-PDU by Com_IpduGroupControl and the first transmission request in case ComTxModeMode is configured to PERIODIC or MIXED. In case of the mixed transmission mode only the periodic part is affected.
              float ComTxModeTimePeriod [0..1]: 0..3600, set at link in variant link-time / post-build in variant post-build / pre-compile in variant pre-compile  # Defines the repetition period in seconds of the periodic transmission requests in case ComTxModeMode is configured to PERIODIC or MIXED. In case of the mixed transmission mode only the periodic part is affected.
          container ComTxModeTrue [0..1]  # This container contains the configuration parameters of the AUTOSAR COM module's transmission modes in the case the ComFilter evaluates to true.
            container ComTxMode  # This container contains the configuration parameters of the AUTOSAR COM module's transmission modes.
              enumeration ComTxModeMode: {DIRECT, MIXED, NONE, PERIODIC}, set at link in variant link-time / post-build in variant post-build / pre-compile in variant pre-compile  # The available transmission modes described in [18] shall be extended by the additional mode None. | The transmission mode None shall not have any further sub-attributes in the ComTxMode object.
              integer ComTxModeNumberOfRepetitions [0..1]: 0..255, set at link in variant link-time / post-build in variant post-build / pre-compile in variant pre-compile  # Defines the number of repetitions for the transmission mode DIRECT and the event driven part of transmission mode MIXED.
              float ComTxModeRepetitionPeriod [0..1]: 0..3600, set at link in variant link-time / post-build in variant post-build / pre-compile in variant pre-compile  # Defines the repetition period in seconds of the multiple transmissions in case ComTxModeNumberOfRepetitions is configured greater than 1 and ComTxModeMode is configured to DIRECT or MIXED. In case of the mixed transmission mode only the event driven part is affected.
              float ComTxModeTimeOffset [0..1]: 0..3600, set at link in variant link-time / post-build in variant post-build / pre-compile in variant pre-compile  # Defines the period in seconds between the start of the I-PDU by Com_IpduGroupControl and the first transmission request in case ComTxModeMode is configured to PERIODIC or MIXED. In case of the mixed transmission mode only the periodic part is affected.
              float ComTxModeTimePeriod [0..1]: 0..3600, set at link in variant link-time / post-build in variant post-build / pre-compile in variant pre-compile  # Defines the repetition period in seconds of the periodic transmission requests in case ComTxModeMode is configured to PERIODIC or MIXED. In case of the mixed transmission mode only the periodic part is affected.
      container ComIPduGroup [0..*]  # Contains the configuration parameters of the AUTOSAR COM module's I-PDU groups.
        integer ComIPduGroupHandleId: 0..65535, set at link in variant link-time+post-build / pre-compile in variant pre-compile, symbolic-name-value=true  # The numerical value used as the ID of this I-PDU Group . | The ComIPduGroupHandleId is required by the API calls to start and stop I-PDU Groups. Range: 0 .. (ComSupportedIPduGroups-1)
        reference ComIPduGroupGroupRef [0..*]: set at link in variant link-time / post-build in variant post-build / pre-compile in variant pre-compile, destination=ComIPduGroup  # References to all I-PDU groups that includes this I-PDU group. If this reference is omitted this I-PDU group does not belong to another I-PDU group.
      container ComSignal [0..*]  # Contains the configuration parameters of the AUTOSAR COM module's signals.
        integer ComBitPosition: 0..2031, set at link in variant link-time / post-build in variant post-build / pre-compile in variant pre-compile  # Starting position within the I-PDU. This parameter refers to the position in the I-PDU and not in the shadow buffer. If the endianness conversion is configured to Opaque the parameter ComBitPosition shall define the bit0 of the first byte like in little endian byte order
        integer ComBitSize [0..1]: 0..64, set at link in variant link-time / post-build in variant post-build / pre-compile in variant pre-compile  # Size in bits, for non-array signal types. | For ComSignalType UINT8_N and UINT8_DYN this size shall be configured by ComSignalLength.
        enumeration ComDataInvalidAction [0..1]: {NOTIFY, REPLACE}, set at link in variant link-time+post-build / pre-compile in variant pre-compile  # This parameter defines the action performed upon reception of an invalid signal. | Relating to signal groups the action in case if one of the included signals is an invalid signal. If Replace is used the ComSignalInitValue will be used for the replacement.
        function name ComErrorNotification [0..1]: set at link in variant link-time+post-build / pre-compile in variant pre-compile  # Only valid on sender side: Name of Com_CbkTxErr callback function to be called. | If this parameter is omitted no error notification shall take place.
        float ComFirstTimeout [0..1]: 0..3600, set at link in variant link-time+post-build / pre-compile in variant pre-compile  # Defines the length of the first deadline monitoring timeout period in seconds. This timeout is used immediately after start (or restart) of the deadline monitoring service. The timeout period of the successive periods is configured by COM263_Conf.
        integer ComHandleId: 0..65535, set at link in variant link-time+post-build / pre-compile in variant pre-compile, symbolic-name-value=true  # The numerical value used as the ID. | For signals it is required by the API calls Com_UpdateShadowSignal, Com_ReceiveShadowSignal and Com_InvalidateShadowSignal. For signals groups it is required by the Com_SendSignalGroup and Com_ReceiveSignalGroup calls.
        function name ComInvalidNotification [0..1]: set at link in variant link-time+post-build / pre-compile in variant pre-compile  # Only valid on receiver side: Name of Com_CbkInv callback function to be called. Name of the function which notifies the RTE about the reception of an invalidated signal/ signal group. Only applicable if ComDataInvalidAction is configured to NOTIFY.
        function name ComNotification [0..1]: set at link in variant link-time+post-build / pre-compile in variant pre-compile  # On sender side: Name of Com_CbkTxAck callback function to be called. | On receiver side: Name of Com_CbkRxAck callback function to be called. If this parameter is omitted no notification shall take place.
        enumeration ComRxDataTimeoutAction [0..1]: {NONE, REPLACE}, set at link in variant link-time+post-build / pre-compile in variant pre-compile  # This parameter defines the action performed upon expiration of the reception deadline monitoring timer.
        string ComSignalDataInvalidValue [0..1]: set at link in variant link-time+post-build / pre-compile in variant pre-compile  # Defines the data invalid value of the signal. | In case the ComSignalType is UINT8, UINT16, UINT32, SINT8, SINT16, SINT32 the string shall be interpreted as defined in the chapter Integer Type in the AUTOSAR EcuC specification. In case the ComSignalType is FLOAT32, FLOAT64 the string shall be interpreted as defined in the chapter Float Type in the AUTOSAR EcuC specification. In case the ComSignalType is BOOLEAN the string shall be interpreted as defined in the chapter Boolean Type in the AUTOSAR EcuC specification. In case the ComSignal is a UINT8_N, UINT6_DYN the string shall be interpreted as a decimal representation of the characters separated by blanks, e.g. "97 98 100" means a string "abd", where the char "a" is in byte 0(lowest address), "b" is in byte 1, and "d" is in byte 2 and (highest address).
        enumeration ComSignalEndianness: {BIG_ENDIAN, LITTLE_ENDIAN, OPAQUE}, set at link in variant link-time / post-build in variant post-build / pre-compile in variant pre-compile  # Defines the endianness of the signal's network representation.
        string ComSignalInitValue [0..1]: set at link in variant link-time / post-build in variant post-build / pre-compile in variant pre-compile, default-value=0  # Initial value for this signal. The default value is 0. | In case the ComSignalType is UINT8, UINT16, UINT32, SINT8, SINT16, SINT32 the string shall be interpreted as defined in the chapter Integer Type in the AUTOSAR EcuC specification. In case the ComSignalType is FLOAT32, FLOAT64 the string shall be interpreted as defined in the chapter Float Type in the AUTOSAR EcuC specification. In case the ComSignalType is BOOLEAN the string shall be interpreted as defined in the chapter Boolean Type in the AUTOSAR EcuC specification. In case the ComSignal is a UINT8_N, UINT6_DYN the string shall be interpreted as a decimal representation of the characters separated by blanks, e.g. "97 98 100" means a string "abd", where the char "a" is in byte 0(lowest address), "b" is in byte 1, and "d" is in byte 2 and (highest address).
        integer ComSignalLength [0..1]: 0..4095, set at link in variant link-time+post-build / pre-compile in variant pre-compile  # Description: | For ComSignalType UINT8_N this parameter specifies the length n in bytes. For ComSignalType UINT8_DYN it specifies the maximum length in bytes. For all other types this parameter shall be ignored. Range: 0..8 for normal CAN/ LIN I-PDUs, 0..254 for normal FlexRay I-PDUs, and 0..4095 for I-PDUs with ComIPduType TP.
        enumeration ComSignalType: {BOOLEAN, FLOAT32, FLOAT64, SINT16, SINT32, SINT8, UINT16, UINT32, UINT8, UINT8_DYN, UINT8_N}, set at link in variant link-time / post-build in variant post-build / pre-compile in variant pre-compile  # The AUTOSAR type of the signal. Whether or not the signal is signed or unsigned can be found by examining the value of this attribute. | This type could also be used to reserved appropriate storage in AUTOSAR COM.
        float ComTimeout [0..1]: 0..3600, set at link in variant link-time / post-build in variant post-build / pre-compile in variant pre-compile  # Defines the length of the deadline monitoring timeout period in seconds. The period for the first timeout period can be configured separately by COM183_Conf.
        function name ComTimeoutNotification [0..1]: set at link in variant link-time+post-build / pre-compile in variant pre-compile  # On sender side: Name of Com_CbkTxTOut callback function to be called. | On receiver side: Name of Com_CbkRxTOut callback function to be called.
        enumeration ComTransferProperty [0..1]: {PENDING, TRIGGERED, TRIGGERED_ON_CHANGE, TRIGGERED_ON_CHANGE_WITHOUT_REPETITION, TRIGGERED_WITHOUT_REPETITION}, set at link in variant link-time / post-build in variant post-build / pre-compile in variant pre-compile  # Defines if a write access to this signal can trigger the transmission of the corresponding I-PDU. If the I-PDU is triggered, depends also on the transmission mode of the corresponding I-PDU.
        integer ComUpdateBitPosition [0..1]: 0..2031, set at link in variant link-time / post-build in variant post-build / pre-compile in variant pre-compile  # Bit position of update-bit inside I-PDU. | If this attribute is omitted then there is no update-bit. This setting must be consistently on sender and on receiver side. Range: 0..63 for CAN and LIN 0..2031 for FlexRay
        foreign reference ComSystemTemplateSystemSignalRef [0..1]: set at link in variant link-time / post-build in variant post-build / pre-compile in variant pre-compile, destination-type=I-SIGNAL-TO-I-PDU-MAPPING  # Reference to the ISignalToIPduMapping that contains a reference to the ISignal (System Template) which this ComSignal (or ComGroupSignal) represents.
        container ComFilter [0..1]  # This container contains the configuration parameters of the AUTOSAR COM module's Filters. | Note: On sender side the container is used to specify the transmission mode conditions.
          enumeration ComFilterAlgorithm: {ALWAYS, MASKED_NEW_DIFFERS_MASKED_OLD, MASKED_NEW_DIFFERS_X, MASKED_NEW_EQUALS_X, NEVER, NEW_IS_OUTSIDE, NEW_IS_WITHIN, ONE_EVERY_N}, set at link in variant link-time+post-build / pre-compile in variant pre-compile  # The range of values is specified in the [17] specification, chapter 2.2.2, Reception Filtering.
          integer ComFilterMask [0..1]: 0..18446744073709551615, set at link in variant link-time+post-build / pre-compile in variant pre-compile  # The name of this attribute corresponds to the parameter name in the [17] specification of Reception Filtering.
          integer ComFilterMax [0..1]: 0..18446744073709551615, set at link in variant link-time+post-build / pre-compile in variant pre-compile  # The name of this attribute corresponds to the parameter name in the [17] specification of Reception Filtering.
          integer ComFilterMin [0..1]: 0..18446744073709551615, set at link in variant link-time+post-build / pre-compile in variant pre-compile  # The name of this attribute corresponds to the parameter name in the [17] specification of Reception Filtering.
          integer ComFilterOffset [0..1]: 0..18446744073709551615, set at link in variant link-time+post-build / pre-compile in variant pre-compile  # The name of this attribute corresponds to the parameter name in the [17] specification of Reception Filtering. | Range = 0..(ComFilterPeriod-1)
          integer ComFilterPeriod [0..1]: 0..18446744073709551615, set at link in variant link-time / post-build in variant post-build / pre-compile in variant pre-compile  # This parameter defines the period of the ComFilterAlgorithm ONE_EVERY_N.
          integer ComFilterX [0..1]: 0..18446744073709551615, set at link in variant link-time+post-build / pre-compile in variant pre-compile  # The name of this attribute corresponds to the parameter name in the [17] specification of Reception Filtering.
      container ComSignalGroup [0..*]  # Contains the configuration parameters of the AUTOSAR COM module's signal groups.
        enumeration ComDataInvalidAction [0..1]: {NOTIFY, REPLACE}, set at link in variant link-time+post-build / pre-compile in variant pre-compile  # This parameter defines the action performed upon reception of an invalid signal. | Relating to signal groups the action in case if one of the included signals is an invalid signal. If Replace is used the ComSignalInitValue will be used for the replacement.
        function name ComErrorNotification [0..1]: set at link in variant link-time+post-build / pre-compile in variant pre-compile  # Only valid on sender side: Name of Com_CbkTxErr callback function to be called. | If this parameter is omitted no error notification shall take place.
        float ComFirstTimeout [0..1]: 0..3600, set at link in variant link-time+post-build / pre-compile in variant pre-compile  # Defines the length of the first deadline monitoring timeout period in seconds. This timeout is used immediately after start (or restart) of the deadline monitoring service. The timeout period of the successive periods is configured by COM263_Conf.
        integer ComHandleId: 0..65535, set at link in variant link-time+post-build / pre-compile in variant pre-compile, symbolic-name-value=true  # The numerical value used as the ID. | For signals it is required by the API calls Com_UpdateShadowSignal, Com_ReceiveShadowSignal and Com_InvalidateShadowSignal. For signals groups it is required by the Com_SendSignalGroup and Com_ReceiveSignalGroup calls.
        function name ComInvalidNotification [0..1]: set at link in variant link-time+post-build / pre-compile in variant pre-compile  # Only valid on receiver side: Name of Com_CbkInv callback function to be called. Name of the function which notifies the RTE about the reception of an invalidated signal/ signal group. Only applicable if ComDataInvalidAction is configured to NOTIFY.
        function name ComNotification [0..1]: set at link in variant link-time+post-build / pre-compile in variant pre-compile  # On sender side: Name of Com_CbkTxAck callback function to be called. | On receiver side: Name of Com_CbkRxAck callback function to be called. If this parameter is omitted no notification shall take place.
        enumeration ComRxDataTimeoutAction [0..1]: {NONE, REPLACE}, set at link in variant link-time+post-build / pre-compile in variant pre-compile  # This parameter defines the action performed upon expiration of the reception deadline monitoring timer.
        float ComTimeout [0..1]: 0..3600, set at link in variant link-time / post-build in variant post-build / pre-compile in variant pre-compile  # Defines the length of the deadline monitoring timeout period in seconds. The period for the first timeout period can be configured separately by COM183_Conf.
        function name ComTimeoutNotification [0..1]: set at link in variant link-time+post-build / pre-compile in variant pre-compile  # On sender side: Name of Com_CbkTxTOut callback function to be called. | On receiver side: Name of Com_CbkRxTOut callback function to be called.
        enumeration ComTransferProperty [0..1]: {PENDING, TRIGGERED, TRIGGERED_ON_CHANGE, TRIGGERED_ON_CHANGE_WITHOUT_REPETITION, TRIGGERED_WITHOUT_REPETITION}, set at link in variant link-time / post-build in variant post-build / pre-compile in variant pre-compile  # Defines if a write access to this signal can trigger the transmission of the corresponding I-PDU. If the I-PDU is triggered, depends also on the transmission mode of the corresponding I-PDU.
        integer ComUpdateBitPosition [0..1]: 0..2031, set at link in variant link-time / post-build in variant post-build / pre-compile in variant pre-compile  # Bit position of update-bit inside I-PDU. | If this attribute is omitted then there is no update-bit. This setting must be consistently on sender and on receiver side. Range: 0..63 for CAN and LIN 0..2031 for FlexRay
        foreign reference ComSystemTemplateSignalGroupRef [0..1]: set at link in variant link-time / post-build in variant post-build / pre-compile in variant pre-compile, destination-type=I-SIGNAL-TO-I-PDU-MAPPING  # Reference to the ISignalToIPduMapping that contains a reference to the ISignalGroup (SystemTemplate) which this ComSignalGroup represents.
        container ComGroupSignal [0..*]  # This container contains the configuration parameters of group signals. I.e. signals that are included within a signal group.
          integer ComBitPosition: 0..2031, set at link in variant link-time / post-build in variant post-build / pre-compile in variant pre-compile  # Starting position within the I-PDU. This parameter refers to the position in the I-PDU and not in the shadow buffer. If the endianness conversion is configured to Opaque the parameter ComBitPosition shall define the bit0 of the first byte like in little endian byte order
          integer ComBitSize [0..1]: 0..64, set at link in variant link-time / post-build in variant post-build / pre-compile in variant pre-compile  # Size in bits, for non-array signal types. | For ComSignalType UINT8_N and UINT8_DYN this size shall be configured by ComSignalLength.
          integer ComHandleId: 0..65535, set at link in variant link-time+post-build / pre-compile in variant pre-compile, symbolic-name-value=true  # The numerical value used as the ID. | For signals it is required by the API calls Com_UpdateShadowSignal, Com_ReceiveShadowSignal and Com_InvalidateShadowSignal. For signals groups it is required by the Com_SendSignalGroup and Com_ReceiveSignalGroup calls.
          string ComSignalDataInvalidValue [0..1]: set at link in variant link-time+post-build / pre-compile in variant pre-compile  # Defines the data invalid value of the signal. | In case the ComSignalType is UINT8, UINT16, UINT32, SINT8, SINT16, SINT32 the string shall be interpreted as defined in the chapter Integer Type in the AUTOSAR EcuC specification. In case the ComSignalType is FLOAT32, FLOAT64 the string shall be interpreted as defined in the chapter Float Type in the AUTOSAR EcuC specification. In case the ComSignalType is BOOLEAN the string shall be interpreted as defined in the chapter Boolean Type in the AUTOSAR EcuC specification. In case the ComSignal is a UINT8_N, UINT6_DYN the string shall be interpreted as a decimal representation of the characters separated by blanks, e.g. "97 98 100" means a string "abd", where the char "a" is in byte 0(lowest address), "b" is in byte 1, and "d" is in byte 2 and (highest address).
          enumeration ComSignalEndianness: {BIG_ENDIAN, LITTLE_ENDIAN, OPAQUE}, set at link in variant link-time / post-build in variant post-build / pre-compile in variant pre-compile  # Defines the endianness of the signal's network representation.
          string ComSignalInitValue [0..1]: set at link in variant link-time / post-build in variant post-build / pre-compile in variant pre-compile, default-value=0  # Initial value for this signal. The default value is 0. | In case the ComSignalType is UINT8, UINT16, UINT32, SINT8, SINT16, SINT32 the string shall be interpreted as defined in the chapter Integer Type in the AUTOSAR EcuC specification. In case the ComSignalType is FLOAT32, FLOAT64 the string shall be interpreted as defined in the chapter Float Type in the AUTOSAR EcuC specification. In case the ComSignalType is BOOLEAN the string shall be interpreted as defined in the chapter Boolean Type in the AUTOSAR EcuC specification. In case the ComSignal is a UINT8_N, UINT6_DYN the string shall be interpreted as a decimal representation of the characters separated by blanks, e.g. "97 98 100" means a string "abd", where the char "a" is in byte 0(lowest address), "b" is in byte 1, and "d" is in byte 2 and (highest address).
          integer ComSignalLength [0..1]: 0..4095, set at link in variant link-time+post-build / pre-compile in variant pre-compile  # Description: | For ComSignalType UINT8_N this parameter specifies the length n in bytes. For ComSignalType UINT8_DYN it specifies the maximum length in bytes. For all other types this parameter shall be ignored. Range: 0..8 for normal CAN/ LIN I-PDUs, 0..254 for normal FlexRay I-PDUs, and 0..4095 for I-PDUs with ComIPduType TP.
          enumeration ComSignalType: {BOOLEAN, FLOAT32, FLOAT64, SINT16, SINT32, SINT8, UINT16, UINT32, UINT8, UINT8_DYN, UINT8_N}, set at link in variant link-time / post-build in variant post-build / pre-compile in variant pre-compile  # The AUTOSAR type of the signal. Whether or not the signal is signed or unsigned can be found by examining the value of this attribute. | This type could also be used to reserved appropriate storage in AUTOSAR COM.
          enumeration ComTransferProperty: {PENDING, TRIGGERED_ON_CHANGE}, set at link in variant link-time / post-build in variant post-build / pre-compile in variant pre-compile  # Optionally defines whether this group signal shall contribute to the TRIGGERED_ON_CHANGE transfer property of the signal group. If at least one group signal of a signal group has the "ComTransferProperty" configured all other group signals of that signal group shall have the attribute configured as well.
          foreign reference ComSystemTemplateSystemSignalRef [0..1]: set at link in variant link-time / post-build in variant post-build / pre-compile in variant pre-compile, destination-type=I-SIGNAL-TO-I-PDU-MAPPING  # Reference to the ISignalToIPduMapping that contains a reference to the ISignal (System Template) which this ComSignal (or ComGroupSignal) represents.
          container ComFilter [0..1]  # This container contains the configuration parameters of the AUTOSAR COM module's Filters. | Note: On sender side the container is used to specify the transmission mode conditions.
            enumeration ComFilterAlgorithm: {ALWAYS, MASKED_NEW_DIFFERS_MASKED_OLD, MASKED_NEW_DIFFERS_X, MASKED_NEW_EQUALS_X, NEVER, NEW_IS_OUTSIDE, NEW_IS_WITHIN, ONE_EVERY_N}, set at link in variant link-time+post-build / pre-compile in variant pre-compile  # The range of values is specified in the [17] specification, chapter 2.2.2, Reception Filtering.
            integer ComFilterMask [0..1]: 0..18446744073709551615, set at link in variant link-time+post-build / pre-compile in variant pre-compile  # The name of this attribute corresponds to the parameter name in the [17] specification of Reception Filtering.
            integer ComFilterMax [0..1]: 0..18446744073709551615, set at link in variant link-time+post-build / pre-compile in variant pre-compile  # The name of this attribute corresponds to the parameter name in the [17] specification of Reception Filtering.
            integer ComFilterMin [0..1]: 0..18446744073709551615, set at link in variant link-time+post-build / pre-compile in variant pre-compile  # The name of this attribute corresponds to the parameter name in the [17] specification of Reception Filtering.
            integer ComFilterOffset [0..1]: 0..18446744073709551615, set at link in variant link-time+post-build / pre-compile in variant pre-compile  # The name of this attribute corresponds to the parameter name in the [17] specification of Reception Filtering. | Range = 0..(ComFilterPeriod-1)
            integer ComFilterPeriod [0..1]: 0..18446744073709551615, set at link in variant link-time / post-build in variant post-build / pre-compile in variant pre-compile  # This parameter defines the period of the ComFilterAlgorithm ONE_EVERY_N.
            integer ComFilterX [0..1]: 0..18446744073709551615, set at link in variant link-time+post-build / pre-compile in variant pre-compile  # The name of this attribute corresponds to the parameter name in the [17] specification of Reception Filtering.
      container ComTimeBase  # Contains the timebase parameters for Tx, Rx and routing.
        float ComGwTimeBase [0..1]: 0..3600, set at link in variant link-time / post-build in variant post-build / pre-compile in variant pre-compile  # The period between successive calls to Com_MainFunctionRouteSignals in seconds. This parameter may be used by the COM generator to transform the values of the signal gateway related timing configuration parameters of the COM module to internal implementation specific counter or tick values. The COM module's internal timing handling is implementation specific. | The COM module (generator) might rely on the fact that Com_MainFunctionRouteSignals is scheduled according to the value configured here.
        float ComRxTimeBase [0..1]: 0..3600, set at link in variant link-time / post-build in variant post-build / pre-compile in variant pre-compile  # The period between successive calls to Com_MainFunctionRx in seconds. This parameter may be used by the COM generator to transform the values of the reception related timing configuration parameters of the COM module to internal implementation specific counter or tick values. The COM module's internal timing handling is implementation specific. | The COM module (generator) may rely on the fact that Com_MainFunctionRx is scheduled according to the value configured here.
        float ComTxTimeBase [0..1]: 0..3600, set at link in variant link-time / post-build in variant post-build / pre-compile in variant pre-compile  # The period between successive calls to Com_MainFunctionTx in seconds. This parameter may be used by the COM generator to transform the values of the transmission related timing configuration parameters of the COM module to internal implementation specific counter or tick values. The COM module's internal timing handling is implementation specific. | The COM module (generator) may rely on the fact that Com_MainFunctionTx is scheduled according to the value configured here.
    container ComGeneral  # Contains the general configuration parameters of the module.
      boolean ComConfigurationUseDet [0..1]: set at pre-compile  # The error hook shall contain code to call the Det. | If this parameter is configured COM_DEV_ERROR_DETECT shall be set to ON as output of the configuration tool. (as input for the source code), see COM028.
      boolean ComEnableMDTForCyclicTransmission [0..1]: set at pre-compile, default-value=true  # Enables globally for the whole Com module the minimum delay time monitoring for cyclic and repeated transmissions (ComTxModeMode=PERIODIC or ComTxModeMode=MIXED for the cyclic transmissions, ComTxModeNumberOfRepetitions > 0 for repeated transmissions).
      boolean ComRetryFailedTransmitRequests [0..1]: set at pre-compile, default-value=true  # If this Parameter is set to true, retry of failed transmission requests is enabled. If this Parameter is not present, the default value is assumed.
      integer ComSupportedIPduGroups: 0..65535, set at pre-compile  # Defines the maximum number of supported I-PDU groups.
      boolean ComVersionInfoApi: set at pre-compile  # Activate/Deactivate the version information API (Com_GetVersionInfo). | True: version information API activated False: version information API deactivated
  module definition ComM [0..1]: variants post-build/pre-compile  # Configuration of the ComM (Communications Manager) module.
    container ComMConfigSet: multiple-configuration-container=true  # This container is the base for a multiple configuration set.
      boolean ComMPncEnabled [0..1]: set at post-build in variant post-build / pre-compile in variant pre-compile, default-value=false  # Defines whether in this configuration set the partial networking is enabled. | true: Enabled false: Disabled
      container ComMChannel [1..*]  # This container contains the configuration (parameters) of the bus channel(s). The channel parameters shall be harmonized within the whole communication stack.
        enumeration ComMBusType: {COMM_BUS_TYPE_CAN, COMM_BUS_TYPE_ETH, COMM_BUS_TYPE_FR, COMM_BUS_TYPE_INTERNAL, COMM_BUS_TYPE_LIN}, set at pre-compile  # Identifies the bus type of the channel.
        integer ComMChannelId: 0..255, set at pre-compile, symbolic-name-value=true  # Channel identification number of the corresponding channel.
        boolean ComMFullCommRequestNotificationEnabled: set at pre-compile, default-value=false  # Defines if the optional SenderReceiver Port of Interface ComM_CurrentChannelRequest will be provided for this channel. | True means enabled. False means disabled
        boolean ComMGlobalNvmBlockDescriptor: set at pre-compile  # If this parameter is set to "true", the NoWakeUp inhibition state of the channel shall be stored (in some implementation specific way) in the block pointed to by ComMGlobalNvmBlockDescriptor.
        float ComMMainFunctionPeriod: 0.001..0.1, set at pre-compile, default-value=0.02  # Specifies the period in seconds that the MainFunction has to be triggered with. | Comment: ComM scheduling shall be at least as fast as the communication stack and a schedule longer than 100ms makes no sense for communication.
        boolean ComMNoCom: set at pre-compile, default-value=false  # Not allowed to change state of ComM channel to COMM_SILENT_COMMUNICATION or COMM_FULL_COMMUNICATION. | true: Enabled - Not allowed to switch to Communication Modes above. false: Disabled - Allowed to switch Communication Modes above. Shall be possible to change parameter during runtime with ComM API's. ECU/All channels: ComM_LimitECUToNoComMode(). Separate channels: ComM_LimitChannelToNoComMode().
        boolean ComMNoWakeup: set at pre-compile, default-value=false  # Defines if an ECU is not allowed to wake-up the channel. | true: Enabled (not allowed to wake-up)) false: Disabled This is the default/init value of a runtime variable that can be changed during runtime using ComM_PreventWakeUp().
        enumeration ComMPncGatewayType [0..1]: {COMM_GATEWAY_TYPE_ACTIVE, COMM_GATEWAY_TYPE_PASSIVE}, set at pre-compile  # Identifies the Partial Network Gateway behaviour of a ComMChannel.
        container ComMNetworkManagement  # This container contains the configuration parameters of the networkmanagement.
          float ComMNmLightTimeout [0..1]: 0..255, set at pre-compile, default-value=10  # Defines the timeout (in seconds) after COMM_FULL_COMMUNICATION sub-state COMM_FULL_COM_READY_SLEEP is left. | The range shall be greater than 0.0 and less or equal to 255.0.
          enumeration ComMNmVariant: {FULL, LIGHT, NONE, PASSIVE}, set at pre-compile, default-value=FULL  # Defines the functionality of the networkmanagement. | Shall be harmonized with NM configuration.
          boolean ComMPncNmRequest: set at pre-compile, default-value=false  # If this parameter equals true then every time a FULL Communication is requested due to a change in the PNC state machine to PNC_REQUESTED Nm shall be called using the API Nm_NetworkRequest.
        container ComMUserPerChannel [0..*]  # This container contains a list of identifiers that are needed to refer to a user in the system which is linked to a channel.
          reference ComMUserChannel: set at pre-compile, destination=ComMUser  # Reference to the ComMUser that corresponds to this channel user. | ImplementationType: COMM_UserHandleType
      container ComMPnc [0..*]  # This container contains the configuration of the partial network cluster (PNC).
        integer ComMPncId: 0..47, set at pre-compile, symbolic-name-value=true  # Partial network cluster identification number.
        reference ComMChannelPerPnc [1..*]: set at pre-compile, destination=ComMChannel  # Reference to the ComMChannel that is required for this PNC. | ImplementationType: COMM_ChannelType
        reference ComMUserPerPnc [0..*]: set at pre-compile, destination=ComMUser  # Reference to the ComMUsers that correspond to this PNC. | ImplementationType: COMM_UserHandleType
        container ComMPncComSignal [0..*]  # Represents the PncComSignals which are used to communicate the EIRA and ERA status of this PNC.
          enumeration ComMPncComSignalDirection: {RX, TX}, set at pre-compile  # Indicates the communication direction of this PncComSignal.
          enumeration ComMPncComSignalKind: {EIRA, ERA}, set at pre-compile  # Indicates whether this PncComSignal represents EIRA or ERA PNC information.
          reference ComMPncComSignalChannelRef [0..1]: set at pre-compile, destination=ComMChannel  # Reference to the ComMChannel which is used to determine whether this PncComSignal shall participate in the active or passive role (via the parameter ComMPncGatewayType of the ComMChannel). | Not applicable if ComMPncComSignalKind is EIRA.
          symbolic name reference ComMPncComSignalRef: set at pre-compile, destination=ComSignal  # Reference to the ComSignal which is used to transport the partial network channel request information.
      container ComMUser [1..*]  # This container contains a list of identifiers that are needed to refer to a user in the system which is designated to request Communication modes.
        integer ComMUserIdentifier: 0..255, set at pre-compile, symbolic-name-value=true  # An identifier that is needed to refer to a user in the system which is designated to request Communication Modes. | ImplementationType: ComM_UserHandleType
        reference ComMUserEcucPartitionRef [0..1]: set at pre-compile, destination=EcucPartition  # Denotes in which "EcucPartition" the requester is executed. When the | partition is stopped, the communication request shall be cancelled in the ComM to avoid a stay-awake situation of the bus due to a stopped partition.
    container ComMGeneral  # General configuration parameters of the Communication Manager.
      boolean ComMDevErrorDetect: set at pre-compile, default-value=false  # Switches the Development Error Detection and Notification ON or OFF. | true: Enabled false: Disabled
      boolean ComMDirectUserMapping [0..1]: set at pre-compile, default-value=false  # If this parameter is set to true the configuration tool shall automatically create a ComMUser per ComMPnc and a ComMUser per ComMChannel. | The shortName of the generated ComMUsers shall follow the following naming convention: PNCUser_ComMPncId, e.g. PNCUser_13 ChannelUser_ComMChannelId, e.g. ChannelUser_25 Restriction: ComMUser, which are created due to this configuration parameter, shall not be used by SWCs (only available for BswM).
      integer ComMEcuGroupClassification: 0..255, set at pre-compile, default-value=3  # Defines whether a mode inhibition affects the ECU or not. | Examples: 000: No mode inhibition can be activated 001: Wake up inhibition can be enabled Forcing into COMM_NO_COMMUNICATION mode shall be switched on if ComMNmVariant=PASSIVE.
      boolean ComMModeLimitationEnabled: set at pre-compile, default-value=false  # true if mode limitation functionality shall be enabled. | true: Enabled false: Disabled
      boolean ComMPncGatewayEnabled [0..1]: set at pre-compile, default-value=false  # Enables or disables support of Partial Network Gateway. | False: Partial Networking Gateway is disabled True: Partial Networking Gateway is enabled
      float ComMPncPrepareSleepTimer [0..1]: 0..63, set at pre-compile  # Time in seconds the PNC state machine shall wait in PNC_PREPARE_SLEEP.
      boolean ComMPncSupport: set at pre-compile, default-value=false  # Enables or disables support of partial networking. | False: Partial Networking is disabled True: Partial Networking is enabled
      boolean ComMSynchronousWakeUp: set at pre-compile, default-value=true  # Wake up of one channel shall lead to a wake up of all channels if true. | true: Enabled false: Disabled
      float ComMTMinFullComModeDuration: 0.001..65, set at pre-compile, default-value=5  # Minimum time duration in seconds, spent in the COMM_FULL_COMMUNICATION sub-state COMM_FULL_COM_NETWORK_REQUESTED.
      boolean ComMVersionInfoApi: set at pre-compile, default-value=true  # Switches the possibility to read the published information with the service ComM_GetPublishedInformation(). | true: Enabled false: Disabled
      boolean ComMWakeupInhibitionEnabled: set at pre-compile, default-value=false  # true if wake up inhibition functionality enabled. | true: Enabled false: Disabled
      symbolic name reference ComMGlobalNvMBlockDescriptor [0..1]: set at pre-compile, destination=NvMBlockDescriptor  # Reference to NVRAM block containing the none volatile data. If this parameter is not configured it means that no NVRam is used at all.
  module definition CorTst [0..1]: variants link-time/pre-compile  # Configuration of the CorTst module.
    container CorTstBackgroundConfigSet [0..*]  # Multiple Configuration Set Container, defines background mode.
      container CorTstSelect  # This container specifies configuration parameters to select individual tests for foreground mode and background mode. The availability is hardware and implementation specific.
        boolean CorTstAddress: set at link in variant link-time / pre-compile in variant pre-compile, default-value=false  # Enable/Disables core address test.
        boolean CorTstAlu: set at link in variant link-time / pre-compile in variant pre-compile, default-value=false  # Enable/Disables core ALU test.
        boolean CorTstCache: set at link in variant link-time / pre-compile in variant pre-compile, default-value=false  # Enable/Disables core cache test.
        boolean CorTstInterrupt: set at link in variant link-time / pre-compile in variant pre-compile, default-value=false  # Enable/Disables core interrupt test
        boolean CorTstMemoryIf: set at link in variant link-time / pre-compile in variant pre-compile, default-value=false  # Enable/Disables core memory interface test
        boolean CorTstMpu: set at link in variant link-time / pre-compile in variant pre-compile, default-value=false  # Enable/Disables core MPU test
        boolean CorTstRegister: set at link in variant link-time / pre-compile in variant pre-compile, default-value=false  # Enable/Disables core register test
    container CorTstConfigApiServices
      boolean CorTstAbortApi: set at pre-compile, default-value=false  # Adds / removes the service CorTst_Abort() from the code.
      boolean CorTstGetCurrentStatus: set at pre-compile, default-value=false  # Adds / removes the service CorTst_GetCurrentStatus() from the code.
      boolean CorTstGetFgndSignature: set at pre-compile, default-value=false  # Adds / removes the service CorTst_GetFgndSignature() from the code.
      boolean CorTstGetSignature: set at pre-compile, default-value=false  # Adds / removes the service CorTst_GetSignature() from the code.
      boolean CorTstGetStateApi: set at pre-compile, default-value=false  # Adds / removes the service CorTst_GetState() from the code.
      boolean CorTstStartApi: set at pre-compile, default-value=false  # Adds / removes the service CorTst_Start() from the code.
      boolean CorTstVersionInfoApi: set at pre-compile, default-value=false  # Adds / removes the service CorTst_GetVersionInfo() from the code.
    container CorTstDemEventParameterRefs [0..1]  # Container for the references to DemEventParameter elements which shall be invoked using the API Dem_ReportErrorStatus in case the corresponding error occurs. The EventId is taken from the referenced DemEventParameter's DemEventId value. The standardized errors are provided in the container and can be extended by vendor specific error references.
      symbolic name reference CORTST_E_CORE_FAILURE [0..1]: set at pre-compile, destination=DemEventParameter  # Reference to the DemEventParameter which shall be issued when the error "CORE failure" has occured.
    container CorTstForegroundConfigSet [1..*]  # Multiple Configuration Set Container , defines foreground mode.
      integer CorTstTestIdFgnd: 0..4294967295, set at pre-compile  # This is the Id of this specific foreground test configuration. The value shall be used in the call to the API CorTst_Start(CorTst_TestIdFgndType TestId).
      container CorTstSelect  # This container specifies configuration parameters to select individual tests for foreground mode and background mode. The availability is hardware and implementation specific.
        boolean CorTstAddress: set at link in variant link-time / pre-compile in variant pre-compile, default-value=false  # Enable/Disables core address test.
        boolean CorTstAlu: set at link in variant link-time / pre-compile in variant pre-compile, default-value=false  # Enable/Disables core ALU test.
        boolean CorTstCache: set at link in variant link-time / pre-compile in variant pre-compile, default-value=false  # Enable/Disables core cache test.
        boolean CorTstInterrupt: set at link in variant link-time / pre-compile in variant pre-compile, default-value=false  # Enable/Disables core interrupt test
        boolean CorTstMemoryIf: set at link in variant link-time / pre-compile in variant pre-compile, default-value=false  # Enable/Disables core memory interface test
        boolean CorTstMpu: set at link in variant link-time / pre-compile in variant pre-compile, default-value=false  # Enable/Disables core MPU test
        boolean CorTstRegister: set at link in variant link-time / pre-compile in variant pre-compile, default-value=false  # Enable/Disables core register test
    container CorTstGeneral
      boolean CorTstDevErrorDetect: set at pre-compile, default-value=false  # Switch for enabling the development error detection.
      integer CorTstFgndTestNumber: 1..4294967295, set at pre-compile  # This parameter holds the number of test configurations available for the foreground tests as defined in this configuration.
      boolean CorTstNotificationSupported: set at pre-compile, default-value=true  # Switch to indicate that the notification is supported.
      integer CorTstTestIntervalIdEndValue [0..1]: 0..4294967295, set at pre-compile  # Defines the end value of the Test Interval Id.
      boolean CorTstTestResultMode: set at pre-compile, default-value=false  # Switch for enabling test result comparison within the Core test driver. In this mode a core test result OK or NOTOK shall not be calculated from the core test driver. Within core test driver no comparison against the reference value is processed.
  module definition Crc [0..1]: variants pre-compile  # Configuration of the Crc (Crc routines) module.
    container CrcGeneral  # General configuration of CRC module
      enumeration Crc16Mode [0..1]: {CRC_16_HARDWARE, CRC_16_RUNTIME, CRC_16_TABLE}, set at pre-compile  # Switch to select one of the available CRC 16-bit (CCITT) calculation methods
      enumeration Crc32Mode [0..1]: {CRC_32_HARDWARE, CRC_32_RUNTIME, CRC_32_TABLE}, set at pre-compile  # Switch to select one of the available CRC 32-bit (IEEE-802.3 CRC32 Ethernet Standard) calculation methods
      enumeration Crc8H2FMode [0..1]: {CRC_8H2F_HARDWARE, CRC_8H2F_RUNTIME, CRC_8H2F_TABLE}, set at pre-compile  # Switch to select one of the available CRC 8-bit (2Fh polynomial) calculation methods
      enumeration Crc8Mode [0..1]: {CRC_8_HARDWARE, CRC_8_RUNTIME, CRC_8_TABLE}, set at pre-compile  # Switch to select one of the available CRC 8-bit (SAE J1850) calculation methods
  module definition Csm [0..1]: variants pre-compile  # Configuration of the Csm (CryptoServiceManager) module.
    container CsmAsymDecrypt [0..1]  # Container for incorporation of AsymDecrypt primitives.
      integer CsmAsymDecryptMaxKeySize: 1..4294967295, set at pre-compile  # The maximum, in bytes, of all key lengths used in all CRY primitives which implement an asymmetrical decryption.
      container CsmAsymDecryptConfig [0..32]  # Container for configuration of service AsymDecrypt. The container name serves as a symbolic name for the identifier of a service configuration.
        string CsmAsymDecryptInitConfiguration: set at pre-compile  # Name of a C symbol which contains the configuration of the underlying cryptographic primitive.
        string CsmAsymDecryptPrimitiveName: set at pre-compile  # Name of the cryptographic primitive to use.
        function name CsmCallbackAsymDecrypt: set at pre-compile  # Callback function to be called if service has finished.
    container CsmAsymEncrypt [0..1]  # Container for incorporation of AsymEncrypt primitives.
      integer CsmAsymEncryptMaxKeySize: 1..4294967295, set at pre-compile  # The maximum, in bytes, of all key lengths used in all CRY primitives which implement an asymmetrical encryption.
      container CsmAsymEncryptConfig [0..32]  # Container for configuration of service AsymEncrypt. The container name serves as a symbolic name for the identifier of a service configuration.
        string CsmAsymEncryptInitConfiguration: set at pre-compile  # Name of a C symbol which contains the configuration of the underlying cryptographic primitive.
        string CsmAsymEncryptPrimitiveName: set at pre-compile  # Name of the cryptographic primitive to use.
        function name CsmCallbackAsymEncrypt: set at pre-compile  # Callback function to be called if service has finished.
    container CsmAsymPrivateKeyExtract [0..1]  # Container for incorporation of AsymPrivateKeyExtract primitives.
      integer CsmAsymPrivateKeyExtractMaxKeySize: 1..4294967295, set at pre-compile  # The maximum, in bytes, of all key lengths used in all CRY primitives which implement an asymmetrical private key extraction.
      container CsmAsymPrivateKeyExtractConfig [0..32]  # Container for configuration of service AsymPrivateKeyExtract. | The container name serves as a symbolic name for the identifier of a service configuration.
        string CsmAsymPrivateKeyExtractInitConfiguration: set at pre-compile  # Name of a C symbol which contains the configuration of the underlying cryptographic primitive.
        string CsmAsymPrivateKeyExtractPrimitiveName: set at pre-compile  # Name of the cryptographic primitive to use.
        function name CsmCallbackAsymPrivateKeyExtract: set at pre-compile  # Callback function to be called if service has finished.
    container CsmAsymPrivateKeyWrapAsym [0..1]  # Container for incorporation of AsymPrivateKeyWrapSym primitives.
      integer CsmAsymPrivateKeyWrapAsymMaxPrivKeySize: 1..4294967295, set at pre-compile  # The maximum length, in bytes, of all private key types used in all CRY primitives which implement an asymmetrical private key wrapping.
      integer CsmAsymPrivateKeyWrapAsymMaxPubKeySize: 1..4294967295, set at pre-compile  # The maximum length, in bytes, of all public key types used in all CRY primitives which implement an asymmetrical private key wrapping.
      container CsmAsymPrivateKeyWrapAsymConfig [0..32]  # Container for configuration of service SymKeyWrapAsym. The container name serves as a symbolic name for the identifier of a service configuration.
        string CsmAsymPrivateKeyWrapAsymInitConfiguration: set at pre-compile  # Name of a C symbol which contains the configuration of the underlying cryptographic primitive.
        string CsmAsymPrivateKeyWrapAsymPrimitiveName: set at pre-compile  # Name of the cryptographic primitive to use.
        function name CsmCallbackAsymPrivateKeyWrapAsym: set at pre-compile  # Callback function to be called if service has finished.
    container CsmAsymPrivateKeyWrapSym [0..1]  # Container for incorporation of AsymPrivateKeyWrapSym primitives.
      integer CsmAsymPrivateKeyWrapSymMaxPrivKeySize: 1..4294967295, set at pre-compile  # The maximum length, in bytes, of all private information types used in all CRY primitives which implement an asymetric private key wrapping.
      integer CsmAsymPrivateKeyWrapSymMaxSymKeySize: 1..4294967295, set at pre-compile  # The maximum, in bytes, of all key lengths used in all CRY primitives which implement an asymetrical private key wrapping.
      container CsmAsymPrivateKeyWrapSymConfig [0..32]  # Container for configuration of service AsymPrivateKeyWrapSym. The container name serves as a symbolic name for the identifier of a service configuration.
        string CsmAsymPrivateKeyWrapSymInitConfiguration: set at pre-compile  # Name of a C symbol which contains the configuration of the underlying cryptographic primitive.
        string CsmAsymPrivateKeyWrapSymPrimitiveName: set at pre-compile  # Name of the cryptographic primitive to use.
        function name CsmCallbackAsymPrivateKeyWrapSym: set at pre-compile  # Callback function to be called if service has finished.
    container CsmAsymPublicKeyExtract [0..1]  # Container for incorporation of AsymPublicKeyExtract primitives.
      integer CsmAsymPublicKeyExtractMaxKeySize: 1..4294967295, set at pre-compile  # The maximum, in bytes, of all key lengths used in all CRY primitives which implement an asymmetrical public key extraction.
      container CsmAsymPublicKeyExtractConfig [0..32]  # Container for configuration of service AsymPublicKeyExtract. | The container name serves as a symbolic name for the identifier of a service configuration.
        string CsmAsymPublicKeyExtractInitConfiguration: set at pre-compile  # Name of a C symbol which contains the configuration of the underlying cryptographic primitive.
        string CsmAsymPublicKeyExtractPrimitiveName: set at pre-compile  # Name of the cryptographic primitive to use.
        function name CsmCallbackAsymPublicKeyExtract: set at pre-compile  # Callback function to be called if service has finished.
    container CsmChecksum [0..1]  # Container for incorporation of Checksum primitives.
      container CsmChecksumConfig [0..32]  # Container for configuration of service Checksum. The container name serves as a symbolic name for the identifier of a service configuration.
        function name CsmCallbackChecksum: set at pre-compile  # Callback function to be called if service has finished.
        string CsmChecksumInitConfiguration: set at pre-compile  # Name of a C symbol which contains the configuration of the underlying cryptographic primitive.
        string CsmChecksumPrimitiveName: set at pre-compile  # Name of the cryptographic primitive to use.
    container CsmDemEventParameterRefs [0..1]  # Container for the references to DemEventParameter elements which shall be invoked using the API Dem_ReportErrorStatus API in case the corresponding error occurs. The EventId is taken from the referenced DemEventParameter's DemEventId value. The standardized errors are provided in the container and can be extended by vendor specific error references.
      symbolic name reference CSM_E_INIT_FAILED [0..1]: set at pre-compile, destination=DemEventParameter  # Reference to the DemEventParameter which shall be issued when the error "Initialization of CSM module failed" has occured.
    container CsmGeneral  # Container for common configuration options.
      boolean CsmDevErrorDetect: set at pre-compile  # Pre-processor switch to enable and disable development error detection. | True: Development error detection enabled. False: Development error detection disabled
      string CsmMaxAlignScalarType: set at pre-compile  # The scalar type which has the maximum alignment restrictions on the given platform. | This type can be e.g. uint8, uint16 or uint32.
      integer CsmMaximumBlockingTime: 1..4294967295, set at pre-compile  # If interruption is turned on with the configuration option CsmUseInterruption, this option configures the maximum time in microseconds the main function shall be allowed to run before it must interrupt itself. The lowest allowed value for the option is implementation dependent.
      boolean CsmUseInterruption: set at pre-compile  # Pre-processor switch to enable and disable interruption of job processing. | True: Interruption of job processing enabled False: Interruption of job processing disabled
      boolean CsmUseSyncJobProcessing: set at pre-compile  # Pre-processor switch to enable and disable synchronous job processing. | True: synchronous job processing enabled False: synchronous job processing disabled
      boolean CsmVersionInfoApi: set at pre-compile  # Pre-processor switch to enable and disable availability of the API Csm_GetVersionInfo(). True: API Csm_GetVersionInfo() is available. False: API Csm_GetVersionInfo() is not available.
    container CsmHash [0..1]  # Container for incorporation of Hash primitives.
      container CsmHashConfig [0..32]  # Configurations for the Hash service. The container name serves as a symbolic name for the identifier of a service configuration.
        function name CsmCallbackHash: set at pre-compile  # Callback function to be called if service has finished.
        string CsmHashInitConfiguration: set at pre-compile  # Name of a C symbol which contains the configuration of the underlying cryptographic primitive.
        string CsmHashPrimitiveName: set at pre-compile  # Name of the cryptographic primitive to use.
    container CsmKeyDerive [0..1]  # Container for incorporation of KeyDerive primitives.
      integer CsmKeyDeriveMaxKeySize: 1..4294967295, set at pre-compile  # The maximum, in bytes, of all key lengths used in all CRY primitives which implement a key derivation.
      container CsmKeyDeriveConfig [0..32]  # Container for configuration of service KeyDerive. The container name serves as a symbolic name for the identifier of a service configuration.
        function name CsmCallbackKeyDerive: set at pre-compile  # Callback function to be called if service has finished.
        string CsmKeyDeriveInitConfiguration: set at pre-compile  # Name of a C symbol which contains the configuration of the underlying cryptographic primitive.
        string CsmKeyDerivePrimitiveName: set at pre-compile  # Name of the cryptographic primitive to use.
    container CsmKeyDeriveSymKey [0..1]  # Container for incorporation of CsmKeyDeriveSymKey primitives.
      integer CsmKeyDeriveSymKeyMaxSymKeySize: 1..4294967295, set at pre-compile  # The maximum, in bytes, of all key lengths used in all CRY primitives which implement a key derivation.
      container CsmKeyDeriveSymKeyConfig [0..32]  # Container for configuration of service CsmKeyDeriveSymKey. The container name serves as a symbolic name for the identifier of a service configuration.
        function name CsmCallbackKeyDeriveSymKey: set at pre-compile  # Callback function to be called if service has finished.
        string CsmKeyDeriveSymKeyInitConfiguration: set at pre-compile  # Name of a C symbol which contains the configuration of the underlying cryptographic primitive.
        string CsmKeyDeriveSymKeyPrimitiveName: set at pre-compile  # Name of the cryptographic primitive to use.
    container CsmKeyExchangeCalcPubVal [0..1]  # Container for incorporation of KeyExchangeCalcPubVal primitives.
      integer CsmKeyExchangeCalcPubValMaxBaseTypeSize: 1..4294967295, set at pre-compile  # The maximum length, in bytes, of all base types used in all CRY primitives which implement a public value calculation.
      integer CsmKeyExchangeCalcPubValMaxPrivateTypeSize: 1..4294967295, set at pre-compile  # The maximum length, in bytes, of all private information types used in all CRY primitives which implement a public value calculation.
      container CsmKeyExchangeCalcPubValConfig [0..32]  # Container for configuration of service KeyExchangeCalcPubVal. The container name serves as a symbolic name for the identifier of a service configuration.
        function name CsmCallbackKeyExchangeCalcPubVal: set at pre-compile  # Callback function to be called if service has finished.
        string CsmKeyExchangeCalcPubValInitConfiguration: set at pre-compile  # Name of a C symbol which contains the configuration of the underlying cryptographic primitive.
        string CsmKeyExchangeCalcPubValPrimitiveName: set at pre-compile  # Name of the cryptographic primitive to use.
    container CsmKeyExchangeCalcSecret [0..1]  # Container for incorporation of KeyExchangeCalcSecret primitives.
      integer CsmKeyExchangeCalcSecretMaxBaseTypeSize: 1..4294967295, set at pre-compile  # The maximum length, in bytes, of all base types used in all CRY primitives which implement a shared secret calculation.
      integer CsmKeyExchangeCalcSecretMaxPrivateTypeSize: 1..4294967295, set at pre-compile  # The maximum length, in bytes, of all private information types used in all CRY primitives which implement a shared secret calculation.
      container CsmKeyExchangeCalcSecretConfig [0..32]  # Container for configuration of service KeyExchangeCalcSecret. The container name serves as a symbolic name for the identifier of a service configuration.
        function name CsmCallbackKeyExchangeCalcSecret: set at pre-compile  # Callback function to be called if service has finished.
        string CsmKeyExchangeCalcSecretInitConfiguration: set at pre-compile  # Name of a C symbol which contains the configuration of the underlying cryptographic primitive.
        string CsmKeyExchangeCalcSecretPrimitiveName: set at pre-compile  # Name of the cryptographic primitive to use.
    container CsmKeyExchangeCalcSymKey [0..1]  # Container for incorporation of KeyExchangeCalcSymKey primitives.
      integer CsmKeyExchangeCalcSymKeyMaxBaseTypeSize: 1..4294967295, set at pre-compile  # The maximum length, in bytes, of all base types used in all CRY primitives which implement a symmetrical key calculation.
      integer CsmKeyExchangeCalcSymKeyMaxPrivateTypeSize: 1..4294967295, set at pre-compile  # The maximum length, in bytes, of all private information types used in all CRY primitives which implement a symmetrical key calculation.
      integer CsmKeyExchangeCalcSymKeyMaxSymKeySize: 1..4294967295, set at pre-compile  # The maximum, in bytes, of all key lengths used in all CRY primitives which implement a symmetrical key calculation.
      container CsmKeyExchangeCalcSymKeyConfig [0..32]  # Container for configuration of service KeyExchangeCalcSymKey. The container name serves as a symbolic name for the identifier of a service configuration.
        function name CsmCallbackKeyExchangeCalcSymKey: set at pre-compile  # Callback function to be called if service has finished.
        string CsmKeyExchangeCalcSymKeyInitConfiguration: set at pre-compile  # Name of a C symbol which contains the configuration of the underlying cryptographic primitive.
        string CsmKeyExchangeCalcSymKeyPrimitiveName: set at pre-compile  # Name of the cryptographic primitive to use.
    container CsmMacGenerate [0..1]  # Container for incorporation of MacGenerate primitives.
      integer CsmMacGenerateMaxKeySize: 1..4294967295, set at pre-compile  # The maximum, in bytes, of all key lengths used in all CRY primitives which implement a MAC generation.
      container CsmMacGenerateConfig [0..32]  # Configurations for the MacGenerate service. The container name serves as a symbolic name for the identifier of a service configuration.
        function name CsmCallbackMacGenerate: set at pre-compile  # Callback function to be called if service has finished.
        string CsmMacGenerateInitConfiguration: set at pre-compile  # Name of a C symbol which contains the configuration of the underlying cryptographic primitive.
        string CsmMacGeneratePrimitiveName: set at pre-compile  # Name of the cryptographic primitive to use.
    container CsmMacVerify [0..1]  # Container for incorporation of MacVerify primitives.
      integer CsmMacVerifyMaxKeySize: 1..4294967295, set at pre-compile  # The maximum, in bytes, of all key lengths used in all CRY primitives which implement a MAC verification.
      container CsmMacVerifyConfig [0..32]  # Container for configuration of service MacVerify. The container name serves as a symbolic name for the identifier of a service configuration.
        function name CsmCallbackMacVerify: set at pre-compile  # Callback function to be called if service has finished.
        string CsmMacVerifyInitConfiguration: set at pre-compile  # Name of a C symbol which contains the configuration of the underlying cryptographic primitive.
        string CsmMacVerifyPrimitiveName: set at pre-compile  # Name of the cryptographic primitive to use.
    container CsmRandomGenerate [0..1]  # Container for incorporation of RandomGenerate primitives.
      container CsmRandomGenerateConfig [0..32]  # Container for configuration of service RandomGenerate. The container name serves as a symbolic name for the identifier of a service configuration.
        function name CsmCallbackRandomGenerate: set at pre-compile  # Callback function to be called if service has finished.
        string CsmRandomGenerateInitConfiguration: set at pre-compile  # Name of a C symbol which contains the configuration of the underlying cryptographic primitive.
        string CsmRandomGeneratePrimitiveName: set at pre-compile  # Name of the cryptographic primitive to use.
    container CsmRandomSeed [0..1]  # Container for incorporation of RandomSeed primitives.
      container CsmRandomSeedConfig [0..32]  # Container for configuration of service RandomSeed. The container name serves as a symbolic name for the identifier of a service configuration.
        function name CsmCallbackRandomSeed: set at pre-compile  # Callback function to be called if service has finished.
        string CsmRandomSeedInitConfiguration: set at pre-compile  # Name of a C symbol which contains the configuration of the underlying cryptographic primitive.
        string CsmRandomSeedPrimitiveName: set at pre-compile  # Name of the cryptographic primitive to use.
    container CsmSignatureGenerate [0..1]  # Container for incorporation of SignatureGenerate primitives
      integer CsmSignatureGenerateMaxKeySize: 1..4294967295, set at pre-compile  # The maximum, in bytes, of all key lengths used in all CRY primitives which implement a signature generation.
      container CsmSignatureGenerateConfig [0..32]  # Container for configuration of service SignatureGenerate. The container name serves as a symbolic name for the identifier of a service configuration.
        function name CsmCallbackSignatureGenerate: set at pre-compile  # Callback function to be called if service has finished.
        string CsmSignatureGenerateInitConfiguration: set at pre-compile  # Name of a C symbol which contains the configuration of the underlying cryptographic primitive.
        string CsmSignatureGeneratePrimitiveName: set at pre-compile  # Name of the cryptographic primitive to use.
    container CsmSignatureVerify [0..1]  # Container for incorporation of SignatureVerify primitives.
      integer CsmSignatureVerifyMaxKeySize: 1..4294967295, set at pre-compile  # The maximum, in bytes, of all key lengths used in all CRY primitives which implement a signature verification.
      container CsmSignatureVerifyConfig [0..32]  # Container for configuration of service SignatureVerify. The container name serves as a symbolic name for the identifier of a service configuration.
        function name CsmCallbackSignatureVerify: set at pre-compile  # Callback function to be called if service has finished.
        string CsmSignatureVerifyInitConfiguration: set at pre-compile  # Name of a C symbol which contains the configuration of the underlying cryptographic primitive.
        string CsmSignatureVerifyPrimitiveName: set at pre-compile  # Name of the cryptographic primitive to use.
    container CsmSymBlockDecrypt [0..1]  # Container for incorporation of SymBlockDecrypt primitives.
      integer CsmSymBlockDecryptMaxKeySize: 1..4294967295, set at pre-compile  # The maximum, in bytes, of all key lengths used in all CRY primitives which implement a symmetrical block decryption.
      container CsmSymBlockDecryptConfig [0..32]  # Container for configuration of service SymBlockDecrypt. The container name serves as a symbolic name for the identifier of a service configuration.
        function name CsmCallbackSymBlockDecrypt: set at pre-compile  # Callback function to be called if service has finished.
        string CsmSymBlockDecryptInitConfiguration: set at pre-compile  # Name of a C symbol which contains the configuration of the underlying cryptographic primitive.
        string CsmSymBlockDecryptPrimitiveName: set at pre-compile  # Name of the cryptographic primitive to use.
    container CsmSymBlockEncrypt [0..1]  # Container for incorporation of SymBlockEncrypt primitives.
      integer CsmSymBlockEncryptMaxKeySize: 1..4294967295, set at pre-compile  # The maximum, in bytes, of all key lengths used in all CRY primitives which implement a symmetrical block encryption.
      container CsmSymBlockEncryptConfig [0..32]  # Container for configuration of service SymBlockEncrypt. The container name serves as a symbolic name for the identifier of a service configuration.
        function name CsmCallbackSymBlockEncrypt: set at pre-compile  # Callback function to be called if service has finished.
        string CsmSymBlockEncryptInitConfiguration: set at pre-compile  # Name of a C symbol which contains the configuration of the underlying cryptographic primitive.
        string CsmSymBlockEncryptPrimitiveName: set at pre-compile  # Name of the cryptographic primitive to use.
    container CsmSymDecrypt [0..1]  # Container for incorporation of SymDecrypt primitives
      integer CsmSymDecryptMaxKeySize: 1..4294967295, set at pre-compile  # The maximum, in bytes, of all key lengths used in all CRY primitives which implement a symmetrical decryption.
      container CsmSymDecryptConfig [0..32]  # Container for configuration of service SymDecrypt. | The container name serves as a symbolic name for the identifier of a service configuration.
        function name CsmCallbackSymDecrypt: set at pre-compile  # Callback function to be called if service has finished.
        string CsmSymDecryptInitConfiguration: set at pre-compile  # Name of a C symbol which contains the configuration of the underlying cryptographic primitive.
        string CsmSymDecryptPrimitiveName: set at pre-compile  # Name of the cryptographic primitive to use.
    container CsmSymEncrypt [0..1]  # Container for incorporation of SymEncrypt primitives.
      integer CsmSymEncryptMaxKeySize: 1..4294967295, set at pre-compile  # The maximum, in bytes, of all key lengths used in all CRY primitives which implement a symmetrical encryption.
      container CsmSymEncryptConfig [0..32]  # Container for configuration of service SymEncrypt. The container name serves as a symbolic name for the identifier of a service configuration.
        function name CsmCallbackSymEncrypt: set at pre-compile  # Callback function to be called if service has finished.
        string CsmSymBlockEncryptInitConfiguration: set at pre-compile  # Name of a C symbol which contains the configuration of the underlying cryptographic primitive.
        string CsmSymEncryptPrimitiveName: set at pre-compile  # Name of the cryptographic primitive to use.
    container CsmSymKeyExtract [0..1]  # Container for incorporation of SymKeyExtract primitives.
      integer CsmSymKeyExtractMaxKeySize: 1..4294967295, set at pre-compile  # The maximum, in bytes, of all key lengths used in all CRY primitives which implement a symmetrical key extraction.
      container CsmSymKeyExtractConfig [0..32]  # Container for configuration of service SymKeyExtract. The container name serves as a symbolic name for the identifier of a service configuration.
        function name CsmCallbackSymKeyExtract: set at pre-compile  # Callback function to be called if service has finished.
        string CsmSymKeyExtractInitConfiguration: set at pre-compile  # Name of a C symbol which contains the configuration of the underlying cryptographic primitive.
        string CsmSymKeyExtractPrimitiveName: set at pre-compile  # Name of the cryptographic primitive to use.
    container CsmSymKeyWrapAsym [0..1]  # Container for incorporation of SymKeyWrapSym primitives.
      integer CsmSymKeyWrapAsymMaxPubKeySize: 1..4294967295, set at pre-compile  # The maximum length, in bytes, of all public key types used in all CRY primitives which implement an asymmetrical key wrapping.
      integer CsmSymKeyWrapAsymMaxSymKeySize: 1..4294967295, set at pre-compile  # The maximum, in bytes, of all key lengths used in all CRY primitives which implement an asymmetrical key wrapping.
      container CsmSymKeyWrapAsymConfig [0..32]  # Container for configuration of service SymKeyWrapAsym. The container name serves as a symbolic name for the identifier of a service configuration.
        function name CsmCallbackSymKeyWrapAsym: set at pre-compile  # Callback function to be called if service has finished.
        string CsmSymKeyWrapAsymInitConfiguration: set at pre-compile  # Name of a C symbol which contains the configuration of the underlying cryptographic primitive.
        string CsmSymKeyWrapAsymPrimitiveName: set at pre-compile  # Name of the cryptographic primitive to use.
    container CsmSymKeyWrapSym [0..1]  # Container for incorporation of SymKeyWrapSym primitives.
      integer CsmSymKeyWrapSymMaxSymKeySize: 1..4294967295, set at pre-compile  # The maximum, in bytes, of all key lengths used in all CRY primitives which implement an symmetrical key wrapping.
      container CsmSymKeyWrapSymConfig [0..32]  # Container for configuration of service SymKeyWrapSym. The container name serves as a symbolic name for the identifier of a service configuration.
        function name CsmCallbackSymKeyWrapSym: set at pre-compile  # Callback function to be called if service has finished.
        string CsmSymKeyWrapSymInitConfiguration: set at pre-compile  # Name of a C symbol which contains the configuration of the underlying cryptographic primitive.
        string CsmSymKeyWrapSymPrimitiveName: set at pre-compile  # Name of the cryptographic primitive to use.
  module definition Dbg [0..1]: variants post-build/pre-compile  # Configuration of the debugging module.
    container DbgBuffering [0..1]  # This container holds the parameters to manage the storage of debugging data in RAM.
      integer DbgBufferSize: 0..65535, set at pre-compile  # Size in bytes of the RAM for the ring buffer. A size of 0 means that no buffer exists. All data records are directly transferred.
      enumeration DbgBufferStrategy: {OverwriteOldestEntries, StopStorage}, set at pre-compile, default-value=StopStorage  # Strategy of buffer operations when it is full: overwrite oldest entries or stop the storage.
      enumeration DbgBufferTransmission: {StartAfterInitialization, StartOnHostRequest}, set at pre-compile, default-value=StartOnHostRequest  # Automatic or requested transmission of the buffer.
    container DbgCommunication [0..1]  # This container holds all configuration parameters for communication.
      container DbgRxPdu  # This container holds configuration parameters for the receive-pdu.
        integer DbgRxPduId: 0..65535, set at published-information, symbolic-name-value=true, default-value=0  # Handle Id to be used by the PduR to indicate the reception of the DbgRxPdu to the Dbg module. The actual value of this parameter is fixed to 0 since there is only one RxPdu for the Dbg module. | The existence of this parameter is essential for the PduR generation tool to actually find a symbolicNameValue for the RxPdu.
        reference DbgReceiveIPduRef: set at pre-compile, destination=Pdu  # Reference to the receive I-PDU.
      container DbgTxPdu  # This container holds configuration parameters for the transmit-pdu.
        integer DbgTxConfirmationPduId: 0..65535, set at published-information, symbolic-name-value=true, default-value=0  # Handle Id to be used by the PduR to confirm the transmission of the DbgTxPdu to the Dbg module. The actual value of this parameter is fixed to 0 since there is only one TxPdu for the Dbg module. | The existence of this parameter is essential for the PduR generation tool to actually find a symbolicNameValue for the TxPdu.
        reference DbgSendIPduRef: set at pre-compile, destination=Pdu  # Reference to the send I-PDU.
    container DbgGeneral  # This container holds the general parameters of the debugging module.
      boolean DbgDevErrorDetect: set at pre-compile  # Enables/Disables development error detection.
      string DbgHeaderFileInclusion [0..*]: set at pre-compile, regular-expression=[a-zA-Z0-9_]([a-zA-Z0-9\._])*  # Name of the header file(s) to be included by the Dbg module.
      boolean DbgVersionInfoApi: set at pre-compile  # Activate/Deactivate the version information API (Dbg_GetVersionInfo). True: version information API activated False: version information API deactivated.
    container DbgMultipleConfigurationContainer: multiple-configuration-container=true
      integer DbgMaxDynamicDID [0..1]: 0..200, set at post-build in variant post-build / pre-compile in variant pre-compile  # Maximum number of dynamic DIDs. This value is only needed to reserve memory for dynamic DIDs added by the host at runtime. If this parameter is not supplied it is automatically set to the configured number of static DIDs. | The sum of MaxStaticDID and MaxDynamicDID must not exceed 200. Dynamic DIDs are MaxStaticDID based and consecutive.
      integer DbgMaxStaticDID [0..1]: 0..200, set at post-build in variant post-build / pre-compile in variant pre-compile  # Maximum number of static DIDs. This value is only needed to reserve memory for static DIDs added at post-build time. If this parameter is not supplied it is automatically set to the configured number of static DIDs. Static DIDs are zero based and consecutive.
      container DbgPredefinedDID [0..16]  # This container holds all configuration parameters for predefined DIDs. For predefined DIDs, only certain values can be changed.
        boolean DbgPredefinedDIDActivation: set at post-build in variant post-build / pre-compile in variant pre-compile, default-value=false  # Activation or not of the DID for debugging. | true: DIDOn. false: DIDOff.
        boolean DbgPredefinedDIDBuffering: set at post-build in variant post-build / pre-compile in variant pre-compile, default-value=false  # Buffer the data or transmit directly. | true: BufferingOn. false: BufferingOff.
        enumeration DbgPredefinedDIDName: {Dbg_PostTaskHook, Dbg_PreTaskHook, Dbg_TraceDetCall, Dbg_TraceFunctionEntry, Dbg_TraceFunctionExit, Dbg_TraceRTECall, Dbg_TraceRTEComCallback, Dbg_TraceRTEComSignalIv, Dbg_TraceRTEComSignalRx, Dbg_TraceRTEComSignalTx, Dbg_TraceRTEVfbSignalReceive, Dbg_TraceRTEVfbSignalSend, Dbg_TraceRunnableStart, Dbg_TraceRunnableTermination, Dbg_TraceTimestamps}, set at pre-compile  # List of possible names for predefined DIDs.
        boolean DbgPredefinedDIDTimeStampActivation: set at post-build in variant post-build / pre-compile in variant pre-compile, default-value=false  # Using or not of time stamp. | true: TimeStampOn. false: TimeStampOff.
        choice container DbgPredefinedDIDAddInfo [0..*]  # Additional information in case the Predefined DID needs further configuration parameters.
          container DbgAddInfoComSignal [0..*]  # Additional information for DIDs with the DbgPredefinedDIDName set to: | - Dbg_TraceRTEComSignalTx - Dbg_TraceRTEComSignalRx - Dbg_TraceRTEComSignalIv - Dbg_TraceRTEComCallback The actual SignalId used in the debugging trace APIs is taken from the ComHandleId availabe at the ComSignal configuration of the Com module.
            string DbgComSignalName [0..1]: set at pre-compile  # Optional name of the traced signal. If present it shall be used in the display of the debugging tool.
            foreign reference DbgBswModuleEntryRef: set at pre-compile, destination-type=BSW-MODULE-ENTRY  # Foreign reference to the BSWModuleEntry describing the trace function implementation.
            reference DbgComSignalRef: set at pre-compile, destination=ComSignal  # Reference to the ComSignal which shall be traced.
          container DbgAddInfoRteCall [0..*]  # Additional information for DIDs with the DbgPredefinedDIDName set to: | - Dbg_TraceRTECall
            integer DbgCallComponentId: 0..65535, set at pre-compile  # Id used to identify the SW-Component Type.
            integer DbgCallInstanceId: 0..255, set at pre-compile  # Id used to identify the SW-Component Instance.
            integer DbgCallPortId: 0..65535, set at pre-compile  # Id used to identify the Port.
            integer DbgCallServiceId: 0..255, set at pre-compile  # Id used to identify the OperationProtoype.
            foreign reference DbgBswModuleEntryRef: set at pre-compile, destination-type=BSW-MODULE-ENTRY  # Foreign reference to the BSWModuleEntry describing the trace function implementation.
            instance reference DbgServiceInstanceRef: set at pre-compile, destination-context=SW-COMPONENT-PROTOTYPE PORT-PROTOTYPE, destination-type=CLIENT-SERVER-OPERATION  # Reference to the actual OperationPrototype which shall be traced.
          container DbgAddInfoRunnable [0..*]  # Additional information for DIDs with the DbgPredefinedDIDName set to: | - Dbg_TraceRunnableStart - Dbg_TraceRunnableTermination
            integer DbgRunnableComponentId: 0..65535, set at pre-compile  # Id used to identify the SW-Component Type.
            integer DbgRunnableId: 0..255, set at pre-compile  # Id used to identify the RunnableEntity.
            integer DbgRunnableInstanceId: 0..255, set at pre-compile  # Id used to identify the SW-Component Instance.
            foreign reference DbgBswModuleEntryRef: set at pre-compile, destination-type=BSW-MODULE-ENTRY  # Foreign reference to the BSWModuleEntry describing the trace function implementation.
            foreign reference DbgRunnableEntityRef: set at pre-compile, destination-type=RUNNABLE-ENTITY  # Reference to the actual RunnableEntity which shall be traced.
            foreign reference DbgSoftwareComponentInstanceRef: set at pre-compile, destination-type=SW-COMPONENT-PROTOTYPE  # Reference to the SW-ComponentProtoype which shall be traced.
          container DbgAddInfoVfbSignal [0..*]  # Additional information for DIDs with the DbgPredefinedDIDName set to: | - Dbg_TraceRTEVfbSignalSend - Dbg_TraceRTEVfbSignalReceive
            integer DbgVfbComponentId: 0..65535, set at pre-compile  # Id used to identify the SW-Component Type.
            integer DbgVfbDataElementId: 0..255, set at pre-compile  # Id used to identify the DataElementPrototype.
            integer DbgVfbInstanceId: 0..255, set at pre-compile  # Id used to identify the SW-Component Instance.
            integer DbgVfbPortId: 0..65535, set at pre-compile  # Id used to identify the Port.
            foreign reference DbgBswModuleEntryRef: set at pre-compile, destination-type=BSW-MODULE-ENTRY  # Foreign reference to the BSWModuleEntry describing the trace function implementation.
            instance reference DbgDataElementInstanceRef: set at pre-compile, destination-context=SW-COMPONENT-PROTOTYPE PORT-PROTOTYPE, destination-type=VARIABLE-DATA-PROTOTYPE  # Reference to the actual DataElementPrototype which shall be traced.
      container DbgStaticDID [0..200]  # This container holds all configuration parameters for static DIDs. For predefined DIDs, only certain values can be changed.
        integer DbgAutomaticCollectionFrequency: 0..65535, set at post-build in variant post-build / pre-compile in variant pre-compile, default-value=0  # Cycle time of collection in DataCollectionTicks. A value of "0" indicates that the collection takes place only on request.
        boolean DbgStaticDIDActivation: set at post-build in variant post-build / pre-compile in variant pre-compile, default-value=false  # Activation or not of the DID for debugging. | true: DIDOn. false: DIDOff.
        boolean DbgStaticDIDBuffering: set at post-build in variant post-build / pre-compile in variant pre-compile, default-value=false  # Buffer the data or transmit directly. | true: BufferingOn. false: BufferingOff.
        string DbgStaticDIDNameRef: set at post-build in variant post-build / pre-compile in variant pre-compile  # Name of the DID, translated by the configuration/generation tool into consecutive DID numbers starting from 0.
        boolean DbgStaticTimeStampActivation: set at post-build in variant post-build / pre-compile in variant pre-compile, default-value=false  # Using or not of time stamp. | true: TimeStampOn. false: TimeStampOff.
        choice container DbgStaticDIDData [1..65535]  # Choice how the DID is to be configured.
          container DbgAddressSizePair [0..1]  # This container describes address/size pairs. It is used for static DIDs and dynamic DIDs.
            integer DbgASAbsoluteAddress [0..1]: 0..4294967295, set at pre-compile  # Absolute address of memory location to be debugged. | max = (2**32)-1
            linker symbol DbgASNameRef [0..1]: set at pre-compile  # Symbolic name of the variable, translated by the configuration/generation tool into the address and size of the variable.
            integer DbgASSize [0..1]: 0..255, set at pre-compile  # Absolute size in Bytes of memory location to be debugged.
          container DbgDebugData [0..1]  # Reference to staticMemory used for Debug Data.
            foreign reference DbgDebugDataRef: set at pre-compile, destination-type=VARIABLE-DATA-PROTOTYPE  # Reference to staticMemory used for Debug Data.
          container DbgLocalDebugData [0..1]  # Reference to a localDebugData.
            foreign reference DbgLocalDebugDataRef: set at pre-compile, destination-type=IMPLEMENTATION-DATA-TYPE-ELEMENT  # Reference to a localDebugData.
    container DbgPeriodicDataCollection [0..1]  # This container holds the parameters to manage the time base of the debugging module.
      integer DbgDataCollectionTick: 0..4294967295, set at pre-compile  # Number of OS counter ticks to be used as data collection tick. The OS alarm used for periodic collection of DIDs is set with this value.
      reference DbgAlarmReference: set at pre-compile, destination=OsAlarm  # Reference to the OS alarm used for periodic collection of DIDs.
    container DbgTimestampConfiguration [0..1]  # This container holds the parameters to manage the time stamps of the debugging module.
      enumeration DbgGlobalTimestampActivation: {TimestampOff, TimestampOn}, set at pre-compile, default-value=TimestampOff  # Initial value for timestamp collection.
      enumeration DbgTimeStampSize: {TimeStampSize_16Bit, TimeStampSize_32Bit}, set at pre-compile, default-value=TimeStampSize_16Bit  # Memory size used for the time stamps of all DIDs.
      symbolic name reference DbgGptChannel: set at pre-compile, destination=GptChannelConfiguration  # Reference to the hardware free running timer of the GPT module for time stamps (if no HWFRT is applied, calls to add timestamps are ignored)
  module definition Dcm [0..1]: variants link-time/post-build/pre-compile  # Configuration of the Dcm (Diagnostic Communications Manager) module.
    container DcmConfigSet: multiple-configuration-container=true  # This container contains the configuration parameters and sub containers of the DCM module supporting multiple configuration sets. | This container is a MultipleConfigurationContainer, i.e. this container and its sub-containers exist once per configuration set.
      container DcmDsd  # These parameters apply to Diagnostic Service Dispatcher. All parameters for all service dispatchers are included in this one configuration container. | There must always be one service dispatcher in a DCM.
        container DcmDsdServiceTable [1..256]  # This container contains the configuration (DSD parameters) for Service Identifier Table.
          integer DcmDsdSidTabId: 0..255, set at link in variant link-time / pre-compile in variant post-build+pre-compile  # Due the fact of using one or more service tables the member of the Service Identifier Table includes a unique id for the Service Identifier Table.
          container DcmDsdService [1..*]  # This container contains the configuration (DSD parameters) for Service.
            function name DcmDsdSidTabFnc [0..1]: set at link in variant link-time / pre-compile in variant post-build+pre-compile  # Callback function of the ECU Supplier specific component for the particular DcmDsdSidTabServiceId. | This parameter is related to the interface <Module>_<DiagnosticService>. If it is not configured the service is handled Dcm-internally.
            integer DcmDsdSidTabServiceId: 0..255, set at link in variant link-time / pre-compile in variant post-build+pre-compile  # Id of the Service identifier. | The possible Service identifier are predefined in the ISO 14229-1 and ISO 15031-5 and in Table 4 and Table 5.
            boolean DcmDsdSidTabSubfuncAvail: set at link in variant link-time / pre-compile in variant post-build+pre-compile  # Information whether the DcmDsdSidTabServiceId includes Sub functions or not. Used for the Handling of "suppressPosRspMsgIndicationBit" ISO14229-1 can be referenced here, as this specification gives fix definition, if an SID includes Subfunction or not. | true = sub-function available false = sub-function not available
            reference DcmDsdSidTabModeRuleRef [0..1]: set at link in variant link-time / pre-compile in variant post-build+pre-compile, destination=DcmModeRule  # Reference to DcmDspModeRule | Mode rule which controls the execution of the DcmDsdService. If there is no reference, no check of the mode rule shall be done.
            reference DcmDsdSidTabSecurityLevelRef [0..*]: set at link in variant link-time / pre-compile in variant post-build+pre-compile, origin=AUTOSAR_ECUC V1.0.0, destination=DcmDspSecurityRow  # Link to the Security Access Levels needed for execution of the DcmDsdService. | Please refer to the ISO 14229-1, ISO 15031-5 and "Verification of the Security Access levels". Please note, that it shall be provided to configure several DcmDsdSidTabSecurityLevelRef per DcmDsdService. If there is no reference, no check of security level shall be done.
            reference DcmDsdSidTabSessionLevelRef [0..*]: set at link in variant link-time / pre-compile in variant post-build+pre-compile, origin=AUTOSAR_ECUC V1.0.0, destination=DcmDspSessionRow  # Link to the Session Control needed for execution of the DcmDsdService. Please refer to the ISO 14229-1, ISO 15031-5 and "Verification of the Diagnostic Session". Please note, that it shall be provided to configure several DcmDsdSidTabSessionLevelRef per DcmDsdService. If there is no reference, no check of session level shall be done.
            container DcmDsdSubService [0..*]  # This container contains the configuration (DSD parameters) for SubServices. This configuration is available only for services having Subfunction: this container exists only if parameter DcmDsdSidTabSubfuncAvail, of this service, is set to TRUE and the parameter DcmDsdSidTabFnc is not existing.
              function name DcmDsdSubServiceFnc [0..1]: set at link in variant link-time / pre-compile in variant post-build+pre-compile  # Callback function of the ECU Supplier specific component. This parameter is related to the interface <Module>_<DiagnosticService>_<SubService>. | If it is not configured the sub-service is handled Dcm-internally.
              integer DcmDsdSubServiceId: 0..255, set at link in variant link-time / pre-compile in variant post-build+pre-compile  # Id of the SubService identifier. The possible Subfunction parameter value are predefined in the ISO 14229-1 and ISO 15031-5.
              reference DcmDsdSubServiceModeRuleRef [0..1]: set at link in variant link-time / pre-compile in variant post-build+pre-compile, destination=DcmModeRule  # Reference to DcmDspModeRule | Mode rule which controls execution of this the DcmDsdSubService. If there is no reference, no check of the mode rule shall be done.
              reference DcmDsdSubServiceSecurityLevelRef [0..*]: set at link in variant link-time / pre-compile in variant post-build+pre-compile, destination=DcmDspSecurityRow  # Link to the Security Level needed for execution of the DcmDsdSubService. | Please refer to the ISO 14229-1, ISO 15031-5 and "Verification of the Diagnostic Session". Please note, that it shall be provided to configure several DcmDsdSubServiceSecurityLevelRef per DcmDsdSubService. If there is no reference, no check of security level shall be done.
              reference DcmDsdSubServiceSessionLevelRef [0..*]: set at link in variant link-time / pre-compile in variant post-build+pre-compile, destination=DcmDspSessionRow  # Link to the Session Control needed for execution of the DcmDsdSubService. | Please refer to the ISO 14229-1, ISO 15031-5 and "Verification of the Diagnostic Session". Please note, that it shall be provided to configure several DcmDsdSubServiceSessionLevelRef per DcmDsdSubService. If there is no reference, no check of session level shall be done.
      container DcmDsl  # These parameters apply to a Diagnostic Session Layer. There may be a parameter set (DSL Configuration) per protocol. | upperMultiplicity: Each DCM configuration must have exactly one DSL configuration. lowerMultiplicity: Each DCM configuration must have exactly one DSL configuration.
        container DcmDslBuffer [1..256]  # This container contains the configuration (parameters) for the diagnostic buffer.
          integer DcmDslBufferSize: 8..4294967294, set at pre-compile  # Size of Diagnostic Buffer (in Bytes) | For a linear buffer: size of the buffer shall be as large as the longest message (request or response) For a paged buffer (only Tx possible): size has impacts on the application performance Please note: max. range is the valid range for a CAN network. We assume a FlexRay (or other networks) implementation will work with this range (and the page buffer mechanism) without any problems.
        container DcmDslCallbackDCMRequestService [1..*]  # The name of this container is used to define the name of the R-Port through which the DCM access the interface CallbackDCMRequestServices. | The R-Port is named CallbackDCMRequestServices_<SWC> where _<SWC> is the name of the container DcmDslCallbackDCMRequestService.
        container DcmDslDiagResp  # This container contains the configuration (parameters) for the ResponsePending handling
          integer DcmDslDiagRespMaxNumRespPend: 0..255, set at link in variant link-time / post-build in variant post-build / pre-compile in variant pre-compile, origin=AUTOSAR_ECUC V1.0.0  # Maximum number of negative responses with response code 0x78 (requestCorrectlyReceived-ResponsePending) allowed per request. DCM will send a negative response with response code 0x10 (generalReject), in case the limit value gets reached. | Value 0xFF means that no limit number of NRC 0x78 response apply.
          boolean DcmDslDiagRespOnSecondDeclinedRequest: set at link in variant link-time / post-build in variant post-build / pre-compile in variant pre-compile, origin=AUTOSAR_ECUC V1.0.0  # Defines the reaction upon a second request (ClientB) that can not be processed (e.g. due to priority assessment). | TRUE: when the second request (Client B) can not be processed, it shall be answered with NRC21 BusyRepeatRequest. FALSE: when the second request (Client B) can not be processed, it shall not be responded.
        container DcmDslProtocol  # This container contains the configuration (parameters) for the protocol configuration (for each protocol) The following parameters needs to be configured per protocol.
          container DcmDslProtocolRow [1..*]  # Definition of a single Row of configuration for the protocol configuration (for each protocol)
            boolean DcmDslProtocolEndiannessConvEnabled: set at link in variant link-time / pre-compile in variant post-build+pre-compile, origin=AUTOSAR_ECUC V1.0.0  # Enables /disables the endianness conversion, per diagnostic | protocol.
            enumeration DcmDslProtocolID: {DCM_OBD_ON_CAN, DCM_OBD_ON_FLEXRAY, DCM_OBD_ON_IP, DCM_PERIODICTRANS_ON_IP, DCM_PERIODIC_ON_CAN, DCM_PERIODIC_ON_FLEXRAY, DCM_ROE_ON_CAN, DCM_ROE_ON_FLEXRAY, DCM_ROE_ON_IP, DCM_SUPPLIER_1, DCM_SUPPLIER_10, DCM_SUPPLIER_11, DCM_SUPPLIER_12, DCM_SUPPLIER_13, DCM_SUPPLIER_14, DCM_SUPPLIER_15, DCM_SUPPLIER_2, DCM_SUPPLIER_3, DCM_SUPPLIER_4, DCM_SUPPLIER_5, DCM_SUPPLIER_6, DCM_SUPPLIER_7, DCM_SUPPLIER_8, DCM_SUPPLIER_9, DCM_UDS_ON_CAN, DCM_UDS_ON_FLEXRAY, DCM_UDS_ON_IP}, set at link in variant link-time / post-build in variant post-build / pre-compile in variant pre-compile, symbolic-name-value=true  # The diagnostic protocol type for the DCM DSL protocol that is being configured. | Implementation Type: Dcm_ProtocolType
            boolean DcmDslProtocolIsParallelExecutab: set at link in variant link-time / pre-compile in variant post-build+pre-compile, origin=AUTOSAR_ECUC V1.0.0  # Enables the parallel processing of ROE or Periodic Transmission protocol. Only these both protocols are allowed to run in parallel to normal protocol (UDS, OBD).
            float DcmDslProtocolPreemptTimeout: 0..1000, set at link in variant link-time / post-build in variant post-build / pre-compile in variant pre-compile  # This is the value for the timeout (in milliseconds) of preempting protocol until protocol needs to be started. | This is defined in the AUTOSAR SWS for DCM as a uint16. The AUTOSAR configuration standard is to use SI units, so this parameter is defined as a float value in seconds. DCM configuration tools must convert this float value to the appropriate value format for the use in the software implementation of DCM. min: A negative value is not allowed. upperMultiplicity: Exactly one DcmDslProtocolPreemptTimeout value per DSL protocol timing structure. lowerMultiplicity: Exactly one DcmDslProtocolPreemptTimeout value per DSL timing structure. origin: Standard AUTOSAR configuration parameter.
            integer DcmDslProtocolPriority: 0..255, set at link in variant link-time / post-build in variant post-build / pre-compile in variant pre-compile  # The SWS for DCM defines this item as uint8. This is the protocol priority that is used during protocol preemption handling. | 0 = Highest priority (protocol may not be preempted by other protocols) 1, 2, 3... = Reducing priority. Protocol may be preempted by other protocols with lower priority value. upperMultiplicity: Exactly one priority must be provided per Tx Protocol. lowerMultiplicity: Exactly one priority must be provided per Tx Protocol. origin: Standard AUTOSAR configuration parameter.
            enumeration DcmDslProtocolTransType [0..1]: {TYPE1, TYPE2}, set at link in variant link-time / post-build in variant post-build / pre-compile in variant pre-compile, origin=AUTOSAR_ECUC V1.0.0  # Selects the transmission type for protocol.
            boolean DcmSendRespPendOnTransToBoot: set at link in variant link-time / post-build in variant post-build / pre-compile in variant pre-compile, default-value=true  # Parameter specifying if the ECU should send a NRC 0x78 (response pending) before transitioning to the bootloader (parameter set to TRUE) or if the transition shall be initiated without sending NRC 0x78 (parameter set to FALSE).
            float DcmTimStrP2ServerAdjust: 0..1000, set at link in variant link-time / post-build in variant post-build / pre-compile in variant pre-compile  # This parameter is used to gurantee that the DCM response is available on the bus before reaching P2.This parameter value in milliseconds has to be configured as a multiple of DcmTaskTime and is minimum in the timing handling of P2. | The AUTOSAR configuration standard is to use SI units, so this parameter is defined as a float value in seconds. DCM configuration tools must convert this float value to the appropriate value format for the use in the software implementation of DCM.
            float DcmTimStrP2StarServerAdjust: 0..5000, set at link in variant link-time / post-build in variant post-build / pre-compile in variant pre-compile  # This parameter is used to gurantee that the DCM response is available on the bus before reaching P2*.This parameter value in milliseconds has to be configured as multiple of DcmTaskTime and is minimum in the timing handling of P2*. | The AUTOSAR configuration standard is to use SI units, so this parameter is defined as a float value in seconds. DCM configuration tools must convert this float value to the appropriate value format for the use in the software implementation of DCM.
            reference DcmDslProtocolRxBufferID: set at link in variant link-time / post-build in variant post-build / pre-compile in variant pre-compile, destination=DcmDslBuffer  # Link to buffer configuration (DcmDslBuffer) for configuration of protocol buffer used for Rx actions. | upperMultiplicity / lowerMultiplicity:: Exactly one Rx buffer is required for protocol reception
            reference DcmDslProtocolSIDTable: set at link in variant link-time / post-build in variant post-build / pre-compile in variant pre-compile, destination=DcmDsdServiceTable  # Link to the used diagnostic service table for this protocol. | upperMultiplicity: Must have exactly one service table for the protocol. lowerMultiplicity: Must have exactly one service table for the protocol.
            reference DcmDslProtocolSessionRef [0..1]: set at link in variant link-time / pre-compile in variant post-build+pre-compile, destination=DcmDspSession  # Reference to the DcmDspSession table used for this protocol ConfigurationClass.
            reference DcmDslProtocolTxBufferID: set at link in variant link-time / post-build in variant post-build / pre-compile in variant pre-compile, destination=DcmDslBuffer  # Link to buffer configuration (DcmDslBuffer) for configuration of protocol buffer used for Tx actions. | upperMultiplicity / lowerMultiplicity:: Exactly one Tx buffer is required for protocol transmission.
            choice container DcmDslConnection [1..*]  # This container contains links between Diagnostic Protocol (=DcmDslProtocolRow) and the according Rx or Tx channel. | Because of the usecase to allow more then one diagnostic tester (using different CAN channels) it is necessary to allow configuration of multiple DcmDslConnections.
              container DcmDslMainConnection [0..1]  # This container contains configuration for Diagnostic Main Connection | (DcmDslProtocolTx, DcmDslProtocolRx). In addition it contains links to the ROE connection (DcmDslROEConnectionRef) and the Periodic Transmission Connection (DcmDslPeriodicTranmissionConRef) relevant for protocols with DcmDslProtocolTransType = TYPE2 or TYPE1.
                integer DcmDslProtocolRxTesterSourceAddr: 0..65535, set at link in variant link-time / post-build in variant post-build / pre-compile in variant pre-compile  # Tester source address uniquely describes a client and will be used e.g. within | the jump to Bootloader interfaces.
                reference DcmDslPeriodicTranmissionConRef [0..1]: set at link in variant link-time / post-build in variant post-build / pre-compile in variant pre-compile, origin=AUTOSAR_ECUC V1.0.0, destination=DcmDslPeriodicTransmission  # Configures the link to the connection of PeriodicTransmission protocol for the processing of the PeriodicTransmission events.
                reference DcmDslROEConnectionRef [0..1]: set at link in variant link-time / post-build in variant post-build / pre-compile in variant pre-compile, origin=AUTOSAR_ECUC V1.0.0, destination=DcmDslResponseOnEvent  # Configures the link to the connection of ROE protocol for processing of the ROE events.
                container DcmDslProtocolRx [1..*]  # This container contains the configuration (parameters) for the protocol configuration of RX channel (for each protocol) | The following parameters needs to be configured per protocol. Please keep in mind, that the parameter DcmDslProtocolRxPduId can be given several times per protocol and that the combination from DcmDslProtocolRxPduId and DcmDslProtocolRxAddrType is unique. Only one physical protocol is allowed per connection. upperMultiplicity: More than one receive PDU ID may be configured for reception (e.g. one for func requests, one for phys requests). lowerMultiplicity: At least one receive PDU ID configuration must be provided per protocol.
                  enumeration DcmDslProtocolRxAddrType: {DCM_FUNCTIONAL_TYPE, DCM_PHYSICAL_TYPE}, set at link in variant link-time / post-build in variant post-build / pre-compile in variant pre-compile  # Declares the communication type of this DCM_PROTOCOL_DCMRXPDUID. | PHYSICAL is used for 1 to 1 communication FUNCTIONAL is used for 1 to n communication
                  integer DcmDslProtocolRxChannelId: 0..255, set at link in variant link-time / post-build in variant post-build / pre-compile in variant pre-compile  # Channel Identifier associated to the received Pdu.
                  integer DcmDslProtocolRxPduId: 0..65535, set at link in variant link-time / post-build in variant post-build / pre-compile in variant pre-compile, symbolic-name-value=true  # DcmRxPduId value for reception of requests.
                  reference DcmDslProtocolRxPduRef: set at link in variant link-time / post-build in variant post-build / pre-compile in variant pre-compile, destination=Pdu  # DcmRxPduId reference for reception of requests / Multiple links shall be allowed. (e.g. one DcmRxPduId to receive func requests, one DcmRxPduId to receive phys requests)
                  symbolic name reference DcmDslProtocolRxComMChannelRef: set at link in variant link-time / post-build in variant post-build / pre-compile in variant pre-compile, destination=ComMChannel  # Reference to the ComMChannel on which the DcmDslProtocolRxPdu is received.
                container DcmDslProtocolTx  # This container contains the configuration (parameters) for the protocol configuration of TX channel (for each protocol) | The included parameters needs to be configured per protocol.
                  integer DcmDslTxConfirmationPduId: 0..65535, set at link in variant link-time / post-build in variant post-build / pre-compile in variant pre-compile, symbolic-name-value=true  # Handle Id to be used by the Lower Layer to confirm the transmission of the DcmDsProtocolTxPdu to the LowerLayer.
                  reference DcmDslProtocolTxPduRef: set at link in variant link-time / post-build in variant post-build / pre-compile in variant pre-compile, destination=Pdu  # DcmTxPduId reference for transmission of responses
              container DcmDslPeriodicTransmission [0..1]  # This container contains the configuration (parameters) for Periodic Transmission service. | Hint: Periodic Transmission request comes via DcmDslMainConnection and PeriodicTransmission Event response is given via DcmDslPeriodicTransmission.
                container DcmDslPeriodicConnection [0..*]  # Holding the TxPduId configuration for PeriodicTransmission.
                  integer DcmDslPeriodicTxConfirmationPduId: 0..65535, set at link in variant link-time / post-build in variant post-build / pre-compile in variant pre-compile, symbolic-name-value=true  # Handle Id to be used by the Lower Layer to confirm the transmission of the DcmDslPeriodicTxPdu to the LowerLayer.
                  reference DcmDslPeriodicTxPduRef: set at link in variant link-time / post-build in variant post-build / pre-compile in variant pre-compile, destination=Pdu  # This is the reference to the PDU ID to be used by this DCM when sending Periodic Transmissions. It is only needed for Type2 Periodic Transmissions configurations. | upperMultiplicity: one or several DcmDslPeriodicTxPduRef can be defined if Periodic Transmission is enabled and TYPE2 Periodic Transmissions is configured. lowerMultiplicity: DcmDslPeriodicTxPduRef does not need to be defined if Periodic Transmission is not enabled or TYPE1 Periodic Transmissions is configured..
              container DcmDslResponseOnEvent [0..1]  # This container contains the configuration (parameters) for ResponseOnEvent service. | Hint: ROE service request is recept via DcmDslMainConnection and that Event response is given via DcmDslResposeOnEvent
                integer DcmDslRoeTxConfirmationPduId [0..1]: 0..65535, set at link in variant link-time / post-build in variant post-build / pre-compile in variant pre-compile, symbolic-name-value=true  # Handle Id to be used by the Lower Layer to confirm the transmission of the DcmDslRoeTxPdu to the LowerLayer.
                reference DcmDslRoeTxPduRef [0..1]: set at link in variant link-time / post-build in variant post-build / pre-compile in variant pre-compile, destination=Pdu  # Reference to the PDU for transmission of ROE response (only needed for ROE Transmission Type is TYPE2) | upperMultiplicity: One PDU required if ROE Transmission Type is TYPE2. lowerMultiplicity: No PDU required if ROE Transmission Type is TYPE1.
        container DcmDslServiceRequestManufacturerNotification [0..*]  # The name of this container is used to define the name of the R-Port through which the DCM accesses the interface ServiceRequestNotification. | The R-Port is named ServiceRequestManufacturerNotification_<SWC>; where <SWC> is the name of the container DcmDslServiceRequestManufacturerNotification. The lowerMultiplicity is 0: If DcmRequestManufacturerNotificationEnabled = false the Indication API is not available.
        container DcmDslServiceRequestSupplierNotification [0..*]  # The name of this container is used to define the name of the R-Port through which the DCM accesses the interface ServiceRequestNotification. | The R-Port is named ServiceRequestSupplierNotification_<SWC> where <SWC> is the name of the container DcmDslServiceRequestSupplierNotification. The lowerMultiplicity is 0: If DcmRequestSupplierNotification = false the Indication API is not available.
      container DcmDsp [0..1]  # These parameters apply to Diagnostic Service Processing. There will always be one set of these parameters per DCM.
        integer DcmDspMaxDidToRead [0..1]: 0..65535, set at link in variant link-time / pre-compile in variant post-build+pre-compile  # Indicates the maximum allowed DIDs in a single "ReadDataByIdentifier" request. | If set to 0, then no limitation is applied.
        integer DcmDspPowerDownTime [0..1]: 0..255, set at link in variant link-time / pre-compile in variant post-build+pre-compile  # This parameter indicates to the client the minimum time of the stand-by sequence the server will remain in the power-down sequence. | The resolution of this parameter is one second per count. The following values are valid: 00 - FE hex: 0 - 254 s powerDownTime; FF hex: indicates a failure or time not available.
        container DcmDspComControl [0..1]
          container DcmDspComControlAllChannel [0..*]  # Collection of ComM channels which shall be controlled if all networks are addressed.
            symbolic name reference DcmDspAllComMChannelRef: set at link in variant link-time / post-build in variant post-build / pre-compile in variant pre-compile, destination=ComMChannel  # Reference to ComM channel.
          container DcmDspComControlSetting [0..1]  # Provide the configuration of the Communication control.
            reference DcmDspComControlCommunicationReEnableModeRuleRef [0..1]: set at link in variant link-time / pre-compile in variant post-build+pre-compile, destination=DcmModeRule  # Reference to DcmDspModeRule Mode rule which controls re-enabling | of communication by DCM. The DCM module shall call BswM_Dcm_CommunicationMode_CurrentState(DCM_ENABLE_RX_TX_NORM_NM)) in case that the referenced mode rule is not fulfilled anymore.
          container DcmDspComControlSpecificChannel [0..*]  # Assigns subnet number to ComM channel which will be controlled.
            integer DcmDspSubnetNumber: 1..14, set at pre-compile  # Subnet Number which controls the specific ComMChannel.
            symbolic name reference DcmDspSpecificComMChannelRef: set at link in variant link-time / post-build in variant post-build / pre-compile in variant pre-compile, destination=ComMChannel  # Reference to ComM channel.
        container DcmDspControlDTCSetting [0..1]  # Provide the configuration of the ControlDTCSetting mechanism.
          reference DcmDspControlDTCSettingReEnableModeRuleRef [0..1]: set at link in variant link-time / pre-compile in variant post-build+pre-compile, destination=DcmModeRule  # Reference to DcmDspModeRule | Mode rule which controls re-enabling of controlDTCsetting by DCM. The DCM module shall execute a ControlDTCSetting.Off (call Dem_EnableDTCSetting()) in case that the referenced mode rule is not fulfilled anymore.
        container DcmDspData [0..*]  # This container contains the configuration (parameters) of a Data belonging to a DID
          function name DcmDspDataConditionCheckReadFnc [0..1]: set at pre-compile  # Function name to demand application if the conditions (e.g. System state) to read the DID are correct. (ConditionCheckRead-function). | Multiplicity shall be equal to parameter DcmDspDataReadFnc. Only relevant if DcmDspDataUsePort=="USE_DATA_SYNCH_FNC or DcmDspDataUsePort==USE_DATA_ASYNCH_FNC". This parameter is related to the interface Xxx_ConditionCheckRead.
          function name DcmDspDataEcuSignal [0..1]: set at pre-compile  # Function name to control the access to a certain ECU Signal by the DCM. (IoHwAb_Dcm_<EcuSignalName>-function). | Only relevant if DcmDspDataUsePort==USE_ECU_SIGNAL.
          function name DcmDspDataFreezeCurrentStateFnc [0..1]: set at pre-compile  # Function name to request to application to freeze the current state of an IOControl. (FreezeCurrentState-function). | Only relevant if DcmDspDataUsePort=="USE_DATA_SYNCH_FNC or DcmDspDataUsePort==USE_DATA_ASYNCH_FNC". This parameter is related to the interface Xxx_FreezeCurrentState.
          function name DcmDspDataGetScalingInfoFnc [0..1]: set at pre-compile  # Function name to request to application the scaling information of the DID. (GetScalingInformation-function). | Only relevant if DcmDspDataUsePort=="USE_DATA_SYNCH_FNC or DcmDspDataUsePort==USE_DATA_ASYNCH_FNC". This parameter is related to the interface Xxxx_GetScalingInformation.
          function name DcmDspDataReadDataLengthFnc [0..1]: set at pre-compile  # Function name to request from application the data length of a DID. (ReadDataLength-function). | Only relevant if DcmDspDataUsePort=="USE_DATA_SYNCH_FNC or DcmDspDataUsePort==USE_DATA_ASYNCH_FNC". This parameter is related to the interface Xxx_ReadDataLength.
          function name DcmDspDataReadEcuSignal [0..1]: set at pre-compile  # Function name for read access to a certain ECU Signal by the DCM. (IoHwAb_Dcm_Read<EcuSignalName>-function). | Only relevant if DcmDspDataUsePort==USE_ECU_SIGNAL.
          function name DcmDspDataReadFnc [0..1]: set at pre-compile  # Function name to request from application the data value of a DID. (ReadData-function). | Multiplicity shall be equal to parameter DcmDspDataConditionCheckReadFnc. Only relevant if DcmDspDataUsePort=="USE_DATA_SYNCH_FNC or DcmDspDataUsePort==USE_DATA_ASYNCH_FNC". This parameter is related to the interface Xxx_ReadData.
          function name DcmDspDataResetToDefaultFnc [0..1]: set at pre-compile  # Function name to request to application to reset an IOControl to default value. (ResetToDefault-function). | Only relevant if DcmDspDataUsePort=="USE_DATA_SYNCH_FNC or DcmDspDataUsePort==USE_DATA_ASYNCH_FNC". This parameter is related to the interface Xxx_ResetToDefault.
          function name DcmDspDataReturnControlToEcuFnc [0..1]: set at pre-compile  # Function name to request to application to return control to ECU of an IOControl. (ReturnControlToECU-function). | Only relevant if DcmDspDataUsePort=="USE_DATA_SYNCH_FNC or DcmDspDataUsePort==USE_DATA_ASYNCH_FNC". This parameter is related to the interface Xxx_ReturnControlToECU.
          function name DcmDspDataShortTermAdjustmentFnc [0..1]: set at pre-compile  # Function name to request to application to adjuste the IO signal. (ShortTermAdjustment-function). | Only relevant if DcmDspDataUsePort=="USE_DATA_SYNCH_FNC or DcmDspDataUsePort==USE_DATA_ASYNCH_FNC". This parameter is related to the interface Xxx_ShortTermAdjustment.
          integer DcmDspDataSize: 0..65535, set at link in variant link-time / pre-compile in variant post-build+pre-compile  # Length of data in bits associated to the Data. If Data has variable datalength, that corresponds to the maximum datalength.
          enumeration DcmDspDataType [0..1]: {BOOLEAN, SINT16, SINT32, SINT8, UINT16, UINT32, UINT8}, set at link in variant link-time / pre-compile in variant post-build+pre-compile  # Provide the data type of Data belonging to a DID.
          enumeration DcmDspDataUsePort: {USE_BLOCK_ID, USE_DATA_ASYNCH_CLIENT_SERVER, USE_DATA_ASYNCH_FNC, USE_DATA_SENDER_RECEIVER, USE_DATA_SYNCH_CLIENT_SERVER, USE_DATA_SYNCH_FNC, USE_ECU_SIGNAL}, set at pre-compile  # Define wich interface shall be used to access the data.
          function name DcmDspDataWriteFnc [0..1]: set at pre-compile  # Function name to request application to write the data value of a DID. (WriteData-function). | Only relevant if DcmDspDataUsePort=="USE_DATA_SYNCH_FNC or DcmDspDataUsePort==USE_DATA_ASYNCH_FNC". This parameter is related to the interface Xxx_WriteData.
          reference DcmDspDataInfoRef: set at pre-compile, destination=DcmDspDataInfo  # Reference to 1 DcmDspDataInfo
          symbolic name reference DcmDspDataBlockIdRef [0..1]: set at pre-compile, origin=AUTOSAR_ECUC V1.0.0, destination=NvMBlockDescriptor  # NRAM blockId to access the data. | Only relevant if DcmDspDataUsePort==USE_BLOCK_ID.
        container DcmDspDataInfo [0..*]  # This container contains the configuration (parameters) of a Data
          boolean DcmDspDataFixedLength: set at link in variant link-time / pre-compile in variant post-build+pre-compile  # Indicates if the datalength of the Data is fixed | true = datalength of the Data is fixed false = datalength of the Data is variable
          integer DcmDspDataScalingInfoSize [0..1]: 0..4294967295, set at link in variant link-time / pre-compile in variant post-build+pre-compile  # If Scaling information service is available for this Data, it provides the size of the scaling information.
        container DcmDspDid [0..*]  # This container contains the configuration (parameters) of the DID.
          integer DcmDspDidIdentifier: 0..65535, set at link in variant link-time / pre-compile in variant post-build+pre-compile  # 2 byte Identifier of the DID
          boolean DcmDspDidRoeQueueEnabled [0..1]: set at link in variant link-time / pre-compile in variant post-build+pre-compile  # If set to TRUE, the ROE queue mechanism will be used in case of ROE OnChangeOfDataIdentifier on this DID. | If set to FALSE, the ROE event will be sent without queuing.
          boolean DcmDspDidUsed: set at link in variant link-time / post-build in variant post-build / pre-compile in variant pre-compile  # Allow to activate or deactivate the usage of a DID, for multi purpose ECUs | true = DID available false = DID not available
          reference DcmDspDidInfoRef: set at link in variant link-time / pre-compile in variant post-build+pre-compile, destination=DcmDspDidInfo  # Reference to DcmDspDidInfo containing information on this DID.
          reference DcmDspDidRef [0..*]: set at link in variant link-time / pre-compile in variant post-build+pre-compile, destination=DcmDspDid  # Reference to DcmDspDid in case this DID refer to one or serveral other DID's
          container DcmDspDidExtRoe [0..1]  # Provide information to manage a responseOnEvent request on this DID externally. If this container doesn't exist, an ROE event on this DID will be managed internally.
            function name DcmDspDidRoeActivateFnc [0..1]: set at link in variant link-time / pre-compile in variant post-build+pre-compile  # Function name to activate/deactivate an ROE event managed externally. Only relevant if DcmDspDataUsePort== USE_DATA_SYNCH_FNC or USE_DATA_ASYNCH_FNC. This parameter is related to the interface xxx_ActivateEvent.
            integer DcmDspDidRoeEventId: 0..255, set at link in variant link-time / pre-compile in variant post-build+pre-compile  # EventId to be used within Apis Dcm_TriggerOnEvent() and xxx_ActivateEvent()
          container DcmDspDidSignal [0..*]  # This container defines the reference to 1 DcmDspData container and position relevant for this DID.
            integer DcmDspDidDataPos: 0..65535, set at link in variant link-time / pre-compile in variant post-build+pre-compile  # Defines the position of the data defined by DcmDspDidDataRef reference to DcmDspData container in the DID. | The position is defined in bits.
            reference DcmDspDidDataRef: set at link in variant link-time / pre-compile in variant post-build+pre-compile, destination=DcmDspData  # Reference to 1 DcmDspData container relevant for this DID.
        container DcmDspDidInfo [0..*]  # This container contains the configuration (parameters) of the DID's Info
          boolean DcmDspDidDynamicallyDefined: set at link in variant link-time / pre-compile in variant post-build+pre-compile  # Indicates if this DID can be dynamically defined | true = DID can be dynamically defined false = DID can not be dynamically defined
          container DcmDspDidAccess  # This container contains the configuration (parameters) of the DID access
            container DcmDspDidControl [0..1]  # This container contains the configuration (parameters) of the DID control.
              boolean DcmDspDidFreezeCurrentState [0..1]: set at pre-compile  # This indicates the presence of "FreezeCurrentState".
              boolean DcmDspDidResetToDefault [0..1]: set at pre-compile  # This indicates the presence of "ResetToDefault".
              boolean DcmDspDidReturnControlToEcu [0..1]: set at pre-compile  # This indicates the presence of "ReturnControlToEcu".
              boolean DcmDspDidShortTermAdjustment [0..1]: set at pre-compile  # This indicates the presence of "ShortTermAdjustment".
              reference DcmDspDidControlModeRuleRef [0..1]: set at link in variant link-time / pre-compile in variant post-build+pre-compile, destination=DcmModeRule  # Reference to DcmDspModeRule | Mode rule which controls this DID. If there is no reference, no check of the mode rule shall be done.
              reference DcmDspDidControlSecurityLevelRef [0..*]: set at link in variant link-time / pre-compile in variant post-build+pre-compile, destination=DcmDspSecurityRow  # Reference to DcmDspSecurityRow | Security levels allowed to control this DID. If there is no reference, no check of security level shall be done.
              reference DcmDspDidControlSessionRef [0..*]: set at link in variant link-time / pre-compile in variant post-build+pre-compile, destination=DcmDspSessionRow  # Reference to DcmDspSessionRow | Sessions allowed to control this DID. If there is no reference, no check of session level shall be done.
            container DcmDspDidRead [0..1]  # This container contains the configuration (parameters) of the DID read.
              reference DcmDspDidReadModeRuleRef [0..1]: set at link in variant link-time / pre-compile in variant post-build+pre-compile, destination=DcmModeRule  # Reference to DcmDspModeRule | Mode rule which controls to read this DID. If there is no reference, no check of the mode rule shall be done.
              reference DcmDspDidReadSecurityLevelRef [0..*]: set at link in variant link-time / pre-compile in variant post-build+pre-compile, destination=DcmDspSecurityRow  # Reference to DcmDspSecurityRow | Security levels allowed to read this DID. If there is no reference, no check of security level shall be done.
              reference DcmDspDidReadSessionRef [0..*]: set at link in variant link-time / pre-compile in variant post-build+pre-compile, destination=DcmDspSessionRow  # Reference to DcmDspSessionRow | Sessions allowed to read this DID. If there is no reference, no check of session level shall be done.
            container DcmDspDidWrite [0..1]  # This container contains the configuration (parameters) of the DID write.
              reference DcmDspDidWriteModeRuleRef [0..1]: set at link in variant link-time / pre-compile in variant post-build+pre-compile, destination=DcmModeRule  # Reference to DcmDspModeRule | Mode rule which controls to write this DID. If there is no reference, no check of the mode rule shall be done.
              reference DcmDspDidWriteSecurityLevelRef [0..*]: set at link in variant link-time / pre-compile in variant post-build+pre-compile, destination=DcmDspSecurityRow  # Reference to DcmDspSecurityRow | Security levels allowed to write this DID. If there is no reference, no check of security level shall be done.
              reference DcmDspDidWriteSessionRef [0..*]: set at link in variant link-time / pre-compile in variant post-build+pre-compile, destination=DcmDspSessionRow  # Reference to DcmDspSessionRow | Sessions allowed to write this DID. If there is no reference, no check of session level shall be done.
        container DcmDspDidRange [0..*]  # This container defines the DID Range
          boolean DcmDspDidRangeHasGaps: set at link in variant link-time / pre-compile in variant post-build+pre-compile  # Parameter specifying if there are gaps in the DID range (parameter set to TRUE) or not (parameter set to FALSE)
          integer DcmDspDidRangeIdentifierLowerLimit: 0..65535, set at link in variant link-time / pre-compile in variant post-build+pre-compile  # Lower limit of DID range.
          integer DcmDspDidRangeIdentifierUpperLimit: 0..65535, set at link in variant link-time / pre-compile in variant post-build+pre-compile  # Upper limit of DID range.
          function name DcmDspDidRangeIsDidAvailableFnc [0..1]: set at pre-compile  # Function name to request from application if a specific DID is available within the range or not. | Only relevant if DcmDspDidRangeUsePort is set to false. This parameter is related to the interface Xxx_IsDidAvailable.
          integer DcmDspDidRangeMaxDataLength: 0..65535, set at link in variant link-time / pre-compile in variant post-build+pre-compile  # Maximum data length in bytes
          function name DcmDspDidRangeReadDidFnc [0..1]: set at pre-compile  # Function name to request from application the data range value of a DID.(ReadData-function). | Only relevant if DcmDspDidRangeUsePort is set to false. This parameter is related to the interface Xxx_ReadDidData.
          boolean DcmDspDidRangeUsePort: set at pre-compile  # When the parameter DcmDspDidRangeUsePort is set to true the DCM will access the Data using an R-Port requiring a PortInteface DataServices_DIDRange. In that case, DcmDspDidRangeIsDidAvailableFnc, DcmDspDidRangeReadDidFnc and DcmDspDidRangeWriteDidFnc are ignored and the RTE APIs are used. When the parameter DcmDspDidRangeUsePort is false, the DCM calls the functions defined in DcmDspDidRangeIsDidAvailableFnc, DcmDspDidRangeReadDidFnc and DcmDspDidRangeWriteDidFnc.
          function name DcmDspDidRangeWriteDidFnc [0..1]: set at pre-compile  # Function name to request application to write the data range value of a DID.(WriteData-function). | Only relevant if DcmDspDidRangeUsePort is set to false. This parameter is related to the interface Xxx_WriteDidData.
          reference DcmDspDidRangeInfoRef: set at link in variant link-time / pre-compile in variant post-build+pre-compile, destination=DcmDspDidInfo  # Reference to DcmDspDidInfo containing information on this DID Range.
        container DcmDspMemory [0..1]  # This container contains the configuration of the memory access.
          boolean DcmDspUseMemoryId: set at link in variant link-time / pre-compile in variant post-build+pre-compile  # If this parameter is set to false, the DCM will not use MemoryIdentifier parameter. | The Dcm_WriteMemory and Dcm_ReadMemory callouts shall be called without the MemoryIdentifier parameter. If this parameter is set to true, the DCM will use MemoryIdentifier parameter to select the memory device to use. The Dcm_WriteMemory and Dcm_ReadMemory callouts shall be called with the MemoryIdentifier parameter.
          container DcmDspMemoryIdInfo [1..*]  # Provides the value of memory identifier used to select the desired memory device | This container contains the configuration of the memory access requested through diagnostic services : ReadMemoryByAddress, WriteMemoryByAddress, RequestDownload, RequestUpload
            integer DcmDspMemoryIdValue [0..1]: 0..255, set at link in variant link-time / pre-compile in variant post-build+pre-compile  # Value of the memory device identifer used. This parameter is only relevant if the memory Id parameter use is enabled. (DcmDspUseMemoryId = TRUE)
            container DcmDspReadMemoryRangeInfo [0..*]  # Provides the range of memory address allowed for reading
              integer DcmDspReadMemoryRangeHigh: 0..4294967294, set at link in variant link-time / pre-compile in variant post-build+pre-compile  # High memory address of a range allowed for reading
              integer DcmDspReadMemoryRangeLow: 0..4294967294, set at link in variant link-time / pre-compile in variant post-build+pre-compile  # Low memory address of a range allowed for reading
              reference DcmDspReadMemoryRangeModeRuleRef [0..1]: set at link in variant link-time / pre-compile in variant post-build+pre-compile, destination=DcmModeRule  # Reference to DcmDspModeRule | Mode rule which controls read access on this memory address. If there is no reference, no check of the mode rule shall be done.
              reference DcmDspReadMemoryRangeSecurityLevelRef [0..*]: set at link in variant link-time / pre-compile in variant post-build+pre-compile, destination=DcmDspSecurityRow  # Link to the Security Access Levels needed for read access on this memory address. If there is no reference, no check of security level shall be done.
            container DcmDspWriteMemoryRangeInfo [0..*]  # Provides the range of memory address allowed for writting.
              integer DcmDspWriteMemoryRangeHigh: 0..4294967294, set at link in variant link-time / pre-compile in variant post-build+pre-compile  # High memory address of a range allowed for writting.
              integer DcmDspWriteMemoryRangeLow: 0..4294967294, set at link in variant link-time / pre-compile in variant post-build+pre-compile  # Low memory address of a range allowed for writting
              reference DcmDspWriteMemoryRangeModeRuleRef [0..1]: set at link in variant link-time / pre-compile in variant post-build+pre-compile, destination=DcmModeRule  # Reference to DcmDspModeRule | Mode rule which controls write access on this memory address. If there is no reference, no check of the mode rule shall be done.
              reference DcmDspWriteMemoryRangeSecurityLevelRef [0..*]: set at link in variant link-time / pre-compile in variant post-build+pre-compile, destination=DcmDspSecurityRow  # Link to the Security Access Levels needed for write access on this memory address. If there is no reference, no check of security level shall be done.
        container DcmDspPid [0..*]  # This container defines the availability of a PID to the DCM.
          integer DcmDspPidIdentifier: 0..255, set at link in variant link-time / pre-compile in variant post-build+pre-compile  # 1 byte Identifier of the PID
          enumeration DcmDspPidService: {DCM_SERVICE_01, DCM_SERVICE_01_02, DCM_SERVICE_02}, set at link in variant link-time / pre-compile in variant post-build+pre-compile  # Allow to indicate if this PID is used for service $01 or/and $02.
          integer DcmDspPidSize: 0..255, set at link in variant link-time / pre-compile in variant post-build+pre-compile  # Length of the PID in byte.
          boolean DcmDspPidUsed: set at link in variant link-time / post-build in variant post-build / pre-compile in variant pre-compile  # Allow to activate or deactivate the usage of a PID, for multi purpose ECUs | true = PID available false = PID not available
          container DcmDspPidData [1..*]  # This container defines the parameter for a Signal in the PID.
            integer DcmDspPidDataPos: 0..2040, set at link in variant link-time / pre-compile in variant post-build+pre-compile  # This is the position in bit of the PID structure and will not start at position 0 in case a support information is availabe (for bit-mapped PIDs).
            integer DcmDspPidDataSize: 0..2040, set at link in variant link-time / pre-compile in variant post-build+pre-compile  # Length of data associated to the PID in bit.
            container DcmDspPidDataSupportInfo [0..1]  # This container defines the supported information.
              integer DcmDspPidDataSupportInfoBit: 0..255, set at link in variant link-time / pre-compile in variant post-build+pre-compile  # referenced Bit of the SupportInfo
              reference DcmDspPidDataSupportInfoRef: set at link in variant link-time / pre-compile in variant post-build+pre-compile, destination=DcmDspPidSupportInfo  # Reference to DcmDspPidSupportInfo
            container DcmDspPidService01 [0..1]  # Contains specific configuration parameter of PID for service $01. This container exists only if DcmDspPidService is set to DCM_SERVICE_01 or DCM_SERVICE_01_02.
              function name DcmDspPidDataReadFnc [0..1]: set at pre-compile  # Function name for reading PID data value. | This is only relevant if DcmDspPidDataUsePort==USE_DATA_SYNCH_FNC. This parameter is related to the interface Xxx_ReadData.
              enumeration DcmDspPidDataUsePort: {USE_DATA_SENDER_RECEIVER, USE_DATA_SYNCH_CLIENT_SERVER, USE_DATA_SYNCH_FNC}, set at pre-compile  # If this parameter is set to USE_DATA_SYNCH_FNC, the DCM will use the function defined in DcmDspPidDataReadFnc to get the PID data value. | If this parameter is set to USE_DATA_SYNCH_CLIENT_SERVER, the DCM will have an R-Port requiring the interface DataServices_<Data>. If this parameter is set to USE_DATA_SENDER_RECEIVER, the DCM will have an R-Port requiring a SenderReceiverInterface The R-Port is named DataServices_<Data> where <Data> is the name of the container DcmDspPidData.
            container DcmDspPidService02 [0..1]  # Contains specific configuration parameter of PID for service $02. This container exists only if DcmDspPidService is set to DCM_SERVICE_02 or DCM_SERVICE_01_02.
              reference DcmDspPidDataDemRef [0..1]: set at link in variant link-time / pre-compile in variant post-build+pre-compile, destination=DemPidDataElement  # Reference to DemPidDataElement in DEM configuration. Allows to link the DCM PID and DEM PID configuration for Mode $02.
          container DcmDspPidSupportInfo [0..*]  # This container defines the support information (typically byte A) to declare the usability of the data bytes within the so-called bit-mapped PIDs (e.g. PID$68).
            integer DcmDspPidSupportInfoLen: 0..255, set at link in variant link-time / pre-compile in variant post-build+pre-compile  # Length of the supported information in bytes.
            integer DcmDspPidSupportInfoPos: 0..255, set at link in variant link-time / pre-compile in variant post-build+pre-compile  # Position of the supported information in bytes.
        container DcmDspRequestControl [0..*]  # This container contains the configuration (parameters) of the "Request control of on-board system, test or component" service (Service $08). | The DCM will request the control using an R-Port requiring a PortInteface RequestControlServices_<TID> The R-Port is named RequestControlServices_<TID> where <TID> is the name of the container DcmDspRequestControl.
          integer DcmDspRequestControlInBufferSize: 0..4294967295, set at link in variant link-time / pre-compile in variant post-build+pre-compile
          integer DcmDspRequestControlOutBufferSize: 0..4294967295, set at link in variant link-time / pre-compile in variant post-build+pre-compile
          integer DcmDspRequestControlTestId: 0..255, set at link in variant link-time / pre-compile in variant post-build+pre-compile  # Test Id for Service $08
        container DcmDspRoe [0..1]  # Provide the configuration of the ResponseOnEvent mechanism.
          integer DcmDspRoeBufSize [0..1]: 0..65535, set at link in variant link-time / pre-compile in variant post-build+pre-compile  # Size of the buffer used to managed internally the subservice OnChangeOfDataIdentifier of ResponseOnEvent Service.
          function name DcmDspRoeInitFnc [0..1]: set at link in variant link-time / pre-compile in variant post-build+pre-compile  # Function name to initialize an ROE event managed externally.
          boolean DcmDspRoeInitOnDSC: set at link in variant link-time / pre-compile in variant post-build+pre-compile  # If set to TRUE the ROE functionality is re-initialized on reception of service DiagnosticSessionControl.
          float DcmDspRoeInterMessageTime: 0..5000, set at link in variant link-time / pre-compile in variant post-build+pre-compile  # Provide the minimum time in ms between two transmissions of ROE event. It is used for the delay between two different consecutive Roe transmissions and between two transmissions of the retry mechanism. | The AUTOSAR configuration standard is to use SI units, so this parameter is defined as float value in seconds. DCM configuration tools must convert this float value to the appropriate value format for the use in the software implementation of DCM. min: A negative value is not allowed.
          integer DcmDspRoeMaxEventLength [0..1]: 1..65535, set at link in variant link-time / pre-compile in variant post-build+pre-compile  # Provide the max size in byte of an ROE message that will be stored in the ROE transmission queue.
          integer DcmDspRoeMaxNumberOfRetry: 0..255, set at link in variant link-time / pre-compile in variant post-build+pre-compile  # Provide the max number of re-transmission of an ROE event in case of transmission failure. | If set to 0, no retry mechanism will be managed
          integer DcmDspRoeMaxQueueLength [0..1]: 1..65535, set at link in variant link-time / pre-compile in variant post-build+pre-compile  # Provide the max number of element in the ROE transmission queue.
          boolean DcmDspRoeQueueEnabled: set at link in variant link-time / pre-compile in variant post-build+pre-compile  # If set to TRUE, the ROE queue mechanism is enabled on DCM. | If set to FALSE, the ROE event will be sent without queuing.
          function name DcmDspRoeStopFnc [0..1]: set at link in variant link-time / pre-compile in variant post-build+pre-compile  # Function name to stop an ROE event managed externally.
        container DcmDspRoutine [0..*]  # This container contains the configuration (parameters) for Routines
          function name DcmDspRequestResultsRoutineFnc [0..1]: set at pre-compile  # Function name for request to application the results of a routine. (Routine_RequestResults-function) | This parameter is related to the interface Xxx_RequestResults.
          boolean DcmDspRequestResultsRoutineSupported: set at link in variant link-time / pre-compile in variant post-build+pre-compile  # Indicates if the optional requestRoutineResults in the RoutineControl is supported | true = requestRoutineResults is supported false = requestRoutineResults is not supported
          boolean DcmDspRoutineFixedLength: set at link in variant link-time / pre-compile in variant post-build+pre-compile  # Indicates if the datalength of the optional record in the RoutineControl request and response is fixed. | true = datalength of the optional record is fixed false = datalength of the optional record is variable In case DcmDspRoutineFixedLength is set to FALSE, the DcmDspRoutineSignalLength for the last signal is the maximum length (in bits) of the optional record.
          integer DcmDspRoutineIdentifier: 0..65535, set at link in variant link-time / pre-compile in variant post-build+pre-compile  # 2 bytes Identifier of the RID
          boolean DcmDspRoutineUsePort: set at pre-compile  # If this parameter is set to true, the DCM uses a port requiring a PortInterface RoutineServices_<ROUTINENAME>. | The R-Port is named RoutineServices_<ROUTINENAME> where <ROUTINENAME> is the name of the container DcmDspRoutine In that case, the configuration must not provide function names in DcmDspStartRoutineFnc, DcmDspStopRoutineFnc or DcmDspRequestResultsRoutineFnc. If this is false, the DCM expects to find the names of the functions to be used in DcmDspStartRoutineFnc, DcmDspStopRoutineFnc or DcmDspRequestResultsRoutineFnc.
          boolean DcmDspRoutineUsed: set at link in variant link-time / post-build in variant post-build / pre-compile in variant pre-compile  # Allow to activate or deactivate the usage of a Routine, for multi purpose ECUs | true = Routine available false = Routine not available
          function name DcmDspStartRoutineFnc [0..1]: set at pre-compile  # Function name for request to application to start a routine. (Routine_Start-function) | This parameter is related to the interface Xxx_Start.
          function name DcmDspStopRoutineFnc [0..1]: set at pre-compile  # Function name for request to application to stop a routine. (Routine_Stop-function) | This parameter is related to the interface Xxx_Stop.
          boolean DcmDspStopRoutineSupported: set at link in variant link-time / pre-compile in variant post-build+pre-compile  # Indicates if the optional stopRoutine in the RoutineControl is supported | true = stopRoutine is supported false = stopRoutine is not supported
          reference DcmDspRoutineInfoRef: set at link in variant link-time / pre-compile in variant post-build+pre-compile, destination=DcmDspRoutineInfo  # Reference to DcmDspRoutineInfo containing information on this routine.
        container DcmDspRoutineInfo [0..*]  # This container contains the configuration (parameters) for Routine's Info.
          container DcmDspRoutineAuthorization  # This container contains the configuration (parameters) for the Routine Authorization.
            reference DcmDspRoutineModeRuleRef [0..1]: set at link in variant link-time / pre-compile in variant post-build+pre-compile, destination=DcmModeRule  # Reference to DcmDspModeRule | Mode rule which controls this RID. If there is no reference, no check of the mode rule shall be done.
            reference DcmDspRoutineSecurityLevelRef [0..*]: set at link in variant link-time / pre-compile in variant post-build+pre-compile, destination=DcmDspSecurityRow  # Reference to DcmDspSecurityRow | Security levels allowed to control this RID. If there is no reference, no check of security level shall be done.
            reference DcmDspRoutineSessionRef [0..*]: set at link in variant link-time / pre-compile in variant post-build+pre-compile, destination=DcmDspSessionRow  # Reference to DcmDspSessionRow | Sessions allowed to control this RID. If there is no reference, no check of session level shall be done.
          container DcmDspRoutineRequestResOut [0..1]  # Provide description of output parameter of RequestResult subservice for RoutineControl service.
            container DcmDspRoutineRequestResOutSignal [1..*]  # Provide description of a routine signal used in RoutineControl service.
              integer DcmDspRoutineSignalLength: 0..65535, set at link in variant link-time / pre-compile in variant post-build+pre-compile  # Provide the length in bits of the signal in the RoutineControl request/response
              integer DcmDspRoutineSignalPos: 0..65535, set at link in variant link-time / pre-compile in variant post-build+pre-compile  # Provide the position of the signal in the RoutineControl request/response. | The position is defined in bits.
              enumeration DcmDspRoutineSignalType: {BOOLEAN, SINT16, SINT32, SINT8, UINT16, UINT32, UINT8, VARIABLE_LENGTH}, set at link in variant link-time / pre-compile in variant post-build+pre-compile  # Provide the type of the signal in the RoutineControl request/response.
          container DcmDspRoutineStopIn [0..1]  # Provide description of input parameter of Stop subservice for RoutineControl service.
            container DcmDspRoutineStopInSignal [1..*]  # Provide description of a routine signal used in RoutineControl service.
              integer DcmDspRoutineSignalLength: 0..65535, set at link in variant link-time / pre-compile in variant post-build+pre-compile  # Provide the length in bits of the signal in the RoutineControl request/response
              integer DcmDspRoutineSignalPos: 0..65535, set at link in variant link-time / pre-compile in variant post-build+pre-compile  # Provide the position of the signal in the RoutineControl request/response. | The position is defined in bits.
              enumeration DcmDspRoutineSignalType: {BOOLEAN, SINT16, SINT32, SINT8, UINT16, UINT32, UINT8, VARIABLE_LENGTH}, set at link in variant link-time / pre-compile in variant post-build+pre-compile  # Provide the type of the signal in the RoutineControl request/response.
          container DcmDspRoutineStopOut [0..1]  # Provide description of output parameter of Stop subservice for RoutineControl service.
            container DcmDspRoutineStopOutSignal [1..*]  # Provide description of a routine signal used in RoutineControl service.
              integer DcmDspRoutineSignalLength: 0..65535, set at link in variant link-time / pre-compile in variant post-build+pre-compile  # Provide the length in bits of the signal in the RoutineControl request/response
              integer DcmDspRoutineSignalPos: 0..65535, set at link in variant link-time / pre-compile in variant post-build+pre-compile  # Provide the position of the signal in the RoutineControl request/response. | The position is defined in bits.
              enumeration DcmDspRoutineSignalType: {BOOLEAN, SINT16, SINT32, SINT8, UINT16, UINT32, UINT8, VARIABLE_LENGTH}, set at link in variant link-time / pre-compile in variant post-build+pre-compile  # Provide the type of the signal in the RoutineControl request/response.
          container DcmDspStartRoutineIn [0..1]  # Provide description of input parameter of Start subservice for RoutineControl service
            container DcmDspStartRoutineInSignal [1..*]  # Provide description of a routine signal used in RoutineControl service.
              integer DcmDspRoutineSignalLength: 0..65535, set at link in variant link-time / pre-compile in variant post-build+pre-compile  # Provide the length in bits of the signal in the RoutineControl request/response
              integer DcmDspRoutineSignalPos: 0..65535, set at link in variant link-time / pre-compile in variant post-build+pre-compile  # Provide the position of the signal in the RoutineControl request/response. | The position is defined in bits.
              enumeration DcmDspRoutineSignalType: {BOOLEAN, SINT16, SINT32, SINT8, UINT16, UINT32, UINT8, VARIABLE_LENGTH}, set at link in variant link-time / pre-compile in variant post-build+pre-compile  # Provide the type of the signal in the RoutineControl request/response.
          container DcmDspStartRoutineOut [0..1]  # Provide description of output parameter of Start subservice for RoutineControl service.
            container DcmDspStartRoutineOutSignal [1..*]  # Provide description of a routine signal used in RoutineControl service.
              integer DcmDspRoutineSignalLength: 0..65535, set at link in variant link-time / pre-compile in variant post-build+pre-compile  # Provide the length in bits of the signal in the RoutineControl request/response.
              integer DcmDspRoutineSignalPos: 0..65535, set at link in variant link-time / pre-compile in variant post-build+pre-compile  # Provide the position of the signal in the RoutineControl request/response. | The position is defined in bits.
              enumeration DcmDspRoutineSignalType: {BOOLEAN, SINT16, SINT32, SINT8, UINT16, UINT32, UINT8, VARIABLE_LENGTH}, set at link in variant link-time / pre-compile in variant post-build+pre-compile  # Provide the type of the signal in the RoutineControl request/response.
        container DcmDspSecurity  # This container contains the configuration ( DSP parameter) for security level configuration (per security level) | Description This container contains Rows of DcmDspSecurityRow
          container DcmDspSecurityRow [0..31]  # Definition of a single Row of configuration for security level configuration (per security level) | The name of this container is used to define the name of the R-Port through which the DCM accesses the interface SecurityAccess_<LEVEL>. The R-Port is named SecurityAccess_<LEVEL> where _<LEVEL> is the name of the container DcmDspSecurityRow. If there is no reference, no check of security level shall be done.
            integer DcmDspSecurityADRSize [0..1]: 1..4294967295, set at link in variant link-time / pre-compile in variant post-build+pre-compile  # Size of the AccessDataRecord used in GetSeed
            float DcmDspSecurityDelayTime: 0..20000, set at link in variant link-time / pre-compile in variant post-build+pre-compile  # Delay time after failed security access (in ms). This is started after DcmDspSecurityNumAttDelay number of failed security accesses. | The AUTOSAR configuration standard is to use SI units, so this parameter is defined as float value in seconds. DCM configuration tools must convert this float value to the appropriate value format for the use in the software implementation of DCM. min: A negative value is not allowed. upperMultiplicity: Exactly one delay time must be specified per security levbel configuration. lowerMultiplicity: Exactly one delay time must be specified per security levbel configuration. origin: Standard AUTOSAR configuration parameter.
            float DcmDspSecurityDelayTimeOnBoot: 0..20000, set at link in variant link-time / pre-compile in variant post-build+pre-compile, origin=AUTOSAR_ECUC V1.0.0  # Start delay timer on power on (in ms) | The AUTOSAR configuration standard is to use SI units, so this parameter is defined as float value in seconds. DCM configuration tools must convert this float value to the appropriate value format for the use in the software implementation of DCM. min: A negative value is not allowed. upperMultiplicity: Exactly one delay time must be specified per security level configuration. lowerMultiplicity: Exactly one delay time must be specified per security level configuration.
            integer DcmDspSecurityKeySize: 1..4294967295, set at link in variant link-time / pre-compile in variant post-build+pre-compile  # size of the security key (in Bytes).
            integer DcmDspSecurityLevel: 1..63, set at link in variant link-time / pre-compile in variant post-build+pre-compile, symbolic-name-value=true  # Value of Security level. | Level 1 is the highest security level. The locked state cannot be configured explicitly. 1,2,3...63: configuration dependent - Conversion formula to calculate SecurityLevel out of tester requested SecurityAccessType parameter: SecurityLevel = (SecurityAccessType + 1) / 2 Type: Dcm_SecLevelType
            integer DcmDspSecurityNumAttDelay: 1..255, set at link in variant link-time / pre-compile in variant post-build+pre-compile  # Number of failed security accesses after which the delay time is activated
            integer DcmDspSecuritySeedSize: 1..4294967295, set at link in variant link-time / pre-compile in variant post-build+pre-compile  # size of the security seed (in Bytes).
        container DcmDspSession [1..*]  # This container contains the configuration ( DSP parameter) session control configuration (per session control) | This container contains Rows of DcmDspSessionRow
          container DcmDspSessionRow [0..31]  # Definition of a single Row of session control configuration (per session control)
            enumeration DcmDspSessionForBoot: {DCM_NO_BOOT, DCM_OEM_BOOT, DCM_SYS_BOOT}, set at link in variant link-time / pre-compile in variant post-build+pre-compile, origin=AUTOSAR_ECUC V1.0.0  # This parameter defines whether this diagnostic session allows to jump to Bootloader (OEM Bootloader or System Supplier Bootloader). If this diagnostic session doesn't allow to jump to Bootloader the value DCM_NO_BOOT shall be chosen.
            integer DcmDspSessionLevel: 0..255, set at link in variant link-time / pre-compile in variant post-build+pre-compile, symbolic-name-value=true  # Value of the Session control. The symbolicName represents the Name of the Session | SWS defines the Dcm_SesCtrlType: 1 DEFAULT_SESSION 2 PROGRAMMING_SESSION 3 EXTENDED_DIAGNOSTIC_SESSION 4 SAFETY_SYSTEM_DIAGNOSTIC_SESSION 5...63 Reserved by Document 64...126 <configuration dependent (according "diagnosticSessionType" parameter DiagnosticSessionControl request> 127...254 Reserved by Document 255 ALL_SESSION_LEVEL
            float DcmDspSessionP2ServerMax: 0..1000, set at link in variant link-time / pre-compile in variant post-build+pre-compile  # This is the session value for P2ServerMax in milliseconds (per Session Control). | This is defined in the AUTOSAR SWS for DCM as a uint16. The AUTOSAR configuration standard is to use SI units, so this parameter is defined as a float value in seconds. DCM configuration tools must convert this float value to the appropriate value format for the use in the software implementation of DCM.
            float DcmDspSessionP2StarServerMax: 0..100000, set at link in variant link-time / pre-compile in variant post-build+pre-compile  # This is the session value for P2*ServerMax in milliseconds (per Session Control). | This is defined in the AUTOSAR SWS for DCM as a uint16. The AUTOSAR configuration standard is to use SI units, so this parameter is defined as a float value in seconds. DCM configuration tools must convert this float value to the appropriate value format for the use in the software implementation of DCM.
        container DcmDspTestResultByObdmid [0..1]  # This container contains the configuration (parameters) of the "Request on-board monitoring test results" service (Service $06).
          container DcmDspTestResultObdmidTid [1..*]  # This container contains the configuration (parameters) of a OBDMID and the assigned TIDs for the "Request on-board monitoring test results" service (Service $06).
            integer DcmDspTestResultObdmid: 0..255, set at link in variant link-time / pre-compile in variant post-build+pre-compile  # OBDMID for Service $06
            container DcmDspTestResultObdmidTids [1..*]  # This container contains the configuration (parameters) of the TIDs belonging to the OBDMID for the "Request on-board monitoring test results" service (Service $06).
              integer DcmDspTestResultObdmidTidUaSid: 0..255, set at link in variant link-time / pre-compile in variant post-build+pre-compile  # Unit And Scaling ID for Service $06
              reference DcmDspTestResultObdmidTidRef [1..*]: set at link in variant link-time / post-build in variant post-build / pre-compile in variant pre-compile, destination=DcmDspTestResultTid  # Link to reported TIDs of this OBDMID | upperMultiplicity / lowerMultiplicity:: At least one TID must be reported for an OBDMID
          container DcmDspTestResultTid [1..*]  # This container contains the configuration (parameters) of a single TID for the "Request on-board monitoring test results" service (Service $06). | The DCM will access the Data using an R-Port requiring a PortInterface DTRServices. The R-Port is named DtrServices_<OBDMID>_<TID> where <TID> is the name of the container DcmDspTestResultTid and <OBDMID> is the name of the container DcmDspTestResultObdmidTid.
            integer DcmDspTestResultTestId: 0..255, set at link in variant link-time / pre-compile in variant post-build+pre-compile  # Test Id for Service $06
        container DcmDspVehInfo [0..*]  # This container contains the configuration (parameters) of the "Request vehicle information service" (service $09).
          integer DcmDspVehInfoInfoType: 0..255, set at link in variant link-time / pre-compile in variant post-build+pre-compile  # value of InfoType.
          container DcmDspVehInfoData [1..*]  # Data Item of an InfoType; post-fix of the port interface name.
            integer DcmDspVehInfoDataOrder: 0..255, set at pre-compile  # Defines the order of the data item in the InfoType; values: 0..255; first data item having the order number 0; the next 1 and so on. | The configuration of order needs to be unique per InfoType.
            function name DcmDspVehInfoDataReadFnc [0..1]: set at pre-compile  # Function name for reading InfoType data item.
            integer DcmDspVehInfoDataSize: 0..255, set at pre-compile  # Size in bytes of the InfoType data item.
            boolean DcmDspVehInfoDataUsePort: set at pre-compile  # When the parameter DcmDspVehInfoUsePort is set to true the DCM will access the Data using an R-Port requiring a PortInteface InfotypeServices_<VEHINFODATA>. The R-Port is named | InfotypeServices_<VEHINFODATA>. where <VEHINFODATA> is the name of the container DcmDspVehInfoData. In that case, the DcmDspVehInfoDataReadFnc is ignored and the RTE APIs are used. When the parameter DcmDspVehInfoDataUsePort is false, the DCM calls the function defined in DcmDspVehInfoDataReadFnc.
      container DcmGeneral  # This container contains the configuration (parameters) for Component wide parameters
        boolean DcmDevErrorDetect: set at pre-compile  # Preprocessor switch to enable or disable the Development Error Detection (DET) mechanism.
        boolean DcmRequestManufacturerNotificationEnabled: set at pre-compile  # Allows to enable or disable the requested notification mechanism for the Manufacturer.
        boolean DcmRequestSupplierNotificationEnabled: set at pre-compile  # Allows to enable or disable the requested notification mechanism for the Supplier.
        boolean DcmRespondAllRequest: set at pre-compile  # If set to FALSE the DCM will not respond to diagnostic request that contains a service ID which is in the range from 0x40 to 0x7F or in the range from 0xC0 to 0xFF (Response IDs).
        float DcmTaskTime: 0..100, set at link in variant link-time / pre-compile in variant post-build+pre-compile  # Allow to configure the time for the periodic cyclic task. Please note: This configuration value shall be equal to the value in the ScheduleManager module. | The AUTOSAR configuration standard is to use SI units, so this parameter is defined as float value in seconds. DCM configuration tools must convert this float value to the appropriate value format for the use in the software implementation of DCM. min: A negative value is not allowed. upperMultiplicity: Exactly one TaskTime must be specified per configuration. lowerMultiplicity: Exactly one TaskTime must be specified per configuration.
        boolean DcmVersionInfoApi: set at pre-compile  # Preprocessor switch to enable or disable the output Version info of the functionality.
      container DcmPageBufferCfg  # This container contains the configuration (parameters) for Page Buffer handling
        boolean DcmPagedBufferEnabled: set at pre-compile  # Allow to enable or disable the Page buffer mechanism. | true = Page buffer handling enabled false = Page Buffer handling disabled
        float DcmPagedBufferTimeout [0..1]: 0..1000, set at link in variant link-time / pre-compile in variant post-build+pre-compile  # Allow to configure the Timeout (in ms) towards the application for filling the next page. | This parameter is only relevant if the Page Buffer handling is enabled. (DcmPagedBufferEnabled = TRUE) Defined in the DCM SWS as uint16, this parameter contains a value in milliseconds. The AUTOSAR configuration standard is to use SI units, so this parameter is defined as float value in seconds. DCM configuration tools must convert this float value to the appropriate value format for the use in the software implementation of DCM. min: A negative value is not allowed. upperMultiplicity: Exactly one Timeout must be specified per configuration. lowerMultiplicity: Exactly one Timeout must be specified per configuration.
      container DcmProcessingConditions [0..1]  # This container contains the configuration ( DSP parameter) for mode arbitration functionality of the Dcm
        container DcmModeCondition [1..*]  # This container contains the configuration of a mode condition which can be used as argument in DcmModeRules. | One DcmModeCondition shall contain either one DcmSwcModeRef or one DcmBswModeRef. Please note that the Dcm acts as well as mode manager. Therefore the references DcmSwcModeRef or one DcmBswModeRef. might point to provided ModeDeclarationGroupPrototypes of the Dcm itself as well as to provided ModeDeclarationGroupPrototypes of other Bsw Modules or software components.
          enumeration DcmConditionType: {DCM_EQUALS, DCM_EQUALS_NOT}, set at pre-compile  # This parameter specifies what kind of comparison that is made for the evaluation of the mode condition.
          instance reference DcmBswModeRef [0..1]: set at pre-compile, destination-context=MODE-DECLARATION-GROUP-PROTOTYPE, destination-type=MODE-DECLARATION  # This parameter references a mode of a ModeDeclarationGroupPrototype provided by a Basic Software Module used for the condition. | Please note that such ModeDeclarationGroupPrototype are owned by a Basic Software Module Description in the role providedModeGroup.
          instance reference DcmSwcModeRef [0..1]: set at pre-compile, destination-context=ROOT-SW-COMPOSITION-PROTOTYPE SW-COMPONENT-PROTOTYPE P-PORT-PROTOTYPE MODE-DECLARATION-GROUP-PROTOTYPE, destination-type=MODE-DECLARATION  # This parameter references a mode in a particular mode request port of a software component that is used for the condition.
        container DcmModeRule [1..*]  # This container contains the configuration of a mode rule which represents a logical expression with DcmModeCondistions or other DcmModeRules as arguments. | All arguments are processed with the operator defined by DcmLogicalOperator, for instance: Argument_A AND Argument_B AND Argument_C
          enumeration DcmLogicalOperator [0..1]: {DCM_AND, DCM_OR}, set at pre-compile  # This parameter specifies the logical operator to be used in the logical expression. If the expression only consists of a single condition this parameter shall not be used.
          integer DcmModeRuleNrcValue [0..1]: 0..255, set at link in variant link-time / pre-compile in variant pre-compile  # Optional parameter which defines the NRC to be sent in case the mode rule condition is not valid.
          choice reference DcmArgumentRef [1..*]: set at pre-compile, destination=[DcmModeCondition, DcmModeRule]  # This is a choice reference either to a mode condition or a an other mode rule serving as sub-expression.

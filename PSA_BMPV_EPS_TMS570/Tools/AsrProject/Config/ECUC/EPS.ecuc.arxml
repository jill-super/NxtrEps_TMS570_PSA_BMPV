[part 2 of 3: package /ActiveEcuC]
AUTOSAR XML (schema 3.0.2)
package /ActiveEcuC  (continued)
  module config OvrVoltMon: implementation-config-variant=VARIANT-PRE-COMPILE  # Configuration of the Nexteer OvrVoltMon module.
    OvrVoltMonGeneral
    CommonPublishedInformation: ArMajorVersion=3, ArMinorVersion=2, ArPatchVersion=0, SwMajorVersion=0, SwMinorVersion=0, SwPatchVersion=0, ModuleId=0, VendorId=0
  module config PeakCurrEst: implementation-config-variant=VARIANT-PRE-COMPILE  # Configuration of the Nexteer PeakCurrEst module.
    PeakCurrEstGeneral
    CommonPublishedInformation: ArMajorVersion=3, ArMinorVersion=2, ArPatchVersion=0, SwMajorVersion=0, SwMinorVersion=0, SwPatchVersion=0, ModuleId=0, VendorId=0
  module config PICurrCntrl: implementation-config-variant=VARIANT-PRE-COMPILE  # Configuration of the Nexteer PICurrCntrl module.
    PICurrCntrlGeneral
    CommonPublishedInformation: ArMajorVersion=3, ArMinorVersion=2, ArPatchVersion=0, SwMajorVersion=0, SwMinorVersion=0, SwPatchVersion=0, ModuleId=0, VendorId=0
  module config Polarity: implementation-config-variant=VARIANT-PRE-COMPILE  # Configuration of the Nexteer Polarity module.
    PolarityGeneral
    CommonPublishedInformation: ArMajorVersion=3, ArMinorVersion=2, ArPatchVersion=0, SwMajorVersion=0, SwMinorVersion=0, SwPatchVersion=0, ModuleId=0, VendorId=0
  module config Port: implementation-config-variant=VARIANT-POST-BUILD, module-description=Port_Impl  # Configuration of the Port module.
    Port_Runtime (PortConfigSet)
      GIOA (PortContainer):
        PortNumberOfPortPins = 8
        PortUse = false
        PortName = GIO A
        PortRegPostfix = GIOA
        PortAvailablePackage0 = false
        PortAvailablePackage1 = true
        PortAvailablePackage2 = true
        PortAvailablePackage3 = false
        PortAvailablePackage4 = false
        PortRegBaseAddr = 4294425648
        PortRegStructure = PORT_REG_STRUCT_REGULAR_NO_FUNC
        PortContainsPrivReg = false
        8 x PortPin, all with PortPinDirection=PORT_PIN_IN, PortPinDirectionChangeable=false, PortPinInitialMode=PORT_PIN_MODE_DIO, PortPinLevelValue=PORT_PIN_LEVEL_LOW, PortPinMode=PORT_PIN_MODE_DIO, PortPinOpenDrain=PORT_PUSH_PULL, PortPinPullSelect=PORT_PULL_DOWN, PortPinRefresh=false, PortPinAvailablePackage0=false, PortPinAvailablePackage1=true, PortPinAvailablePackage2=true, PortPinAvailablePackage3=false, PortPinAvailablePackage4=false, PortPinSlewRate=PORT_PIN_SLEW_RATE_NA:
          PortPinGioA_{0..4}: PortPinId={0..4}, PortPinChannelName=(unset), PortPinName=GIOA{0..4}
          PortPinGioA_5: PortPinId=5, PortPinChannelName=GA_UPPER, PortPinName=GIOA5
          PortPinGioA_6: PortPinId=6, PortPinChannelName=GA_LOWER, PortPinName=GIOA6
          PortPinGioA_7: PortPinId=7, PortPinChannelName=GB_UPPER, PortPinName=GIOA7
      PortDefaultSettings:
        PortUseDefaultSettings = false
        PortDefaultDirection = PORT_PIN_IN
        PortDefaultLevelValue = PORT_PIN_LEVEL_LOW
        PortDefaultOpenDrain = PORT_PUSH_PULL
        PortDefaultPullSelect = PORT_PULL_UP
        PortDefaultSlewRate = PORT_PIN_SLEW_RATE_NORMAL
      Multiplexing (PortMux):
        PortMuxName = Port Pin Multiplexing
        PortMuxNumberOfPins = 9
        PortMuxNumberOfRegs = 31
        PortMuxRegPostfix = PINMUX
        PortMuxRegBaseAddr = 4294961936
        PortUseMux = true
        PortMuxEmifClkOutput = false
        PortMuxDisableNhet2OutputByGiob2 = false
        PortMuxSelMiiOrRmii = PORT_MUX_SEL_RMII
        PortMuxSelAdcTriggerTable = PORT_MUX_SEL_ADC_TRIG_TABLE_2
        109 x PortMuxPin, all with PortMuxPinId=0, PortMuxPinNumberPackage0=-, PortMuxPinNumberPackage3=-, PortMuxPinNumberPackage4=-:
          Pin_N19_86: PortMuxPinName=AD1EVT, MII_RX_ER, RMII_RX_ER, PortMuxPinFunc=PORT_PIN_MUX_AD1EVT, PortMuxPinRegId=10, PortMuxPinRegPos=0, PortMuxPinNumberPackage1=N19, PortMuxPinNumberPackage2=86, PortMuxPinDirection=PORT_MUX_PIN_DIR_OUTPUT
          Pin_D4: PortMuxPinName=EMIF_ADDR[0], NHET2[1], PortMuxPinFunc=PORT_PIN_MUX_EMIF_ADDR_0, PortMuxPinRegId=22, PortMuxPinRegPos=0, PortMuxPinNumberPackage1=D4, PortMuxPinNumberPackage2=-, PortMuxPinDirection=PORT_MUX_PIN_DIR_OUTPUT
          Pin_D5: PortMuxPinName=EMIF_ADDR[1], NHET2[3], PortMuxPinFunc=PORT_PIN_MUX_EMIF_ADDR_1, PortMuxPinRegId=21, PortMuxPinRegPos=0, PortMuxPinNumberPackage1=D5, PortMuxPinNumberPackage2=-, PortMuxPinDirection=PORT_MUX_PIN_DIR_OUTPUT
          Pin_C8: PortMuxPinName=EMIF_ADDR[10], RTP_DATA[09], PortMuxPinFunc=PORT_PIN_MUX_EMIF_ADDR_10, PortMuxPinRegId=21, PortMuxPinRegPos=16, PortMuxPinNumberPackage1=C8, PortMuxPinNumberPackage2=-, PortMuxPinDirection=PORT_MUX_PIN_DIR_OUTPUT
          Pin_C9: PortMuxPinName=EMIF_ADDR[11], RTP_DATA[08], PortMuxPinFunc=PORT_PIN_MUX_EMIF_ADDR_11, PortMuxPinRegId=20, PortMuxPinRegPos=24, PortMuxPinNumberPackage1=C9, PortMuxPinNumberPackage2=-, PortMuxPinDirection=PORT_MUX_PIN_DIR_OUTPUT
          Pin_C10: PortMuxPinName=EMIF_ADDR[12], RTP_DATA[06], PortMuxPinFunc=PORT_PIN_MUX_EMIF_ADDR_12, PortMuxPinRegId=20, PortMuxPinRegPos=8, PortMuxPinNumberPackage1=C10, PortMuxPinNumberPackage2=-, PortMuxPinDirection=PORT_MUX_PIN_DIR_OUTPUT
          Pin_C11: PortMuxPinName=EMIF_ADDR[13], RTP_DATA[05], PortMuxPinFunc=PORT_PIN_MUX_EMIF_ADDR_13, PortMuxPinRegId=20, PortMuxPinRegPos=0, PortMuxPinNumberPackage1=C11, PortMuxPinNumberPackage2=-, PortMuxPinDirection=PORT_MUX_PIN_DIR_OUTPUT
          Pin_C12: PortMuxPinName=EMIF_ADDR[14], RTP_DATA[04], PortMuxPinFunc=PORT_PIN_MUX_EMIF_ADDR_14, PortMuxPinRegId=18, PortMuxPinRegPos=16, PortMuxPinNumberPackage1=C12, PortMuxPinNumberPackage2=-, PortMuxPinDirection=PORT_MUX_PIN_DIR_OUTPUT
          Pin_C13: PortMuxPinName=EMIF_ADDR[15], RTP_DATA[03], PortMuxPinFunc=PORT_PIN_MUX_EMIF_ADDR_15, PortMuxPinRegId=18, PortMuxPinRegPos=0, PortMuxPinNumberPackage1=C13, PortMuxPinNumberPackage2=-, PortMuxPinDirection=PORT_MUX_PIN_DIR_OUTPUT
          Pin_D14: PortMuxPinName=EMIF_ADDR[16], RTP_DATA[02], PortMuxPinFunc=PORT_PIN_MUX_EMIF_ADDR_16, PortMuxPinRegId=16, PortMuxPinRegPos=16, PortMuxPinNumberPackage1=D14, PortMuxPinNumberPackage2=-, PortMuxPinDirection=PORT_MUX_PIN_DIR_OUTPUT
          Pin_C14: PortMuxPinName=EMIF_ADDR[17], RTP_DATA[01], PortMuxPinFunc=PORT_PIN_MUX_EMIF_ADDR_17, PortMuxPinRegId=16, PortMuxPinRegPos=8, PortMuxPinNumberPackage1=C14, PortMuxPinNumberPackage2=-, PortMuxPinDirection=PORT_MUX_PIN_DIR_OUTPUT
          Pin_D15: PortMuxPinName=EMIF_ADDR[18], RTP_DATA[0], PortMuxPinFunc=PORT_PIN_MUX_EMIF_ADDR_18, PortMuxPinRegId=15, PortMuxPinRegPos=24, PortMuxPinNumberPackage1=D15, PortMuxPinNumberPackage2=-, PortMuxPinDirection=PORT_MUX_PIN_DIR_OUTPUT
          Pin_C15: PortMuxPinName=EMIF_ADDR[19], RTP_nENA, PortMuxPinFunc=PORT_PIN_MUX_EMIF_ADDR_19, PortMuxPinRegId=15, PortMuxPinRegPos=16, PortMuxPinNumberPackage1=C15, PortMuxPinNumberPackage2=-, PortMuxPinDirection=PORT_MUX_PIN_DIR_OUTPUT
          Pin_C16: PortMuxPinName=EMIF_ADDR[20], RTP_nSYNC, PortMuxPinFunc=PORT_PIN_MUX_EMIF_ADDR_20, PortMuxPinRegId=15, PortMuxPinRegPos=8, PortMuxPinNumberPackage1=C16, PortMuxPinNumberPackage2=-, PortMuxPinDirection=PORT_MUX_PIN_DIR_OUTPUT
          Pin_C17: PortMuxPinName=EMIF_ADDR[21], RTP_CLK, PortMuxPinFunc=PORT_PIN_MUX_EMIF_ADDR_21, PortMuxPinRegId=15, PortMuxPinRegPos=0, PortMuxPinNumberPackage1=C17, PortMuxPinNumberPackage2=-, PortMuxPinDirection=PORT_MUX_PIN_DIR_OUTPUT
          Pin_C4: PortMuxPinName=EMIF_ADDR[6], RTP_DATA[13], NHET2[11], PortMuxPinFunc=PORT_PIN_MUX_EMIF_ADDR_6, PortMuxPinRegId=22, PortMuxPinRegPos=16, PortMuxPinNumberPackage1=C4, PortMuxPinNumberPackage2=-, PortMuxPinDirection=PORT_MUX_PIN_DIR_OUTPUT
          Pin_C5: PortMuxPinName=EMIF_ADDR[7], RTP_DATA[12], NHET2[13], PortMuxPinFunc=PORT_PIN_MUX_EMIF_ADDR_7, PortMuxPinRegId=22, PortMuxPinRegPos=8, PortMuxPinNumberPackage1=C5, PortMuxPinNumberPackage2=-, PortMuxPinDirection=PORT_MUX_PIN_DIR_OUTPUT
          Pin_C6: PortMuxPinName=EMIF_ADDR[8], RTP_DATA[11], NHET2[15], PortMuxPinFunc=PORT_PIN_MUX_EMIF_ADDR_8, PortMuxPinRegId=23, PortMuxPinRegPos=0, PortMuxPinNumberPackage1=C6, PortMuxPinNumberPackage2=-, PortMuxPinDirection=PORT_MUX_PIN_DIR_OUTPUT
          Pin_C7: PortMuxPinName=EMIF_ADDR[9], RTP_DATA[10], PortMuxPinFunc=PORT_PIN_MUX_EMIF_ADDR_9, PortMuxPinRegId=21, PortMuxPinRegPos=24, PortMuxPinNumberPackage1=C7, PortMuxPinNumberPackage2=-, PortMuxPinDirection=PORT_MUX_PIN_DIR_OUTPUT
          Pin_D16: PortMuxPinName=EMIF_BA[1], NHET2[5], PortMuxPinFunc=PORT_PIN_MUX_EMIF_BA_1, PortMuxPinRegId=14, PortMuxPinRegPos=24, PortMuxPinNumberPackage1=D16, PortMuxPinNumberPackage2=-, PortMuxPinDirection=PORT_MUX_PIN_DIR_OUTPUT
          Pin_N17: PortMuxPinName=EMIF_nCS[0], RTP_DATA[15], NHET2[7], PortMuxPinFunc=PORT_PIN_MUX_EMIF_nCS_0, PortMuxPinRegId=10, PortMuxPinRegPos=16, PortMuxPinNumberPackage1=N17, PortMuxPinNumberPackage2=-, PortMuxPinDirection=PORT_MUX_PIN_DIR_OUTPUT
          Pin_K17: PortMuxPinName=EMIF_nCS[3], RTP_DATA[14], NHET2[9], PortMuxPinFunc=PORT_PIN_MUX_EMIF_nCS_3, PortMuxPinRegId=11, PortMuxPinRegPos=0, PortMuxPinNumberPackage1=K17, PortMuxPinNumberPackage2=-, PortMuxPinDirection=PORT_MUX_PIN_DIR_OUTPUT
          Pin_M17: PortMuxPinName=EMIF_nCS[4], RTP_DATA[07], PortMuxPinFunc=PORT_PIN_MUX_EMIF_nCS_4, PortMuxPinRegId=11, PortMuxPinRegPos=8, PortMuxPinNumberPackage1=M17, PortMuxPinNumberPackage2=-, PortMuxPinDirection=PORT_MUX_PIN_DIR_OUTPUT
          Pin_D17: PortMuxPinName=EMIF_nWE, EMIF_RNW, PortMuxPinFunc=PORT_PIN_MUX_EMIF_nWE, PortMuxPinRegId=14, PortMuxPinRegPos=16, PortMuxPinNumberPackage1=D17, PortMuxPinNumberPackage2=-, PortMuxPinDirection=PORT_MUX_PIN_DIR_OUTPUT
          Pin_D9: PortMuxPinName=ETMDATA[08], EMIF_ADDR[5], PortMuxPinFunc=PORT_PIN_MUX_ETMDATA_08, PortMuxPinRegId=17, PortMuxPinRegPos=24, PortMuxPinNumberPackage1=D9, PortMuxPinNumberPackage2=-, PortMuxPinDirection=PORT_MUX_PIN_DIR_OUTPUT
          Pin_D8: PortMuxPinName=ETMDATA[09], EMIF_ADDR[4], PortMuxPinFunc=PORT_PIN_MUX_ETMDATA_09, PortMuxPinRegId=19, PortMuxPinRegPos=0, PortMuxPinNumberPackage1=D8, PortMuxPinNumberPackage2=-, PortMuxPinDirection=PORT_MUX_PIN_DIR_OUTPUT
          Pin_D7: PortMuxPinName=ETMDATA[10], EMIF_ADDR[3], PortMuxPinFunc=PORT_PIN_MUX_ETMDATA_10, PortMuxPinRegId=19, PortMuxPinRegPos=24, PortMuxPinNumberPackage1=D7, PortMuxPinNumberPackage2=-, PortMuxPinDirection=PORT_MUX_PIN_DIR_OUTPUT
          Pin_D6: PortMuxPinName=ETMDATA[11], EMIF_ADDR[2], PortMuxPinFunc=PORT_PIN_MUX_ETMDATA_11, PortMuxPinRegId=22, PortMuxPinRegPos=24, PortMuxPinNumberPackage1=D6, PortMuxPinNumberPackage2=-, PortMuxPinDirection=PORT_MUX_PIN_DIR_OUTPUT
          Pin_D13: PortMuxPinName=ETMDATA[12], EMIF_BA[0], PortMuxPinFunc=PORT_PIN_MUX_ETMDATA_12, PortMuxPinRegId=16, PortMuxPinRegPos=0, PortMuxPinNumberPackage1=D13, PortMuxPinNumberPackage2=-, PortMuxPinDirection=PORT_MUX_PIN_DIR_OUTPUT
          Pin_D12: PortMuxPinName=ETMDATA[13], EMIF_nOE, PortMuxPinFunc=PORT_PIN_MUX_ETMDATA_13, PortMuxPinRegId=16, PortMuxPinRegPos=24, PortMuxPinNumberPackage1=D12, PortMuxPinNumberPackage2=-, PortMuxPinDirection=PORT_MUX_PIN_DIR_OUTPUT
          Pin_D11: PortMuxPinName=ETMDATA[14], EMIF_nDQM[1], PortMuxPinFunc=PORT_PIN_MUX_ETMDATA_14, PortMuxPinRegId=17, PortMuxPinRegPos=8, PortMuxPinNumberPackage1=D11, PortMuxPinNumberPackage2=-, PortMuxPinDirection=PORT_MUX_PIN_DIR_OUTPUT
          Pin_D10: PortMuxPinName=ETMDATA[15], EMIF_nDQM[0], PortMuxPinFunc=PORT_PIN_MUX_ETMDATA_15, PortMuxPinRegId=19, PortMuxPinRegPos=16, PortMuxPinNumberPackage1=D10, PortMuxPinNumberPackage2=-, PortMuxPinDirection=PORT_MUX_PIN_DIR_OUTPUT
          Pin_K15: PortMuxPinName=ETMDATA[16], EMIF_DATA[0], PortMuxPinFunc=PORT_PIN_MUX_ETMDATA_16, PortMuxPinRegId=12, PortMuxPinRegPos=8, PortMuxPinNumberPackage1=K15, PortMuxPinNumberPackage2=-, PortMuxPinDirection=PORT_MUX_PIN_DIR_OUTPUT
          Pin_L15: PortMuxPinName=ETMDATA[17], EMIF_DATA[1], PortMuxPinFunc=PORT_PIN_MUX_ETMDATA_17, PortMuxPinRegId=11, PortMuxPinRegPos=16, PortMuxPinNumberPackage1=L15, PortMuxPinNumberPackage2=-, PortMuxPinDirection=PORT_MUX_PIN_DIR_OUTPUT
          Pin_M15: PortMuxPinName=ETMDATA[18], EMIF_DATA[2], PortMuxPinFunc=PORT_PIN_MUX_ETMDATA_18, PortMuxPinRegId=10, PortMuxPinRegPos=24, PortMuxPinNumberPackage1=M15, PortMuxPinNumberPackage2=-, PortMuxPinDirection=PORT_MUX_PIN_DIR_OUTPUT
          Pin_N15: PortMuxPinName=ETMDATA[19], EMIF_DATA[3], PortMuxPinFunc=PORT_PIN_MUX_ETMDATA_19, PortMuxPinRegId=10, PortMuxPinRegPos=8, PortMuxPinNumberPackage1=N15, PortMuxPinNumberPackage2=-, PortMuxPinDirection=PORT_MUX_PIN_DIR_OUTPUT
          Pin_E4: PortMuxPinName=ETMDATA[20], EMIF_DATA[4], PortMuxPinFunc=PORT_PIN_MUX_ETMDATA_20, PortMuxPinRegId=1, PortMuxPinRegPos=16, PortMuxPinNumberPackage1=E4, PortMuxPinNumberPackage2=-, PortMuxPinDirection=PORT_MUX_PIN_DIR_OUTPUT
          Pin_F4: PortMuxPinName=ETMDATA[21], EMIF_DATA[5], PortMuxPinFunc=PORT_PIN_MUX_ETMDATA_21, PortMuxPinRegId=1, PortMuxPinRegPos=24, PortMuxPinNumberPackage1=F4, PortMuxPinNumberPackage2=-, PortMuxPinDirection=PORT_MUX_PIN_DIR_OUTPUT
          Pin_G4: PortMuxPinName=ETMDATA[22], EMIF_DATA[6], PortMuxPinFunc=PORT_PIN_MUX_ETMDATA_22, PortMuxPinRegId=2, PortMuxPinRegPos=8, PortMuxPinNumberPackage1=G4, PortMuxPinNumberPackage2=-, PortMuxPinDirection=PORT_MUX_PIN_DIR_OUTPUT
          Pin_K4: PortMuxPinName=ETMDATA[23], EMIF_DATA[7], PortMuxPinFunc=PORT_PIN_MUX_ETMDATA_23, PortMuxPinRegId=3, PortMuxPinRegPos=0, PortMuxPinNumberPackage1=K4, PortMuxPinNumberPackage2=-, PortMuxPinDirection=PORT_MUX_PIN_DIR_OUTPUT
          Pin_L4: PortMuxPinName=ETMDATA[24], EMIF_DATA[8], PortMuxPinFunc=PORT_PIN_MUX_ETMDATA_24, PortMuxPinRegId=3, PortMuxPinRegPos=24, PortMuxPinNumberPackage1=L4, PortMuxPinNumberPackage2=-, PortMuxPinDirection=PORT_MUX_PIN_DIR_OUTPUT
          Pin_M4: PortMuxPinName=ETMDATA[25], EMIF_DATA[9], PortMuxPinFunc=PORT_PIN_MUX_ETMDATA_25, PortMuxPinRegId=4, PortMuxPinRegPos=8, PortMuxPinNumberPackage1=M4, PortMuxPinNumberPackage2=-, PortMuxPinDirection=PORT_MUX_PIN_DIR_OUTPUT
          Pin_N4: PortMuxPinName=ETMDATA[26], EMIF_DATA[10], PortMuxPinFunc=PORT_PIN_MUX_ETMDATA_26, PortMuxPinRegId=5, PortMuxPinRegPos=24, PortMuxPinNumberPackage1=N4, PortMuxPinNumberPackage2=-, PortMuxPinDirection=PORT_MUX_PIN_DIR_OUTPUT
          Pin_P4: PortMuxPinName=ETMDATA[27], EMIF_DATA[11], PortMuxPinFunc=PORT_PIN_MUX_ETMDATA_27, PortMuxPinRegId=6, PortMuxPinRegPos=8, PortMuxPinNumberPackage1=P4, PortMuxPinNumberPackage2=-, PortMuxPinDirection=PORT_MUX_PIN_DIR_OUTPUT
          Pin_R5: PortMuxPinName=ETMDATA[28], EMIF_DATA[12], PortMuxPinFunc=PORT_PIN_MUX_ETMDATA_28, PortMuxPinRegId=6, PortMuxPinRegPos=24, PortMuxPinNumberPackage1=R5, PortMuxPinNumberPackage2=-, PortMuxPinDirection=PORT_MUX_PIN_DIR_OUTPUT
          Pin_R6: PortMuxPinName=ETMDATA[29], EMIF_DATA[13], PortMuxPinFunc=PORT_PIN_MUX_ETMDATA_29, PortMuxPinRegId=7, PortMuxPinRegPos=0, PortMuxPinNumberPackage1=R6, PortMuxPinNumberPackage2=-, PortMuxPinDirection=PORT_MUX_PIN_DIR_OUTPUT
          Pin_R7: PortMuxPinName=ETMDATA[30], EMIF_DATA[14], PortMuxPinFunc=PORT_PIN_MUX_ETMDATA_30, PortMuxPinRegId=7, PortMuxPinRegPos=24, PortMuxPinNumberPackage1=R7, PortMuxPinNumberPackage2=-, PortMuxPinDirection=PORT_MUX_PIN_DIR_OUTPUT
          Pin_R8: PortMuxPinName=ETMDATA[31], EMIF_DATA[15], PortMuxPinFunc=PORT_PIN_MUX_ETMDATA_31, PortMuxPinRegId=8, PortMuxPinRegPos=24, PortMuxPinNumberPackage1=R8, PortMuxPinNumberPackage2=-, PortMuxPinDirection=PORT_MUX_PIN_DIR_OUTPUT
          Pin_R9: PortMuxPinName=ETMTRACECLKIN, EXTCLKIN2, PortMuxPinFunc=PORT_PIN_MUX_ETMTRACECLKIN, PortMuxPinRegId=9, PortMuxPinRegPos=0, PortMuxPinNumberPackage1=R9, PortMuxPinNumberPackage2=-, PortMuxPinDirection=PORT_MUX_PIN_DIR_OUTPUT
          Pin_C1_9: PortMuxPinName=GIOA[2], Reserved, Reserved, NHET2[0], PortMuxPinFunc=PORT_PIN_MUX_GIOA_2, PortMuxPinRegId=2, PortMuxPinRegPos=0, PortMuxPinNumberPackage1=C1, PortMuxPinNumberPackage2=9, PortMuxPinDirection=PORT_MUX_PIN_DIR_OUTPUT
          Pin_E1: PortMuxPinName=GIOA[3], NHET2[2], PortMuxPinFunc=PORT_PIN_MUX_GIOA_3, PortMuxPinRegId=2, PortMuxPinRegPos=16, PortMuxPinNumberPackage1=E1, PortMuxPinNumberPackage2=-, PortMuxPinDirection=PORT_MUX_PIN_DIR_OUTPUT
          Pin_B5_14: PortMuxPinName=GIOA[5], EXTCLKIN, PortMuxPinFunc=PORT_PIN_MUX_GIOA_5, PortMuxPinRegId=2, PortMuxPinRegPos=24, PortMuxPinNumberPackage1=B5, PortMuxPinNumberPackage2=14, PortMuxPinDirection=PORT_MUX_PIN_DIR_OUTPUT
          Pin_H3_16: PortMuxPinName=GIOA[6], NHET2[4], PortMuxPinFunc=PORT_PIN_MUX_NHET2_4, PortMuxPinRegId=3, PortMuxPinRegPos=16, PortMuxPinNumberPackage1=H3, PortMuxPinNumberPackage2=16, PortMuxPinDirection=PORT_MUX_PIN_DIR_OUTPUT
          Pin_M1_22: PortMuxPinName=GIOA[7], NHET2[6], PortMuxPinFunc=PORT_PIN_MUX_GIOA_7, PortMuxPinRegId=4, PortMuxPinRegPos=0, PortMuxPinNumberPackage1=M1, PortMuxPinNumberPackage2=22, PortMuxPinDirection=PORT_MUX_PIN_DIR_OUTPUT
          Pin_R2_105: PortMuxPinName=MIBSPI1NCS[0], MIBSPI1SOMI[1], MII_TXD[2], PortMuxPinFunc=PORT_PIN_MUX_MIBSPI1NCS_0, PortMuxPinRegId=13, PortMuxPinRegPos=24, PortMuxPinNumberPackage1=R2, PortMuxPinNumberPackage2=105, PortMuxPinDirection=PORT_MUX_PIN_DIR_OUTPUT
          Pin_F3_130: PortMuxPinName=MIBSPI1NCS[1], NHET1[17], MII_COL, PortMuxPinFunc=PORT_PIN_MUX_MIBSPI1NCS_1, PortMuxPinRegId=20, PortMuxPinRegPos=16, PortMuxPinNumberPackage1=F3, PortMuxPinNumberPackage2=130, PortMuxPinDirection=PORT_MUX_PIN_DIR_OUTPUT
          Pin_F3_130_IN: PortMuxPinName=MIBSPI1NCS[1], NHET1[17], PortMuxPinFunc=PORT_PIN_MUX_MIBSPI1NCS_1, PortMuxPinRegId=24, PortMuxPinRegPos=16, PortMuxPinNumberPackage1=F3, PortMuxPinNumberPackage2=130, PortMuxPinDirection=PORT_MUX_PIN_DIR_INPUT
          Pin_G3_40: PortMuxPinName=MIBSPI1NCS[2], NHET1[19], MDIO, PortMuxPinFunc=PORT_PIN_MUX_MIBSPI1NCS_2, PortMuxPinRegId=8, PortMuxPinRegPos=8, PortMuxPinNumberPackage1=G3, PortMuxPinNumberPackage2=40, PortMuxPinDirection=PORT_MUX_PIN_DIR_OUTPUT
          Pin_G3_40_IN: PortMuxPinName=MIBSPI1NCS[2], NHET1[19], PortMuxPinFunc=PORT_PIN_MUX_MIBSPI1NCS_2, PortMuxPinRegId=24, PortMuxPinRegPos=24, PortMuxPinNumberPackage1=G3, PortMuxPinNumberPackage2=40, PortMuxPinDirection=PORT_MUX_PIN_DIR_INPUT
          Pin_J3: PortMuxPinName=MIBSPI1NCS[3], NHET1[21], PortMuxPinFunc=PORT_PIN_MUX_MIBSPI1NCS_3, PortMuxPinRegId=9, PortMuxPinRegPos=24, PortMuxPinNumberPackage1=J3, PortMuxPinNumberPackage2=-, PortMuxPinDirection=PORT_MUX_PIN_DIR_OUTPUT
          Pin_J3_IN: PortMuxPinName=MIBSPI1NCS[3], NHET1[21], PortMuxPinFunc=PORT_PIN_MUX_MIBSPI1NCS_3, PortMuxPinRegId=25, PortMuxPinRegPos=0, PortMuxPinNumberPackage1=J3, PortMuxPinNumberPackage2=-, PortMuxPinDirection=PORT_MUX_PIN_DIR_INPUT
          Pin_G19_96: PortMuxPinName=MIBSPI1NENA, NHET1[23], MII_RXD[2], PortMuxPinFunc=PORT_PIN_MUX_MIBSPI1NENA, PortMuxPinRegId=12, PortMuxPinRegPos=16, PortMuxPinNumberPackage1=G19, PortMuxPinNumberPackage2=96, PortMuxPinDirection=PORT_MUX_PIN_DIR_OUTPUT
          Pin_G19_96_IN: PortMuxPinName=MIBSPI1NENA, NHET1[23], PortMuxPinFunc=PORT_PIN_MUX_MIBSPI1NENA, PortMuxPinRegId=25, PortMuxPinRegPos=8, PortMuxPinNumberPackage1=G19, PortMuxPinNumberPackage2=96, PortMuxPinDirection=PORT_MUX_PIN_DIR_INPUT
          Pin_V10_55: PortMuxPinName=MIBSPI3NCS[0], AD2EVT, GIOB[2], PortMuxPinFunc=PORT_PIN_MUX_MIBSPI3NCS_0, PortMuxPinRegId=9, PortMuxPinRegPos=16, PortMuxPinNumberPackage1=V10, PortMuxPinNumberPackage2=55, PortMuxPinDirection=PORT_MUX_PIN_DIR_OUTPUT
          Pin_V10_55_IN: PortMuxPinName=MIBSPI3NCS[0], GIOB[2], PortMuxPinFunc=PORT_PIN_MUX_MIBSPI3NCS_0, PortMuxPinRegId=29, PortMuxPinRegPos=16, PortMuxPinNumberPackage1=V10, PortMuxPinNumberPackage2=55, PortMuxPinDirection=PORT_MUX_PIN_DIR_INPUT
          Pin_V5_37: PortMuxPinName=MIBSPI3NCS[1], NHET1[25], MDCLK, PortMuxPinFunc=PORT_PIN_MUX_MIBSPI3NCS_1, PortMuxPinRegId=7, PortMuxPinRegPos=8, PortMuxPinNumberPackage1=V5, PortMuxPinNumberPackage2=37, PortMuxPinDirection=PORT_MUX_PIN_DIR_OUTPUT
          Pin_V5_37_IN: PortMuxPinName=MIBSPI3NCS[1], NHET1[25], PortMuxPinFunc=PORT_PIN_MUX_MIBSPI3NCS_1, PortMuxPinRegId=25, PortMuxPinRegPos=16, PortMuxPinNumberPackage1=V5, PortMuxPinNumberPackage2=37, PortMuxPinDirection=PORT_MUX_PIN_DIR_INPUT
          Pin_B2_4: PortMuxPinName=MIBSPI3NCS[2], I2C_SDA, NHET1[27], PortMuxPinFunc=PORT_PIN_MUX_I2C_SDA, PortMuxPinRegId=0, PortMuxPinRegPos=24, PortMuxPinNumberPackage1=B2, PortMuxPinNumberPackage2=4, PortMuxPinDirection=PORT_MUX_PIN_DIR_OUTPUT
          Pin_B2_4_IN: PortMuxPinName=MIBSPI3NCS[2], NHET1[27], PortMuxPinFunc=PORT_PIN_MUX_MIBSPI3NCS_2, PortMuxPinRegId=25, PortMuxPinRegPos=24, PortMuxPinNumberPackage1=B2, PortMuxPinNumberPackage2=4, PortMuxPinDirection=PORT_MUX_PIN_DIR_INPUT
          Pin_C3_3: PortMuxPinName=MIBSPI3NCS[3], I2C_SCL, NHET1[29], PortMuxPinFunc=PORT_PIN_MUX_I2C_SCL, PortMuxPinRegId=0, PortMuxPinRegPos=16, PortMuxPinNumberPackage1=C3, PortMuxPinNumberPackage2=3, PortMuxPinDirection=PORT_MUX_PIN_DIR_OUTPUT
          Pin_C3_3_IN: PortMuxPinName=MIBSPI3NCS[3], NHET1[29], PortMuxPinFunc=PORT_PIN_MUX_MIBSPI3NCS_3, PortMuxPinRegId=26, PortMuxPinRegPos=0, PortMuxPinNumberPackage1=C3, PortMuxPinNumberPackage2=3, PortMuxPinDirection=PORT_MUX_PIN_DIR_INPUT
          Pin_W9_54: PortMuxPinName=MIBSPI3NENA, MIBSPI3NCS[5], NHET1[31], PortMuxPinFunc=PORT_PIN_MUX_MIBSPI3NENA, PortMuxPinRegId=9, PortMuxPinRegPos=8, PortMuxPinNumberPackage1=W9, PortMuxPinNumberPackage2=54, PortMuxPinDirection=PORT_MUX_PIN_DIR_OUTPUT
          Pin_W9_54_IN: PortMuxPinName=MIBSPI3NENA, NHET1[31], PortMuxPinFunc=PORT_PIN_MUX_MIBSPI3NENA, PortMuxPinRegId=26, PortMuxPinRegPos=8, PortMuxPinNumberPackage1=W9, PortMuxPinNumberPackage2=54, PortMuxPinDirection=PORT_MUX_PIN_DIR_INPUT
          Pin_H19_100: PortMuxPinName=MIBSPI5CLK, DMM_DATA[4], MII_TXEN, RMII_TXEN, PortMuxPinFunc=PORT_PIN_MUX_MIBSPI5CLK, PortMuxPinRegId=13, PortMuxPinRegPos=16, PortMuxPinNumberPackage1=H19, PortMuxPinNumberPackage2=100, PortMuxPinDirection=PORT_MUX_PIN_DIR_OUTPUT
          Pin_E19_32: PortMuxPinName=MIBSPI5NCS[0], DMM_DATA[5], PortMuxPinFunc=PORT_PIN_MUX_MIBSPI5NCS_0, PortMuxPinRegId=27, PortMuxPinRegPos=0, PortMuxPinNumberPackage1=E19, PortMuxPinNumberPackage2=32, PortMuxPinDirection=PORT_MUX_PIN_DIR_OUTPUT
          Pin_B6: PortMuxPinName=MIBSPI5NCS[1], DMM_DATA[6], PortMuxPinFunc=PORT_PIN_MUX_MIBSPI5NCS_1, PortMuxPinRegId=27, PortMuxPinRegPos=8, PortMuxPinNumberPackage1=B6, PortMuxPinNumberPackage2=-, PortMuxPinDirection=PORT_MUX_PIN_DIR_OUTPUT
          Pin_W6: PortMuxPinName=MIBSPI5NCS[2], DMM_DATA[2], PortMuxPinFunc=PORT_PIN_MUX_MIBSPI5NCS_2, PortMuxPinRegId=26, PortMuxPinRegPos=16, PortMuxPinNumberPackage1=W6, PortMuxPinNumberPackage2=-, PortMuxPinDirection=PORT_MUX_PIN_DIR_OUTPUT
          Pin_T12: PortMuxPinName=MIBSPI5NCS[3], DMM_DATA[3], PortMuxPinFunc=PORT_PIN_MUX_MIBSPI5NCS_3, PortMuxPinRegId=26, PortMuxPinRegPos=24, PortMuxPinNumberPackage1=T12, PortMuxPinNumberPackage2=-, PortMuxPinDirection=PORT_MUX_PIN_DIR_OUTPUT
          Pin_H18_97: PortMuxPinName=MIBSPI5NENA, DMM_DATA[7], MII_RXD[3], PortMuxPinFunc=PORT_PIN_MUX_MIBSPI5NENA, PortMuxPinRegId=12, PortMuxPinRegPos=24, PortMuxPinNumberPackage1=H18, PortMuxPinNumberPackage2=97, PortMuxPinDirection=PORT_MUX_PIN_DIR_OUTPUT
          Pin_J19_99: PortMuxPinName=MIBSPI5SIMO[0], DMM_DATA[8], MII_TXD[1], RMII_TXD[1], PortMuxPinFunc=PORT_PIN_MUX_MIBSPI5SIMO_0, PortMuxPinRegId=13, PortMuxPinRegPos=8, PortMuxPinNumberPackage1=J19, PortMuxPinNumberPackage2=99, PortMuxPinDirection=PORT_MUX_PIN_DIR_OUTPUT
          Pin_E16: PortMuxPinName=MIBSPI5SIMO[1], DMM_DATA[9], PortMuxPinFunc=PORT_PIN_MUX_MIBSPI5SIMO_1, PortMuxPinRegId=27, PortMuxPinRegPos=16, PortMuxPinNumberPackage1=E16, PortMuxPinNumberPackage2=-, PortMuxPinDirection=PORT_MUX_PIN_DIR_OUTPUT
          Pin_H17: PortMuxPinName=MIBSPI5SIMO[2], DMM_DATA[10], PortMuxPinFunc=PORT_PIN_MUX_MIBSPI5SIMO_2, PortMuxPinRegId=27, PortMuxPinRegPos=24, PortMuxPinNumberPackage1=H17, PortMuxPinNumberPackage2=-, PortMuxPinDirection=PORT_MUX_PIN_DIR_OUTPUT
          Pin_G17: PortMuxPinName=MIBSPI5SIMO[3], DMM_DATA[11], PortMuxPinFunc=PORT_PIN_MUX_MIBSPI5SIMO_3, PortMuxPinRegId=28, PortMuxPinRegPos=0, PortMuxPinNumberPackage1=G17, PortMuxPinNumberPackage2=-, PortMuxPinDirection=PORT_MUX_PIN_DIR_OUTPUT
          Pin_J18_98: PortMuxPinName=MIBSPI5SOMI[0], DMM_DATA[12], MII_TXD[0], RMII_TXD[0], PortMuxPinFunc=PORT_PIN_MUX_MIBSPI5SOMI_0, PortMuxPinRegId=13, PortMuxPinRegPos=0, PortMuxPinNumberPackage1=J18, PortMuxPinNumberPackage2=98, PortMuxPinDirection=PORT_MUX_PIN_DIR_OUTPUT
          Pin_E17: PortMuxPinName=MIBSPI5SOMI[1], DMM_DATA[13], PortMuxPinFunc=PORT_PIN_MUX_MIBSPI5SOMI_1, PortMuxPinRegId=28, PortMuxPinRegPos=8, PortMuxPinNumberPackage1=E17, PortMuxPinNumberPackage2=-, PortMuxPinDirection=PORT_MUX_PIN_DIR_OUTPUT
          Pin_H16: PortMuxPinName=MIBSPI5SOMI[2], DMM_DATA[14], PortMuxPinFunc=PORT_PIN_MUX_MIBSPI5SOMI_2, PortMuxPinRegId=28, PortMuxPinRegPos=16, PortMuxPinNumberPackage1=H16, PortMuxPinNumberPackage2=-, PortMuxPinDirection=PORT_MUX_PIN_DIR_OUTPUT
          Pin_G16: PortMuxPinName=MIBSPI5SOMI[3], DMM_DATA[15], PortMuxPinFunc=PORT_PIN_MUX_MIBSPI5SOMI_3, PortMuxPinRegId=28, PortMuxPinRegPos=24, PortMuxPinNumberPackage1=G16, PortMuxPinNumberPackage2=-, PortMuxPinDirection=PORT_MUX_PIN_DIR_OUTPUT
          Pin_K18_25: PortMuxPinName=NHET1[0], SPI4CLK, PortMuxPinFunc=PORT_PIN_MUX_NHET1_0, PortMuxPinRegId=5, PortMuxPinRegPos=0, PortMuxPinNumberPackage1=K18, PortMuxPinNumberPackage2=25, PortMuxPinDirection=PORT_MUX_PIN_DIR_OUTPUT
          Pin_K18_25_IN: PortMuxPinName=NHET1[0], SPI4CLK, PortMuxPinFunc=PORT_PIN_MUX_NHET1_0, PortMuxPinRegId=23, PortMuxPinRegPos=8, PortMuxPinNumberPackage1=K18, PortMuxPinNumberPackage2=25, PortMuxPinDirection=PORT_MUX_PIN_DIR_INPUT
          Pin_V2_23: PortMuxPinName=NHET1[01], SPI4NENA, NHET2[8], PortMuxPinFunc=PORT_PIN_MUX_NHET2_8, PortMuxPinRegId=4, PortMuxPinRegPos=16, PortMuxPinNumberPackage1=V2, PortMuxPinNumberPackage2=23, PortMuxPinDirection=PORT_MUX_PIN_DIR_OUTPUT
          Pin_W5_30: PortMuxPinName=NHET1[02], SPI4SIMO, PortMuxPinFunc=PORT_PIN_MUX_NHET1_02, PortMuxPinRegId=5, PortMuxPinRegPos=8, PortMuxPinNumberPackage1=W5, PortMuxPinNumberPackage2=30, PortMuxPinDirection=PORT_MUX_PIN_DIR_OUTPUT
          Pin_W5_30_IN: PortMuxPinName=NHET1[02], SPI4SIMO, PortMuxPinFunc=PORT_PIN_MUX_NHET1_02, PortMuxPinRegId=23, PortMuxPinRegPos=16, PortMuxPinNumberPackage1=W5, PortMuxPinNumberPackage2=30, PortMuxPinDirection=PORT_MUX_PIN_DIR_INPUT
          Pin_U1_24: PortMuxPinName=NHET1[03], SPI4NCS[0], NHET2[10], PortMuxPinFunc=PORT_PIN_MUX_NHET2_10, PortMuxPinRegId=4, PortMuxPinRegPos=24, PortMuxPinNumberPackage1=U1, PortMuxPinNumberPackage2=24, PortMuxPinDirection=PORT_MUX_PIN_DIR_OUTPUT
          Pin_V6_31: PortMuxPinName=NHET1[05], SPI4SOMI, NHET2[12], PortMuxPinFunc=PORT_PIN_MUX_NHET2_12, PortMuxPinRegId=5, PortMuxPinRegPos=16, PortMuxPinNumberPackage1=V6, PortMuxPinNumberPackage2=31, PortMuxPinDirection=PORT_MUX_PIN_DIR_OUTPUT
          Pin_V6_31_IN: PortMuxPinName=NHET1[05], SPI4SOMI, PortMuxPinFunc=PORT_PIN_MUX_NHET1_05, PortMuxPinRegId=23, PortMuxPinRegPos=24, PortMuxPinNumberPackage1=V6, PortMuxPinNumberPackage2=31, PortMuxPinDirection=PORT_MUX_PIN_DIR_INPUT
          Pin_W3_38: PortMuxPinName=NHET1[06], SCIRX, PortMuxPinFunc=PORT_PIN_MUX_NHET1_06, PortMuxPinRegId=7, PortMuxPinRegPos=16, PortMuxPinNumberPackage1=W3, PortMuxPinNumberPackage2=38, PortMuxPinDirection=PORT_MUX_PIN_DIR_OUTPUT
          Pin_T1_33: PortMuxPinName=NHET1[07], Reserved, Reserved, NHET2[14], PortMuxPinFunc=PORT_PIN_MUX_NHET2_14, PortMuxPinRegId=6, PortMuxPinRegPos=0, PortMuxPinNumberPackage1=T1, PortMuxPinNumberPackage2=33, PortMuxPinDirection=PORT_MUX_PIN_DIR_OUTPUT
          Pin_E18_106: PortMuxPinName=NHET1[08], MIBSPI1SIMO[1], MII_TXD[3], PortMuxPinFunc=PORT_PIN_MUX_NHET1_08, PortMuxPinRegId=14, PortMuxPinRegPos=0, PortMuxPinNumberPackage1=E18, PortMuxPinNumberPackage2=106, PortMuxPinDirection=PORT_MUX_PIN_DIR_OUTPUT
          Pin_V7_35: PortMuxPinName=NHET1[09], NHET2[16], PortMuxPinFunc=PORT_PIN_MUX_NHET1_09, PortMuxPinRegId=6, PortMuxPinRegPos=16, PortMuxPinNumberPackage1=V7, PortMuxPinNumberPackage2=35, PortMuxPinDirection=PORT_MUX_PIN_DIR_OUTPUT
          Pin_D19_118: PortMuxPinName=NHET1[10], MII_TX_CLK, Reserved, MII_TX_AVCLK4, PortMuxPinFunc=PORT_PIN_MUX_NHET1_10, PortMuxPinRegId=17, PortMuxPinRegPos=0, PortMuxPinNumberPackage1=D19, PortMuxPinNumberPackage2=118, PortMuxPinDirection=PORT_MUX_PIN_DIR_OUTPUT
          Pin_E3_6: PortMuxPinName=NHET1[11], MIBSPI3NCS[4], NHET2[18], PortMuxPinFunc=PORT_PIN_MUX_NHET2_18, PortMuxPinRegId=1, PortMuxPinRegPos=8, PortMuxPinNumberPackage1=E3, PortMuxPinNumberPackage2=6, PortMuxPinDirection=PORT_MUX_PIN_DIR_OUTPUT
          Pin_B4_124: PortMuxPinName=NHET1[12], MII_CRS, RMII_CRS_DV, PortMuxPinFunc=PORT_PIN_MUX_NHET1_12, PortMuxPinRegId=17, PortMuxPinRegPos=16, PortMuxPinNumberPackage1=B4, PortMuxPinNumberPackage2=124, PortMuxPinDirection=PORT_MUX_PIN_DIR_OUTPUT
          Pin_N2_39: PortMuxPinName=NHET1[13], SCITX, PortMuxPinFunc=PORT_PIN_MUX_NHET1_13, PortMuxPinRegId=8, PortMuxPinRegPos=0, PortMuxPinNumberPackage1=N2, PortMuxPinNumberPackage2=39, PortMuxPinDirection=PORT_MUX_PIN_DIR_OUTPUT
          Pin_N1_41: PortMuxPinName=NHET1[15], MIBSPI1NCS[4], PortMuxPinFunc=PORT_PIN_MUX_NHET1_15, PortMuxPinRegId=8, PortMuxPinRegPos=16, PortMuxPinNumberPackage1=N1, PortMuxPinNumberPackage2=41, PortMuxPinDirection=PORT_MUX_PIN_DIR_OUTPUT
          Pin_P1_91: PortMuxPinName=NHET1[24], MIBSPI1NCS[5], MII_RXD[0], RMII_RXD[0], PortMuxPinFunc=PORT_PIN_MUX_NHET1_24, PortMuxPinRegId=11, PortMuxPinRegPos=24, PortMuxPinNumberPackage1=P1, PortMuxPinNumberPackage2=91, PortMuxPinDirection=PORT_MUX_PIN_DIR_OUTPUT
          Pin_A14_92: PortMuxPinName=NHET1[26], MII_RXD[1], RMII_RXD[1], PortMuxPinFunc=PORT_PIN_MUX_NHET1_26, PortMuxPinRegId=12, PortMuxPinRegPos=0, PortMuxPinNumberPackage1=A14, PortMuxPinNumberPackage2=92, PortMuxPinDirection=PORT_MUX_PIN_DIR_OUTPUT
          Pin_K19_107: PortMuxPinName=NHET1[28], MII_RXCLK, RMII_REFCLK, MII_RX_AVCLK4, PortMuxPinFunc=PORT_PIN_MUX_NHET1_28, PortMuxPinRegId=14, PortMuxPinRegPos=8, PortMuxPinNumberPackage1=K19, PortMuxPinNumberPackage2=107, PortMuxPinDirection=PORT_MUX_PIN_DIR_OUTPUT
          Pin_B11_127: PortMuxPinName=NHET1[30], MII_RX_DV, PortMuxPinFunc=PORT_PIN_MUX_NHET1_30, PortMuxPinRegId=19, PortMuxPinRegPos=8, PortMuxPinNumberPackage1=B11, PortMuxPinNumberPackage2=127, PortMuxPinDirection=PORT_MUX_PIN_DIR_OUTPUT
          Pin_D3_54: PortMuxPinName=SPI2NENA, SPI2NCS[1], PortMuxPinFunc=PORT_PIN_MUX_SPI2NENA, PortMuxPinRegId=29, PortMuxPinRegPos=0, PortMuxPinNumberPackage1=D3, PortMuxPinNumberPackage2=54, PortMuxPinDirection=PORT_MUX_PIN_DIR_OUTPUT
      19 x PortContainer, all with PortAvailablePackage1=true:
        GIOB: PortNumberOfPortPins=8, PortUse=false, PortName=GIO B, PortRegPostfix=GIOB, PortAvailablePackage0=true, PortAvailablePackage2=true, PortAvailablePackage3=false, PortAvailablePackage4=false, PortRegBaseAddr=4294425680, PortRegStructure=PORT_REG_STRUCT_REGULAR_NO_FUNC, PortContainsPrivReg=false
          8 x PortPin, all with PortPinDirection=PORT_PIN_IN, PortPinDirectionChangeable=false, PortPinInitialMode=PORT_PIN_MODE_DIO, PortPinLevelValue=PORT_PIN_LEVEL_LOW, PortPinMode=PORT_PIN_MODE_DIO, PortPinOpenDrain=PORT_PUSH_PULL, PortPinPullSelect=PORT_PULL_UP, PortPinRefresh=false, PortPinChannelName=(unset), PortPinAvailablePackage0=true, PortPinAvailablePackage1=true, PortPinAvailablePackage2=true, PortPinAvailablePackage3=false, PortPinAvailablePackage4=false, PortPinSlewRate=PORT_PIN_SLEW_RATE_NA:
            PortPinGioB_{0..7}: PortPinId={0..7}, PortPinName=GIOB{0..7}
        CAN1: PortNumberOfPortPins=2, PortUse=false, PortName=CAN 1, PortRegPostfix=CAN1, PortAvailablePackage0=false, PortAvailablePackage2=true, PortAvailablePackage3=false, PortAvailablePackage4=false, PortRegBaseAddr=4294434272, PortRegStructure=PORT_REG_STRUCT_SHORT, PortContainsPrivReg=true
          PortPinCan1_0 (PortPin):
            PortPinDirection = PORT_PIN_IN
            PortPinDirectionChangeable = false
            PortPinId = 0
            PortPinInitialMode = PORT_PIN_MODE_CAN
            PortPinLevelValue = PORT_PIN_LEVEL_LOW
            PortPinMode = PORT_PIN_MODE_DIO
            PortPinOpenDrain = PORT_PUSH_PULL
            PortPinPullSelect = PORT_PULL_UP
            PortPinRefresh = true
            PortPinChannelName = (unset)
            PortPinAvailablePackage0 = false
            PortPinAvailablePackage1 = true
            PortPinAvailablePackage2 = true
            PortPinAvailablePackage3 = false
            PortPinAvailablePackage4 = false
            PortPinSlewRate = PORT_PIN_SLEW_RATE_NA
            PortPinName = CAN1TX
          PortPinCan1_1 (PortPin):
            PortPinDirection = PORT_PIN_IN
            PortPinDirectionChangeable = false
            PortPinId = 1
            PortPinInitialMode = PORT_PIN_MODE_CAN
            PortPinLevelValue = PORT_PIN_LEVEL_LOW
            PortPinMode = PORT_PIN_MODE_DIO
            PortPinOpenDrain = PORT_PUSH_PULL
            PortPinPullSelect = PORT_PULL_UP
            PortPinRefresh = false
            PortPinChannelName = (unset)
            PortPinAvailablePackage0 = false
            PortPinAvailablePackage1 = true
            PortPinAvailablePackage2 = true
            PortPinAvailablePackage3 = false
            PortPinAvailablePackage4 = false
            PortPinSlewRate = PORT_PIN_SLEW_RATE_NA
            PortPinName = CAN1RX
        CAN2: PortNumberOfPortPins=2, PortUse=false, PortName=CAN 2, PortRegPostfix=CAN2, PortAvailablePackage0=false, PortAvailablePackage2=true, PortAvailablePackage3=false, PortAvailablePackage4=false, PortRegBaseAddr=4294434784, PortRegStructure=PORT_REG_STRUCT_SHORT, PortContainsPrivReg=true
          PortPinCan2_0 (PortPin):
            PortPinDirection = PORT_PIN_IN
            PortPinDirectionChangeable = false
            PortPinId = 0
            PortPinInitialMode = PORT_PIN_MODE_CAN
            PortPinLevelValue = PORT_PIN_LEVEL_LOW
            PortPinMode = PORT_PIN_MODE_DIO
            PortPinOpenDrain = PORT_PUSH_PULL
            PortPinPullSelect = PORT_PULL_UP
            PortPinRefresh = false
            PortPinChannelName = (unset)
            PortPinAvailablePackage0 = false
            PortPinAvailablePackage1 = true
            PortPinAvailablePackage2 = true
            PortPinAvailablePackage3 = false
            PortPinAvailablePackage4 = false
            PortPinSlewRate = PORT_PIN_SLEW_RATE_NA
            PortPinName = CAN2TX
          PortPinCan2_1 (PortPin):
            PortPinDirection = PORT_PIN_IN
            PortPinDirectionChangeable = false
            PortPinId = 1
            PortPinInitialMode = PORT_PIN_MODE_CAN
            PortPinLevelValue = PORT_PIN_LEVEL_LOW
            PortPinMode = PORT_PIN_MODE_DIO
            PortPinOpenDrain = PORT_PUSH_PULL
            PortPinPullSelect = PORT_PULL_UP
            PortPinRefresh = false
            PortPinChannelName = (unset)
            PortPinAvailablePackage0 = false
            PortPinAvailablePackage1 = true
            PortPinAvailablePackage2 = true
            PortPinAvailablePackage3 = false
            PortPinAvailablePackage4 = false
            PortPinSlewRate = PORT_PIN_SLEW_RATE_NA
            PortPinName = CAN2RX
        CAN3: PortNumberOfPortPins=2, PortUse=true, PortName=CAN 3, PortRegPostfix=CAN3, PortAvailablePackage0=false, PortAvailablePackage2=true, PortAvailablePackage3=false, PortAvailablePackage4=false, PortRegBaseAddr=4294435296, PortRegStructure=PORT_REG_STRUCT_SHORT, PortContainsPrivReg=true
          PortPinCan3_0 (PortPin):
            PortPinDirection = PORT_PIN_OUT
            PortPinDirectionChangeable = false
            PortPinId = 0
            PortPinInitialMode = PORT_PIN_MODE_DIO
            PortPinLevelValue = PORT_PIN_LEVEL_LOW
            PortPinMode = PORT_PIN_MODE_DIO
            PortPinOpenDrain = PORT_PUSH_PULL
            PortPinPullSelect = PORT_PULL_UP
            PortPinRefresh = false
            PortPinChannelName = WdReset
            PortPinAvailablePackage0 = false
            PortPinAvailablePackage1 = true
            PortPinAvailablePackage2 = true
            PortPinAvailablePackage3 = false
            PortPinAvailablePackage4 = false
            PortPinSlewRate = PORT_PIN_SLEW_RATE_NA
            PortPinName = CAN3TX
          PortPinCan3_1 (PortPin):
            PortPinDirection = PORT_PIN_OUT
            PortPinDirectionChangeable = false
            PortPinId = 1
            PortPinInitialMode = PORT_PIN_MODE_DIO
            PortPinLevelValue = PORT_PIN_LEVEL_LOW
            PortPinMode = PORT_PIN_MODE_DIO
            PortPinOpenDrain = PORT_PUSH_PULL
            PortPinPullSelect = PORT_PULL_UP
            PortPinRefresh = false
            PortPinChannelName = WdMonitor
            PortPinAvailablePackage0 = false
            PortPinAvailablePackage1 = true
            PortPinAvailablePackage2 = true
            PortPinAvailablePackage3 = false
            PortPinAvailablePackage4 = false
            PortPinSlewRate = PORT_PIN_SLEW_RATE_NA
            PortPinName = CAN3RX
        LIN: PortNumberOfPortPins=2, PortUse=false, PortName=LIN, PortRegPostfix=LIN, PortAvailablePackage0=false, PortAvailablePackage2=true, PortAvailablePackage3=false, PortAvailablePackage4=false, PortRegBaseAddr=4294435900, PortRegStructure=PORT_REG_STRUCT_REGULAR_SLEW_1, PortContainsPrivReg=false
          PortPinLin1_0 (PortPin):
            PortPinDirection = PORT_PIN_IN
            PortPinDirectionChangeable = false
            PortPinId = 1
            PortPinInitialMode = PORT_PIN_MODE_DIO
            PortPinLevelValue = PORT_PIN_LEVEL_LOW
            PortPinMode = PORT_PIN_MODE_DIO
            PortPinOpenDrain = PORT_PUSH_PULL
            PortPinPullSelect = PORT_PULL_UP
            PortPinRefresh = false
            PortPinChannelName = (unset)
            PortPinAvailablePackage0 = false
            PortPinAvailablePackage1 = true
            PortPinAvailablePackage2 = true
            PortPinAvailablePackage3 = false
            PortPinAvailablePackage4 = false
            PortPinSlewRate = PORT_PIN_SLEW_RATE_NA
            PortPinName = LINRX
          PortPinLin1_1 (PortPin):
            PortPinDirection = PORT_PIN_IN
            PortPinDirectionChangeable = false
            PortPinId = 2
            PortPinInitialMode = PORT_PIN_MODE_DIO
            PortPinLevelValue = PORT_PIN_LEVEL_LOW
            PortPinMode = PORT_PIN_MODE_DIO
            PortPinOpenDrain = PORT_PUSH_PULL
            PortPinPullSelect = PORT_PULL_UP
            PortPinRefresh = false
            PortPinChannelName = (unset)
            PortPinAvailablePackage0 = false
            PortPinAvailablePackage1 = true
            PortPinAvailablePackage2 = true
            PortPinAvailablePackage3 = false
            PortPinAvailablePackage4 = false
            PortPinSlewRate = PORT_PIN_SLEW_RATE_NA
            PortPinName = LINTX
        SCI: PortNumberOfPortPins=2, PortUse=false, PortName=SCI, PortRegPostfix=SCI, PortAvailablePackage0=false, PortAvailablePackage2=true, PortAvailablePackage3=false, PortAvailablePackage4=false, PortRegBaseAddr=4294436156, PortRegStructure=PORT_REG_STRUCT_REGULAR_SLEW_1, PortContainsPrivReg=false
          PortPinSci1_0 (PortPin):
            PortPinDirection = PORT_PIN_IN
            PortPinDirectionChangeable = false
            PortPinId = 1
            PortPinInitialMode = PORT_PIN_MODE_DIO
            PortPinLevelValue = PORT_PIN_LEVEL_LOW
            PortPinMode = PORT_PIN_MODE_DIO
            PortPinOpenDrain = PORT_PUSH_PULL
            PortPinPullSelect = PORT_PULL_UP
            PortPinRefresh = false
            PortPinChannelName = (unset)
            PortPinAvailablePackage0 = false
            PortPinAvailablePackage1 = true
            PortPinAvailablePackage2 = true
            PortPinAvailablePackage3 = false
            PortPinAvailablePackage4 = false
            PortPinSlewRate = PORT_PIN_SLEW_RATE_NA
            PortPinName = SCIRX
          PortPinSci1_1 (PortPin):
            PortPinDirection = PORT_PIN_IN
            PortPinDirectionChangeable = false
            PortPinId = 2
            PortPinInitialMode = PORT_PIN_MODE_DIO
            PortPinLevelValue = PORT_PIN_LEVEL_LOW
            PortPinMode = PORT_PIN_MODE_DIO
            PortPinOpenDrain = PORT_PUSH_PULL
            PortPinPullSelect = PORT_PULL_UP
            PortPinRefresh = false
            PortPinChannelName = (unset)
            PortPinAvailablePackage0 = false
            PortPinAvailablePackage1 = true
            PortPinAvailablePackage2 = true
            PortPinAvailablePackage3 = false
            PortPinAvailablePackage4 = false
            PortPinSlewRate = PORT_PIN_SLEW_RATE_NA
            PortPinName = SCITX
        I2C: PortNumberOfPortPins=2, PortUse=false, PortName=I2C, PortRegPostfix=IIC, PortAvailablePackage0=false, PortAvailablePackage2=true, PortAvailablePackage3=false, PortAvailablePackage4=false, PortRegBaseAddr=4294431816, PortRegStructure=PORT_REG_STRUCT_REGULAR_SLEW_1, PortContainsPrivReg=false
          PortPinIic_0 (PortPin):
            PortPinDirection = PORT_PIN_OUT
            PortPinDirectionChangeable = false
            PortPinId = 1
            PortPinInitialMode = PORT_PIN_MODE_DIO
            PortPinLevelValue = PORT_PIN_LEVEL_LOW
            PortPinMode = PORT_PIN_MODE_DIO
            PortPinOpenDrain = PORT_OPEN_DRAIN
            PortPinPullSelect = PORT_PULL_UP
            PortPinRefresh = false
            PortPinChannelName = (unset)
            PortPinAvailablePackage0 = false
            PortPinAvailablePackage1 = true
            PortPinAvailablePackage2 = true
            PortPinAvailablePackage3 = false
            PortPinAvailablePackage4 = false
            PortPinSlewRate = PORT_PIN_SLEW_RATE_NA
            PortPinName = I2C_SCL
          PortPinIic_1 (PortPin):
            PortPinDirection = PORT_PIN_OUT
            PortPinDirectionChangeable = false
            PortPinId = 2
            PortPinInitialMode = PORT_PIN_MODE_DIO
            PortPinLevelValue = PORT_PIN_LEVEL_LOW
            PortPinMode = PORT_PIN_MODE_DIO
            PortPinOpenDrain = PORT_OPEN_DRAIN
            PortPinPullSelect = PORT_PULL_UP
            PortPinRefresh = false
            PortPinChannelName = (unset)
            PortPinAvailablePackage0 = false
            PortPinAvailablePackage1 = true
            PortPinAvailablePackage2 = true
            PortPinAvailablePackage3 = false
            PortPinAvailablePackage4 = false
            PortPinSlewRate = PORT_PIN_SLEW_RATE_NA
            PortPinName = I2C_SDA
        SPI1: PortNumberOfPortPins=16, PortUse=false, PortName=MBSPI 1, PortRegPostfix=SPI1, PortAvailablePackage0=true, PortAvailablePackage2=true, PortAvailablePackage3=true, PortAvailablePackage4=true, PortRegBaseAddr=4294439956, PortRegStructure=PORT_REG_STRUCT_REGULAR_SLEW_2, PortContainsPrivReg=false
          12 x PortPin, all with PortPinDirection=PORT_PIN_IN, PortPinDirectionChangeable=false, PortPinInitialMode=PORT_PIN_MODE_SPI, PortPinLevelValue=PORT_PIN_LEVEL_LOW, PortPinMode=PORT_PIN_MODE_DIO, PortPinOpenDrain=PORT_PUSH_PULL, PortPinPullSelect=PORT_PULL_UP, PortPinRefresh=false, PortPinChannelName=(unset), PortPinAvailablePackage0=true, PortPinAvailablePackage1=true, PortPinAvailablePackage2=true, PortPinAvailablePackage3=true, PortPinSlewRate=PORT_PIN_SLEW_RATE_NA:
            PortPinSpi1_0: PortPinId=9, PortPinAvailablePackage4=true, PortPinName=SPI1CLK
            PortPinSpi1_1: PortPinId=0, PortPinAvailablePackage4=true, PortPinName=SPI1NCS0
            PortPinSpi1_2: PortPinId=1, PortPinAvailablePackage4=true, PortPinName=SPI1NCS1
            PortPinSpi1_3: PortPinId=2, PortPinAvailablePackage4=false, PortPinName=SPI1NCS2
            PortPinSpi1_4: PortPinId=3, PortPinAvailablePackage4=false, PortPinName=SPI1NCS3
            PortPinSpi1_5: PortPinId=4, PortPinAvailablePackage4=false, PortPinName=SPI1NCS4
            PortPinSpi1_6: PortPinId=5, PortPinAvailablePackage4=false, PortPinName=SPI1NCS5
            PortPinSpi1_7: PortPinId=8, PortPinAvailablePackage4=true, PortPinName=SPI1NENA
            PortPinSpi1_8: PortPinId=10, PortPinAvailablePackage4=true, PortPinName=SPI1SIMO0
            PortPinSpi1_9: PortPinId=17, PortPinAvailablePackage4=true, PortPinName=SPI1SIMO1
            PortPinSpi1_10: PortPinId=11, PortPinAvailablePackage4=true, PortPinName=SPI1SOMI0
            PortPinSpi1_11: PortPinId=25, PortPinAvailablePackage4=true, PortPinName=SPI1SOMI1
        SPI2: PortNumberOfPortPins=8, PortUse=false, PortName=SPI 2, PortRegPostfix=SPI2, PortAvailablePackage0=false, PortAvailablePackage2=true, PortAvailablePackage3=false, PortAvailablePackage4=false, PortRegBaseAddr=4294440468, PortRegStructure=PORT_REG_STRUCT_REGULAR_SLEW_2, PortContainsPrivReg=false
          6 x PortPin, all with PortPinDirection=PORT_PIN_IN, PortPinDirectionChangeable=false, PortPinInitialMode=PORT_PIN_MODE_DIO, PortPinLevelValue=PORT_PIN_LEVEL_LOW, PortPinMode=PORT_PIN_MODE_DIO, PortPinOpenDrain=PORT_PUSH_PULL, PortPinPullSelect=PORT_PULL_UP, PortPinRefresh=false, PortPinChannelName=(unset), PortPinAvailablePackage0=false, PortPinAvailablePackage1=true, PortPinAvailablePackage2=true, PortPinAvailablePackage3=false, PortPinAvailablePackage4=false, PortPinSlewRate=PORT_PIN_SLEW_RATE_NA:
            PortPinSpi2_0: PortPinId=9, PortPinName=SPI2CLK
            PortPinSpi2_1: PortPinId=0, PortPinName=SPI2NCS0
            PortPinSpi2_2: PortPinId=1, PortPinName=SPI2NCS1
            PortPinSpi2_5: PortPinId=8, PortPinName=SPI2NENA
            PortPinSpi2_6: PortPinId=10, PortPinName=SPI2SIMO
            PortPinSpi2_7: PortPinId=11, PortPinName=SPI2SOMI
        SPI3: PortNumberOfPortPins=16, PortUse=true, PortName=MBSPI 3, PortRegPostfix=SPI3, PortAvailablePackage0=true, PortAvailablePackage2=true, PortAvailablePackage3=true, PortAvailablePackage4=true, PortRegBaseAddr=4294440980, PortRegStructure=PORT_REG_STRUCT_REGULAR_SLEW_2, PortContainsPrivReg=false
          10 x PortPin, all with PortPinDirectionChangeable=false, PortPinLevelValue=PORT_PIN_LEVEL_LOW, PortPinMode=PORT_PIN_MODE_DIO, PortPinOpenDrain=PORT_PUSH_PULL, PortPinPullSelect=PORT_PULL_UP, PortPinRefresh=false, PortPinAvailablePackage0=true, PortPinAvailablePackage1=true, PortPinAvailablePackage2=true, PortPinAvailablePackage3=true, PortPinSlewRate=PORT_PIN_SLEW_RATE_NA:
            PortPinSpi3_0: PortPinDirection=PORT_PIN_OUT, PortPinId=9, PortPinInitialMode=PORT_PIN_MODE_SPI, PortPinChannelName=MS_SCLK1, PortPinAvailablePackage4=true, PortPinName=SPI3CLK
            PortPinSpi3_1: PortPinDirection=PORT_PIN_OUT, PortPinId=0, PortPinInitialMode=PORT_PIN_MODE_SPI, PortPinChannelName=MS_CSN1, PortPinAvailablePackage4=true, PortPinName=SPI3NCS0
            PortPinSpi3_2: PortPinDirection=PORT_PIN_OUT, PortPinId=1, PortPinInitialMode=PORT_PIN_MODE_DIO, PortPinChannelName=FetDrvReset, PortPinAvailablePackage4=true, PortPinName=SPI3NCS1
            PortPinSpi3_3: PortPinDirection=PORT_PIN_IN, PortPinId=2, PortPinInitialMode=PORT_PIN_MODE_SPI, PortPinChannelName=(unset), PortPinAvailablePackage4=false, PortPinName=SPI3NCS2
            PortPinSpi3_4: PortPinDirection=PORT_PIN_IN, PortPinId=3, PortPinInitialMode=PORT_PIN_MODE_SPI, PortPinChannelName=(unset), PortPinAvailablePackage4=false, PortPinName=SPI3NCS3
            PortPinSpi3_7: PortPinDirection=PORT_PIN_IN, PortPinId=8, PortPinInitialMode=PORT_PIN_MODE_SPI, PortPinChannelName=(unset), PortPinAvailablePackage4=true, PortPinName=SPI3NENA
            PortPinSpi3_8: PortPinDirection=PORT_PIN_OUT, PortPinId=10, PortPinInitialMode=PORT_PIN_MODE_SPI, PortPinChannelName=MS_MOSI1, PortPinAvailablePackage4=true, PortPinName=SPI3SIMO
            PortPinSpi3_10: PortPinDirection=PORT_PIN_IN, PortPinId=11, PortPinInitialMode=PORT_PIN_MODE_SPI, PortPinChannelName=MS_MISO1, PortPinAvailablePackage4=true, PortPinName=SPI3SOMI
            PortPinSpi3_5: PortPinDirection=PORT_PIN_IN, PortPinId=4, PortPinInitialMode=PORT_PIN_MODE_SPI, PortPinChannelName=(unset), PortPinAvailablePackage4=true, PortPinName=SPI3NCS4
            PortPinSpi3_6: PortPinDirection=PORT_PIN_IN, PortPinId=5, PortPinInitialMode=PORT_PIN_MODE_SPI, PortPinChannelName=(unset), PortPinAvailablePackage4=true, PortPinName=SPI3NCS5
        SPI4: PortNumberOfPortPins=8, PortUse=false, PortName=SPI 4, PortRegPostfix=SPI4, PortAvailablePackage0=false, PortAvailablePackage2=true, PortAvailablePackage3=false, PortAvailablePackage4=false, PortRegBaseAddr=4294441492, PortRegStructure=PORT_REG_STRUCT_REGULAR_SLEW_2, PortContainsPrivReg=false
          5 x PortPin, all with PortPinDirection=PORT_PIN_IN, PortPinDirectionChangeable=false, PortPinInitialMode=PORT_PIN_MODE_DIO, PortPinLevelValue=PORT_PIN_LEVEL_LOW, PortPinMode=PORT_PIN_MODE_DIO, PortPinOpenDrain=PORT_PUSH_PULL, PortPinPullSelect=PORT_PULL_UP, PortPinRefresh=false, PortPinChannelName=(unset), PortPinAvailablePackage0=false, PortPinAvailablePackage1=true, PortPinAvailablePackage2=true, PortPinAvailablePackage3=false, PortPinAvailablePackage4=false, PortPinSlewRate=PORT_PIN_SLEW_RATE_NA:
            PortPinSpi4_0: PortPinId=9, PortPinName=SPI4CLK
            PortPinSpi4_1: PortPinId=0, PortPinName=SPI4NCS0
            PortPinSpi4_5: PortPinId=8, PortPinName=SPI4NENA
            PortPinSpi4_6: PortPinId=10, PortPinName=SPI4SIMO
            PortPinSpi4_7: PortPinId=11, PortPinName=SPI4SOMI
        SPI5: PortNumberOfPortPins=16, PortUse=true, PortName=MBSPI 5, PortRegPostfix=SPI5, PortAvailablePackage0=true, PortAvailablePackage2=true, PortAvailablePackage3=true, PortAvailablePackage4=true, PortRegBaseAddr=4294442004, PortRegStructure=PORT_REG_STRUCT_REGULAR_SLEW_2, PortContainsPrivReg=false
          14 x PortPin, all with PortPinDirectionChangeable=false, PortPinInitialMode=PORT_PIN_MODE_SPI, PortPinLevelValue=PORT_PIN_LEVEL_LOW, PortPinMode=PORT_PIN_MODE_DIO, PortPinOpenDrain=PORT_PUSH_PULL, PortPinRefresh=false, PortPinAvailablePackage0=true, PortPinAvailablePackage1=true, PortPinAvailablePackage2=true, PortPinAvailablePackage3=true, PortPinSlewRate=PORT_PIN_SLEW_RATE_NA:
            PortPinSpi5_0: PortPinDirection=PORT_PIN_OUT, PortPinId=9, PortPinPullSelect=PORT_PULL_UP, PortPinChannelName=MS_SCLK2, PortPinAvailablePackage4=true, PortPinName=SPI5CLK
            PortPinSpi5_1: PortPinDirection=PORT_PIN_OUT, PortPinId=0, PortPinPullSelect=PORT_PULL_UP, PortPinChannelName=MS_CSN2, PortPinAvailablePackage4=true, PortPinName=SPI5NCS0
            PortPinSpi5_2: PortPinDirection=PORT_PIN_IN, PortPinId=1, PortPinPullSelect=PORT_PULL_UP, PortPinChannelName=(unset), PortPinAvailablePackage4=true, PortPinName=SPI5NCS1
            PortPinSpi5_3: PortPinDirection=PORT_PIN_IN, PortPinId=2, PortPinPullSelect=PORT_PULL_UP, PortPinChannelName=(unset), PortPinAvailablePackage4=false, PortPinName=SPI5NCS2
            PortPinSpi5_4: PortPinDirection=PORT_PIN_IN, PortPinId=3, PortPinPullSelect=PORT_PULL_UP, PortPinChannelName=(unset), PortPinAvailablePackage4=false, PortPinName=SPI5NCS3
            PortPinSpi5_5: PortPinDirection=PORT_PIN_IN, PortPinId=8, PortPinPullSelect=PORT_PULL_DOWN, PortPinChannelName=(unset), PortPinAvailablePackage4=true, PortPinName=SPI5NENA
            PortPinSpi5_6: PortPinDirection=PORT_PIN_OUT, PortPinId=10, PortPinPullSelect=PORT_PULL_UP, PortPinChannelName=MS_MOSI2, PortPinAvailablePackage4=true, PortPinName=SPI5SIMO0
            PortPinSpi5_7: PortPinDirection=PORT_PIN_IN, PortPinId=17, PortPinPullSelect=PORT_PULL_UP, PortPinChannelName=(unset), PortPinAvailablePackage4=true, PortPinName=SPI5SIMO1
            PortPinSpi5_8: PortPinDirection=PORT_PIN_IN, PortPinId=18, PortPinPullSelect=PORT_PULL_UP, PortPinChannelName=(unset), PortPinAvailablePackage4=true, PortPinName=SPI5SIMO2
            PortPinSpi5_9: PortPinDirection=PORT_PIN_IN, PortPinId=19, PortPinPullSelect=PORT_PULL_UP, PortPinChannelName=(unset), PortPinAvailablePackage4=true, PortPinName=SPI5SIMO3
            PortPinSpi5_10: PortPinDirection=PORT_PIN_IN, PortPinId=11, PortPinPullSelect=PORT_PULL_UP, PortPinChannelName=MS_MISO2, PortPinAvailablePackage4=true, PortPinName=SPI5SOMI0
            PortPinSpi5_11: PortPinDirection=PORT_PIN_IN, PortPinId=25, PortPinPullSelect=PORT_PULL_UP, PortPinChannelName=(unset), PortPinAvailablePackage4=true, PortPinName=SPI5SOMI1
            PortPinSpi5_12: PortPinDirection=PORT_PIN_IN, PortPinId=26, PortPinPullSelect=PORT_PULL_UP, PortPinChannelName=(unset), PortPinAvailablePackage4=true, PortPinName=SPI5SOMI2
            PortPinSpi5_13: PortPinDirection=PORT_PIN_IN, PortPinId=27, PortPinPullSelect=PORT_PULL_UP, PortPinChannelName=(unset), PortPinAvailablePackage4=true, PortPinName=SPI5SOMI3
        NHET1: PortNumberOfPortPins=32, PortUse=true, PortName=NHET1, PortRegPostfix=NHET1, PortAvailablePackage0=false, PortAvailablePackage2=true, PortAvailablePackage3=false, PortAvailablePackage4=false, PortRegBaseAddr=4294424648, PortRegStructure=PORT_REG_STRUCT_REGULAR_NO_FUNC, PortContainsPrivReg=false
          32 x PortPin, all with PortPinDirectionChangeable=false, PortPinInitialMode=PORT_PIN_MODE_DIO, PortPinMode=PORT_PIN_MODE_DIO, PortPinPullSelect=PORT_PULL_DOWN, PortPinRefresh=false, PortPinAvailablePackage0=false, PortPinAvailablePackage1=true, PortPinAvailablePackage2=true, PortPinAvailablePackage3=false, PortPinAvailablePackage4=false, PortPinSlewRate=PORT_PIN_SLEW_RATE_NA:
            PortPinNHet1_0: PortPinDirection=PORT_PIN_IN, PortPinId=0, PortPinLevelValue=PORT_PIN_LEVEL_LOW, PortPinOpenDrain=PORT_PUSH_PULL, PortPinChannelName=GB_LOWER, PortPinName=NHET1_0
            PortPinNHet1_1: PortPinDirection=PORT_PIN_IN, PortPinId=1, PortPinLevelValue=PORT_PIN_LEVEL_LOW, PortPinOpenDrain=PORT_PUSH_PULL, PortPinChannelName=(unset), PortPinName=NHET1_1
            PortPinNHet1_2: PortPinDirection=PORT_PIN_IN, PortPinId=2, PortPinLevelValue=PORT_PIN_LEVEL_LOW, PortPinOpenDrain=PORT_PUSH_PULL, PortPinChannelName=GC_UPPER, PortPinName=NHET1_2
            PortPinNHet1_3: PortPinDirection=PORT_PIN_IN, PortPinId=3, PortPinLevelValue=PORT_PIN_LEVEL_LOW, PortPinOpenDrain=PORT_PUSH_PULL, PortPinChannelName=(unset), PortPinName=NHET1_3
            PortPinNHet1_4: PortPinDirection=PORT_PIN_IN, PortPinId=4, PortPinLevelValue=PORT_PIN_LEVEL_LOW, PortPinOpenDrain=PORT_PUSH_PULL, PortPinChannelName=FetDrvCntl, PortPinName=NHET1_4
            PortPinNHet1_5: PortPinDirection=PORT_PIN_IN, PortPinId=5, PortPinLevelValue=PORT_PIN_LEVEL_LOW, PortPinOpenDrain=PORT_PUSH_PULL, PortPinChannelName=GC_LOWER, PortPinName=NHET1_5
            PortPinNHet1_6: PortPinDirection=PORT_PIN_IN, PortPinId=6, PortPinLevelValue=PORT_PIN_LEVEL_LOW, PortPinOpenDrain=PORT_PUSH_PULL, PortPinChannelName=(unset), PortPinName=NHET1_6
            PortPinNHet1_7: PortPinDirection=PORT_PIN_IN, PortPinId=7, PortPinLevelValue=PORT_PIN_LEVEL_LOW, PortPinOpenDrain=PORT_PUSH_PULL, PortPinChannelName=(unset), PortPinName=NHET1_7
            PortPinNHet1_8: PortPinDirection=PORT_PIN_IN, PortPinId=8, PortPinLevelValue=PORT_PIN_LEVEL_LOW, PortPinOpenDrain=PORT_PUSH_PULL, PortPinChannelName=PwrSwitchEn, PortPinName=NHET1_8
            PortPinNHet1_9: PortPinDirection=PORT_PIN_IN, PortPinId=9, PortPinLevelValue=PORT_PIN_LEVEL_LOW, PortPinOpenDrain=PORT_PUSH_PULL, PortPinChannelName=(unset), PortPinName=NHET1_9
            PortPinNHet1_10: PortPinDirection=PORT_PIN_IN, PortPinId=10, PortPinLevelValue=PORT_PIN_LEVEL_LOW, PortPinOpenDrain=PORT_PUSH_PULL, PortPinChannelName=T1_SENT, PortPinName=NHET1_10
            PortPinNHet1_11: PortPinDirection=PORT_PIN_IN, PortPinId=11, PortPinLevelValue=PORT_PIN_LEVEL_LOW, PortPinOpenDrain=PORT_PUSH_PULL, PortPinChannelName=(unset), PortPinName=NHET1_11
            PortPinNHet1_12: PortPinDirection=PORT_PIN_OUT, PortPinId=12, PortPinLevelValue=PORT_PIN_LEVEL_LOW, PortPinOpenDrain=PORT_OPEN_DRAIN, PortPinChannelName=T1_SENT_Sync, PortPinName=NHET1_12
            PortPinNHet1_13: PortPinDirection=PORT_PIN_IN, PortPinId=13, PortPinLevelValue=PORT_PIN_LEVEL_LOW, PortPinOpenDrain=PORT_PUSH_PULL, PortPinChannelName=(unset), PortPinName=NHET1_13
            PortPinNHet1_14: PortPinDirection=PORT_PIN_OUT, PortPinId=14, PortPinLevelValue=PORT_PIN_LEVEL_LOW, PortPinOpenDrain=PORT_PUSH_PULL, PortPinChannelName=SPI_50us_Trigger, PortPinName=NHET1_14
            PortPinNHet1_15: PortPinDirection=PORT_PIN_OUT, PortPinId=15, PortPinLevelValue=PORT_PIN_LEVEL_LOW, PortPinOpenDrain=PORT_PUSH_PULL, PortPinChannelName=SysFault2, PortPinName=NHET1_15
            PortPinNHet1_16: PortPinDirection=PORT_PIN_OUT, PortPinId=16, PortPinLevelValue=PORT_PIN_LEVEL_LOW, PortPinOpenDrain=PORT_PUSH_PULL, PortPinChannelName=ePWM_Sync, PortPinName=NHET1_16
            PortPinNHet1_17: PortPinDirection=PORT_PIN_IN, PortPinId=17, PortPinLevelValue=PORT_PIN_LEVEL_LOW, PortPinOpenDrain=PORT_PUSH_PULL, PortPinChannelName=(unset), PortPinName=NHET1_17
            PortPinNHet1_18: PortPinDirection=PORT_PIN_OUT, PortPinId=18, PortPinLevelValue=PORT_PIN_LEVEL_LOW, PortPinOpenDrain=PORT_PUSH_PULL, PortPinChannelName=SPI_2m_Trigger, PortPinName=NHET1_18
            PortPinNHet1_19: PortPinDirection=PORT_PIN_IN, PortPinId=19, PortPinLevelValue=PORT_PIN_LEVEL_LOW, PortPinOpenDrain=PORT_PUSH_PULL, PortPinChannelName=(unset), PortPinName=NHET1_19
            PortPinNHet1_20: PortPinDirection=PORT_PIN_OUT, PortPinId=20, PortPinLevelValue=PORT_PIN_LEVEL_HIGH, PortPinOpenDrain=PORT_PUSH_PULL, PortPinChannelName=TODReset, PortPinName=NHET1_20
            PortPinNHet1_21: PortPinDirection=PORT_PIN_IN, PortPinId=21, PortPinLevelValue=PORT_PIN_LEVEL_LOW, PortPinOpenDrain=PORT_PUSH_PULL, PortPinChannelName=(unset), PortPinName=NHET1_21
            PortPinNHet1_22: PortPinDirection=PORT_PIN_IN, PortPinId=22, PortPinLevelValue=PORT_PIN_LEVEL_LOW, PortPinOpenDrain=PORT_PUSH_PULL, PortPinChannelName=OvrVoltFdbk, PortPinName=NHET1_22
            PortPinNHet1_23: PortPinDirection=PORT_PIN_IN, PortPinId=23, PortPinLevelValue=PORT_PIN_LEVEL_LOW, PortPinOpenDrain=PORT_PUSH_PULL, PortPinChannelName=(unset), PortPinName=NHET1_23
            PortPinNHet1_24: PortPinDirection=PORT_PIN_IN, PortPinId=24, PortPinLevelValue=PORT_PIN_LEVEL_LOW, PortPinOpenDrain=PORT_PUSH_PULL, PortPinChannelName=FetFlt1Data, PortPinName=NHET1_24
            PortPinNHet1_25: PortPinDirection=PORT_PIN_IN, PortPinId=25, PortPinLevelValue=PORT_PIN_LEVEL_LOW, PortPinOpenDrain=PORT_PUSH_PULL, PortPinChannelName=(unset), PortPinName=NHET1_25
            PortPinNHet1_26: PortPinDirection=PORT_PIN_IN, PortPinId=26, PortPinLevelValue=PORT_PIN_LEVEL_LOW, PortPinOpenDrain=PORT_PUSH_PULL, PortPinChannelName=FetFlt2Clk, PortPinName=NHET1_26
            PortPinNHet1_27: PortPinDirection=PORT_PIN_IN, PortPinId=27, PortPinLevelValue=PORT_PIN_LEVEL_LOW, PortPinOpenDrain=PORT_PUSH_PULL, PortPinChannelName=(unset), PortPinName=NHET1_27
            PortPinNHet1_28: PortPinDirection=PORT_PIN_IN, PortPinId=28, PortPinLevelValue=PORT_PIN_LEVEL_LOW, PortPinOpenDrain=PORT_PUSH_PULL, PortPinChannelName=T2_SENT, PortPinName=NHET1_28
            PortPinNHet1_29: PortPinDirection=PORT_PIN_IN, PortPinId=29, PortPinLevelValue=PORT_PIN_LEVEL_LOW, PortPinOpenDrain=PORT_PUSH_PULL, PortPinChannelName=(unset), PortPinName=NHET1_29
            PortPinNHet1_30: PortPinDirection=PORT_PIN_OUT, PortPinId=30, PortPinLevelValue=PORT_PIN_LEVEL_LOW, PortPinOpenDrain=PORT_OPEN_DRAIN, PortPinChannelName=T2_SENT_Sync, PortPinName=NHET1_30
            PortPinNHet1_31: PortPinDirection=PORT_PIN_IN, PortPinId=31, PortPinLevelValue=PORT_PIN_LEVEL_LOW, PortPinOpenDrain=PORT_PUSH_PULL, PortPinChannelName=(unset), PortPinName=NHET1_31
        NHET2: PortNumberOfPortPins=32, PortUse=true, PortName=NHET2, PortRegPostfix=NHET2, PortAvailablePackage0=false, PortAvailablePackage2=true, PortAvailablePackage3=false, PortAvailablePackage4=false, PortRegBaseAddr=4294424904, PortRegStructure=PORT_REG_STRUCT_REGULAR_NO_FUNC, PortContainsPrivReg=false
          18 x PortPin, all with PortPinDirection=PORT_PIN_IN, PortPinDirectionChangeable=false, PortPinInitialMode=PORT_PIN_MODE_DIO, PortPinLevelValue=PORT_PIN_LEVEL_LOW, PortPinMode=PORT_PIN_MODE_DIO, PortPinOpenDrain=PORT_PUSH_PULL, PortPinRefresh=false, PortPinAvailablePackage0=false, PortPinAvailablePackage1=true, PortPinAvailablePackage2=true, PortPinAvailablePackage3=false, PortPinAvailablePackage4=false, PortPinSlewRate=PORT_PIN_SLEW_RATE_NA:
            PortPinNHet2_{0..7}: PortPinId={0..7}, PortPinPullSelect=PORT_PULL_DOWN, PortPinChannelName=(unset), PortPinName=NHET2_{0..7}
            PortPinNHet2_8: PortPinId=8, PortPinPullSelect=PORT_PULL_DOWN, PortPinChannelName=PhaseC, PortPinName=NHET2_8
            PortPinNHet2_9: PortPinId=9, PortPinPullSelect=PORT_PULL_DOWN, PortPinChannelName=(unset), PortPinName=NHET2_9
            PortPinNHet2_10: PortPinId=10, PortPinPullSelect=PORT_PULL_DOWN, PortPinChannelName=PhaseA, PortPinName=NHET2_10
            PortPinNHet2_{11..15}: PortPinId={11..15}, PortPinPullSelect=PORT_PULL_DOWN, PortPinChannelName=(unset), PortPinName=NHET2_{11..15}
            PortPinNHet2_16: PortPinId=16, PortPinPullSelect=PORT_PULL_UP, PortPinChannelName=(unset), PortPinName=NHET2_16
            PortPinNHet2_18: PortPinId=18, PortPinPullSelect=PORT_PULL_DOWN, PortPinChannelName=PhaseB, PortPinName=NHET2_18
        SYS: PortNumberOfPortPins=1, PortUse=false, PortName=ECLK, PortRegPostfix=SYS, PortAvailablePackage0=false, PortAvailablePackage2=true, PortAvailablePackage3=false, PortAvailablePackage4=false, PortRegBaseAddr=4294967040, PortRegStructure=PORT_REG_STRUCT_REGULAR_SLEW_1, PortContainsPrivReg=false
          PortPinEcp_0 (PortPin):
            PortPinDirection = PORT_PIN_IN
            PortPinDirectionChangeable = false
            PortPinId = 0
            PortPinInitialMode = PORT_PIN_MODE_DIO
            PortPinLevelValue = PORT_PIN_LEVEL_LOW
            PortPinMode = PORT_PIN_MODE_DIO
            PortPinOpenDrain = PORT_PUSH_PULL
            PortPinPullSelect = PORT_PULL_DOWN
            PortPinRefresh = false
            PortPinChannelName = (unset)
            PortPinAvailablePackage0 = false
            PortPinAvailablePackage1 = true
            PortPinAvailablePackage2 = true
            PortPinAvailablePackage3 = false
            PortPinAvailablePackage4 = false
            PortPinSlewRate = PORT_PIN_SLEW_RATE_SLOW
            PortPinName = ECLK
        ADC1: PortNumberOfPortPins=1, PortUse=true, PortName=MibADC 1, PortRegPostfix=ADC1, PortAvailablePackage0=false, PortAvailablePackage2=true, PortAvailablePackage3=false, PortAvailablePackage4=false, PortRegBaseAddr=4294426872, PortRegStructure=PORT_REG_STRUCT_REGULAR_PERMUTED, PortContainsPrivReg=false
          PortPinADC1_0 (PortPin):
            PortPinDirection = PORT_PIN_IN
            PortPinDirectionChangeable = false
            PortPinId = 0
            PortPinInitialMode = PORT_PIN_MODE_DIO
            PortPinLevelValue = PORT_PIN_LEVEL_LOW
            PortPinMode = PORT_PIN_MODE_DIO
            PortPinOpenDrain = PORT_PUSH_PULL
            PortPinPullSelect = PORT_PULL_DOWN
            PortPinRefresh = false
            PortPinChannelName = EpsEn
            PortPinAvailablePackage0 = false
            PortPinAvailablePackage1 = true
            PortPinAvailablePackage2 = true
            PortPinAvailablePackage3 = false
            PortPinAvailablePackage4 = false
            PortPinSlewRate = PORT_PIN_SLEW_RATE_NA
            PortPinName = AD1EVT
        ADC2: PortNumberOfPortPins=1, PortUse=false, PortName=MibADC 2, PortRegPostfix=ADC2, PortAvailablePackage0=false, PortAvailablePackage2=true, PortAvailablePackage3=false, PortAvailablePackage4=false, PortRegBaseAddr=4294427384, PortRegStructure=PORT_REG_STRUCT_REGULAR_PERMUTED, PortContainsPrivReg=false
          PortPinADC2_0 (PortPin):
            PortPinDirection = PORT_PIN_IN
            PortPinDirectionChangeable = false
            PortPinId = 0
            PortPinInitialMode = PORT_PIN_MODE_DIO
            PortPinLevelValue = PORT_PIN_LEVEL_LOW
            PortPinMode = PORT_PIN_MODE_DIO
            PortPinOpenDrain = PORT_PUSH_PULL
            PortPinPullSelect = PORT_PULL_DOWN
            PortPinRefresh = false
            PortPinChannelName = (unset)
            PortPinAvailablePackage0 = false
            PortPinAvailablePackage1 = true
            PortPinAvailablePackage2 = true
            PortPinAvailablePackage3 = false
            PortPinAvailablePackage4 = false
            PortPinSlewRate = PORT_PIN_SLEW_RATE_NA
            PortPinName = AD2EVT
        RTP: PortNumberOfPortPins=19, PortUse=false, PortName=RTP, PortRegPostfix=RTP, PortAvailablePackage0=false, PortAvailablePackage2=true, PortAvailablePackage3=false, PortAvailablePackage4=false, PortRegBaseAddr=4294965812, PortRegStructure=PORT_REG_STRUCT_REGULAR_NO_SLEW, PortContainsPrivReg=false
          19 x PortPin, all with PortPinDirection=PORT_PIN_IN, PortPinDirectionChangeable=false, PortPinInitialMode=PORT_PIN_MODE_DIO, PortPinLevelValue=PORT_PIN_LEVEL_LOW, PortPinMode=PORT_PIN_MODE_DIO, PortPinOpenDrain=PORT_PUSH_PULL, PortPinPullSelect=PORT_PULL_UP, PortPinRefresh=false, PortPinChannelName=(unset), PortPinAvailablePackage0=false, PortPinAvailablePackage1=true, PortPinAvailablePackage2=true, PortPinAvailablePackage3=false, PortPinAvailablePackage4=false, PortPinSlewRate=PORT_PIN_SLEW_RATE_NA:
            PortPinRtp_{0..15}: PortPinId={0..15}, PortPinName=RPTDATA{0..15}
            PortPinRtp_16: PortPinId=16, PortPinName=RPTSYNC
            PortPinRtp_17: PortPinId=17, PortPinName=RPTCLK
            PortPinRtp_18: PortPinId=18, PortPinName=RPTENA
        DMM: PortNumberOfPortPins=19, PortUse=false, PortName=DMM, PortRegPostfix=DMM, PortAvailablePackage0=true, PortAvailablePackage2=false, PortAvailablePackage3=false, PortAvailablePackage4=false, PortRegBaseAddr=4294965100, PortRegStructure=PORT_REG_STRUCT_REGULAR_NO_SLEW, PortContainsPrivReg=false
          19 x PortPin, all with PortPinDirection=PORT_PIN_IN, PortPinDirectionChangeable=false, PortPinInitialMode=PORT_PIN_MODE_DIO, PortPinLevelValue=PORT_PIN_LEVEL_LOW, PortPinMode=PORT_PIN_MODE_DIO, PortPinOpenDrain=PORT_PUSH_PULL, PortPinPullSelect=PORT_PULL_UP, PortPinRefresh=false, PortPinChannelName=(unset), PortPinAvailablePackage0=true, PortPinAvailablePackage1=true, PortPinAvailablePackage2=false, PortPinAvailablePackage3=false, PortPinAvailablePackage4=false, PortPinSlewRate=PORT_PIN_SLEW_RATE_NA:
            PortPinDmm_0: PortPinId=0, PortPinName=DMMSYNC
            PortPinDmm_1: PortPinId=1, PortPinName=DMMCLK
            PortPinDmm_2: PortPinId=2, PortPinName=DMMDATA0
            PortPinDmm_3: PortPinId=3, PortPinName=DMMDATA1
            PortPinDmm_4: PortPinId=4, PortPinName=DMMDATA2
            PortPinDmm_5: PortPinId=5, PortPinName=DMMDATA3
            PortPinDmm_6: PortPinId=6, PortPinName=DMMDATA4
            PortPinDmm_7: PortPinId=7, PortPinName=DMMDATA5
            PortPinDmm_8: PortPinId=8, PortPinName=DMMDATA6
            PortPinDmm_9: PortPinId=9, PortPinName=DMMDATA7
            PortPinDmm_10: PortPinId=10, PortPinName=DMMDATA8
            PortPinDmm_11: PortPinId=11, PortPinName=DMMDATA9
            PortPinDmm_12: PortPinId=12, PortPinName=DMMDATA10
            PortPinDmm_13: PortPinId=13, PortPinName=DMMDATA11
            PortPinDmm_14: PortPinId=14, PortPinName=DMMDATA12
            PortPinDmm_15: PortPinId=15, PortPinName=DMMDATA13
            PortPinDmm_16: PortPinId=16, PortPinName=DMMDATA14
            PortPinDmm_17: PortPinId=17, PortPinName=DMMDATA15
            PortPinDmm_18: PortPinId=18, PortPinName=DMMnENA
    PortGeneral:
      PortDevErrorDetect = true
      PortSetPinDirectionApi = true
      PortSetPinModeApi = false
      PortVersionInfoApi = false
      PortRefreshPortDirectionApi = false
      PortCfgDoParamChk = true
      PortCfgChkUninit = true
      PortCfgChkParamPin = true
      PortCfgChkParamVinfo = true
      PortCfgChkParamConfig = true
      PortCfgDebugReporting = true
      PortErrorhook = Det_ReportError
      PortDetIncludeFile = Det.h
      PortPackageMapping0 = NA
      PortPackageMapping1 = Pin_337
      PortPackageMapping2 = Pin_144
      PortPackageMapping3 = NA
      PortPackageMapping4 = NA
      PortSpecialRegisterAccessEnabled = true
      PortSpecialRegisterAccessOnlyForWrite = true
      PortSpecialRegisterAccessOnlyForPrivilegedModeRegisters = true
      PortSpecialRegisterAccessNotInInit = false
      PortIrqHandling = SuspendAllInterrupts
  module config PwrLmtFuncCr: implementation-config-variant=VARIANT-PRE-COMPILE  # Configuration of the Nexteer PwrLmtFuncCr module.
    PwrLmtFuncCrGeneral
    CommonPublishedInformation: ArMajorVersion=3, ArMinorVersion=2, ArPatchVersion=0, SwMajorVersion=0, SwMinorVersion=0, SwPatchVersion=0, ModuleId=0, VendorId=0
  module config QuadDet: implementation-config-variant=VARIANT-PRE-COMPILE  # Configuration of the Nexteer QuadDet module.
    QuadDetGeneral
    CommonPublishedInformation: ArMajorVersion=3, ArMinorVersion=2, ArPatchVersion=0, SwMajorVersion=0, SwMinorVersion=0, SwPatchVersion=0, ModuleId=0, VendorId=0
  module config Return: implementation-config-variant=VARIANT-PRE-COMPILE  # Configuration of the Nexteer Return module.
    ReturnGeneral
    CommonPublishedInformation: ArMajorVersion=3, ArMinorVersion=2, ArPatchVersion=0, SwMajorVersion=0, SwMinorVersion=0, SwPatchVersion=0, ModuleId=0, VendorId=0
  module config ReturnFirewall: implementation-config-variant=VARIANT-PRE-COMPILE  # Configuration of the Nexteer ReturnFirewall module.
    ReturnFirewallGeneral
    CommonPublishedInformation: ArMajorVersion=3, ArMinorVersion=2, ArPatchVersion=0, SwMajorVersion=0, SwMinorVersion=0, SwPatchVersion=0, ModuleId=0, VendorId=0
  module config Rte: implementation-config-variant=VARIANT-PRE-COMPILE, module-description=Rte_Impl  # Configuration of the Rte (Runtime Environment) module.
    RteGeneration: RteMeasurementSupport=true, RteXcpEventSupport=false, RteA2LVersion=V151, RteCalibrationSupport=NONE, RteOptimizationMode=MEMORY, RteVfbTrace=0
    106 x SwComponentInstance:
      AbsHwPos_Ap_AbsHwPos_ECU_Composition: SoftwareComponentInstanceRef=AbsHwPos, ImplementationRef=Ap_AbsHwPos_Implementation
        5 x RunnableEntityMapping, all with ActivationOffset=0, RteCyclicTriggerImplementation=Auto:
          Task_2ms_10_11_Timer0: PositionInTask=11, RTEEventRef=TMT_AbsHwPos_Per1, MappedToTaskRef=Task_2ms_10
          Task_Init_10_19_Timer0: PositionInTask=19, RTEEventRef=AbsHwPos_Init1_InitEvent, MappedToTaskRef=Task_Init_10
          Task_10ms_10a_2_Timer0: PositionInTask=2, RTEEventRef=TMT_AbsHwPos_Per4, MappedToTaskRef=Task_10ms_10a
          Task_4ms_10_3_Timer0: PositionInTask=3, RTEEventRef=TMT_AbsHwPos_Per3, MappedToTaskRef=Task_4ms_10
          Task_2ms_10_12_Timer0: PositionInTask=12, RTEEventRef=TMT_AbsHwPos_Per2, MappedToTaskRef=Task_2ms_10
        MAP_Rte_NvmBlock_AbsHwPos_EOLVehCntrOffset (NVRamAllocation): SwNvRamMappingReference=AbsHwPos.EOLVehCntrOffsetBlock, NvmBlockRef=Rte_NvmBlock_AbsHwPos_EOLVehCntrOffset
      ActivePull_Ap_ActivePull_ECU_Composition: SoftwareComponentInstanceRef=ActivePull, ImplementationRef=Ap_ActivePull_Implementation
        5 x RunnableEntityMapping, all with ActivationOffset=0, RteCyclicTriggerImplementation=Auto:
          Task_100ms_9_1_Timer0: PositionInTask=1, RTEEventRef=TMT_ActivePull_Per3, MappedToTaskRef=Task_100ms_9
          Task_2ms_9_10_Timer0: PositionInTask=10, RTEEventRef=TMT_ActivePull_Per2, MappedToTaskRef=Task_2ms_9
          Task_2ms_9_9_Timer0: PositionInTask=9, RTEEventRef=TMT_ActivePull_Per1, MappedToTaskRef=Task_2ms_9
          Task_Trns_9_6_TrigModeSwitch0: PositionInTask=6, RTEEventRef=MST_ActivePull_Trns1_0, MappedToTaskRef=Task_Trns_9
          Task_Init_9_5_Timer0: PositionInTask=5, RTEEventRef=ActivePull_Init1_InitEvent, MappedToTaskRef=Task_Init_9
      ApXcp_Ap_ApXcp_ECU_Composition: SoftwareComponentInstanceRef=ApXcp, ImplementationRef=Ap_ApXcp_Implementation
        Task_2ms_6_2_Timer0 (RunnableEntityMapping): PositionInTask=2, ActivationOffset=0, RteCyclicTriggerImplementation=Auto, RTEEventRef=TMT_DAQ_2msTL, MappedToTaskRef=Task_2ms_6
        Task_10ms_6_3_Timer0 (RunnableEntityMapping): PositionInTask=3, ActivationOffset=0, RteCyclicTriggerImplementation=Auto, RTEEventRef=TMT_ApXcp_Per1, MappedToTaskRef=Task_10ms_6
      Assist_Ap_Assist_ECU_Composition: SoftwareComponentInstanceRef=Assist, ImplementationRef=Ap_Assist_Implementation
        Task_2ms_10_4_Timer0 (RunnableEntityMapping): PositionInTask=4, ActivationOffset=0, RteCyclicTriggerImplementation=Auto, RTEEventRef=TMT_Assist_Per1, MappedToTaskRef=Task_2ms_10
      AssistFirewall_Ap_AssistFirewall_ECU_Composition: SoftwareComponentInstanceRef=AssistFirewall, ImplementationRef=Ap_AssistFirewall_Implementation
        Task_Init_10_24_Timer0 (RunnableEntityMapping): PositionInTask=24, ActivationOffset=0, RteCyclicTriggerImplementation=Auto, RTEEventRef=AssistFirewall_Init1_InitEvent, MappedToTaskRef=Task_Init_10
        Task_2ms_10_6_Timer0 (RunnableEntityMapping): PositionInTask=6, ActivationOffset=0, RteCyclicTriggerImplementation=Auto, RTEEventRef=TMT_AssistFirewall_Per1, MappedToTaskRef=Task_2ms_10
      AstLmt_Ap_AstLmt_ECU_Composition: SoftwareComponentInstanceRef=AstLmt, ImplementationRef=Ap_AstLmt_Implementation
        Task_Init_10_25_Timer0 (RunnableEntityMapping): PositionInTask=25, ActivationOffset=0, RteCyclicTriggerImplementation=Auto, RTEEventRef=AstLmt_InitEvent, MappedToTaskRef=Task_Init_10
        Task_2ms_10_21_Timer0 (RunnableEntityMapping): PositionInTask=21, ActivationOffset=0, RteCyclicTriggerImplementation=Auto, RTEEventRef=TMT_AstLmt_Per1, MappedToTaskRef=Task_2ms_10
        MAP_Rte_NvmBlock_AstLmt_SteerAsstDefeat (NVRamAllocation): SwNvRamMappingReference=AstLmt.SteeringAsstDefeat, NvmBlockRef=Rte_NvmBlock_AstLmt_SteerAsstDefeat
      AvgFricLrn_Ap_AvgFricLrn_ECU_Composition: SoftwareComponentInstanceRef=AvgFricLrn, ImplementationRef=Ap_AvgFricLrn_Implementation
        3 x RunnableEntityMapping, all with ActivationOffset=0, RteCyclicTriggerImplementation=Auto:
          Task_10ms_9_1_Timer0: PositionInTask=1, RTEEventRef=TMT_AvgFricLrn_Per1, MappedToTaskRef=Task_10ms_9
          Task_Init_9_4_Timer0: PositionInTask=4, RTEEventRef=AvgFricLrn_Init1_InitEvent, MappedToTaskRef=Task_Init_9
          Task_Trns_9_8_TrigModeSwitch0: PositionInTask=8, RTEEventRef=MST_AvgFricLrn_Trns1_0, MappedToTaskRef=Task_Trns_9
        MAP_Rte_NvmBlock_AvgFricLrn_AvgFricLrnData (NVRamAllocation): SwNvRamMappingReference=AvgFricLrn.AvgFricLrnBlk, NvmBlockRef=Rte_NvmBlock_AvgFricLrn_AvgFricLrnData
      BVDiag_Ap_BVDiag_ECU_Composition: SoftwareComponentInstanceRef=BVDiag, ImplementationRef=Ap_BVDiag_Implementation
        Task_10ms_9_3_Timer0 (RunnableEntityMapping): PositionInTask=3, ActivationOffset=0, RteCyclicTriggerImplementation=Auto, RTEEventRef=TMT_BVDiag_Per1, MappedToTaskRef=Task_10ms_9
      BatteryVoltage_Ap_BatteryVoltage_ECU_Composition: SoftwareComponentInstanceRef=BatteryVoltage, ImplementationRef=Ap_BatteryVoltage_Implementation
        3 x RunnableEntityMapping, all with ActivationOffset=0, RteCyclicTriggerImplementation=Auto:
          Task_4ms_9_1_Timer0: PositionInTask=1, RTEEventRef=TMT_BatteryVoltage_Per2, MappedToTaskRef=Task_4ms_9
          Task_2ms_9_13_Timer0: PositionInTask=13, RTEEventRef=TMT_BatteryVoltage_Per1, MappedToTaskRef=Task_2ms_9
          Task_Init_9_10_Timer0: PositionInTask=10, RTEEventRef=BatteryVoltage_Init1_InitEvent, MappedToTaskRef=Task_Init_9
        MAP_Rte_NvmBlock_BatteryVoltage_OvervoltageData (NVRamAllocation): SwNvRamMappingReference=BatteryVoltage.OvervoltageBlock, NvmBlockRef=Rte_NvmBlock_BatteryVoltage_OvervoltageData
      BkCpPc_Sa_BkCpPc_ECU_Composition: SoftwareComponentInstanceRef=BkCpPc, ImplementationRef=Sa_BkCpPc_Implementation
        3 x RunnableEntityMapping, all with ActivationOffset=0, RteCyclicTriggerImplementation=Auto:
          Task_Trns_9_2_TrigModeSwitch0: PositionInTask=2, RTEEventRef=MST_BkCpPc_Trns2_0, MappedToTaskRef=Task_Trns_9
          Task_2ms_9_17_Timer0: PositionInTask=17, RTEEventRef=TMT_BkCpPc_Per1, MappedToTaskRef=Task_2ms_9
          Task_Trns_9_4_TrigModeSwitch0: PositionInTask=4, RTEEventRef=MST_BkCpPc_Trns1_0, MappedToTaskRef=Task_Trns_9
      CDD_CDD_ECU_Composition: ServiceComponentPrototypeRef=CDD, ImplementationRef=CDD_Implementation
        Task_SchM_10ms_6_3_Timer0 (RunnableEntityMapping): PositionInTask=3, ActivationOffset=0, RteCyclicTriggerImplementation=Auto, RTEEventRef=TMT_Cdd_DummyFunction, MappedToTaskRef=Task_SchM_10ms_6
      CDDInterface10_Sa_CDDInterface10_ECU_Composition: SoftwareComponentInstanceRef=CDDInterface10, ImplementationRef=Sa_CDDInterface10_Implementation
        Task_2ms_10_35_Timer0 (RunnableEntityMapping): PositionInTask=35, ActivationOffset=0, RteCyclicTriggerImplementation=Auto, RTEEventRef=TMT_CDDInterface10_Per1, MappedToTaskRef=Task_2ms_10
        Task_Init_10_1_Timer0 (RunnableEntityMapping): PositionInTask=1, ActivationOffset=0, RteCyclicTriggerImplementation=Auto, RTEEventRef=CDDInterface10_Init1_InitEvent, MappedToTaskRef=Task_Init_10
      CDDInterface11_Sa_CDDInterface11_ECU_Composition: SoftwareComponentInstanceRef=CDDInterface11, ImplementationRef=Sa_CDDInterface11_Implementation
        Task_Init_11a_0_Timer0 (RunnableEntityMapping): PositionInTask=0, ActivationOffset=0, RteCyclicTriggerImplementation=Auto, RTEEventRef=CDDInterface11_Init1_InitEvent, MappedToTaskRef=Task_Init_11a
        Task_10ms_11_1_Timer0 (RunnableEntityMapping): PositionInTask=1, ActivationOffset=0, RteCyclicTriggerImplementation=Auto, RTEEventRef=TMT_CDDInterface11_Per1, MappedToTaskRef=Task_10ms_11
      CDDInterface6_Sa_CDDInterface6_ECU_Composition: SoftwareComponentInstanceRef=CDDInterface6, ImplementationRef=Sa_CDDInterface6_Implementation
        Task_Init_6_4_Timer0 (RunnableEntityMapping): PositionInTask=4, ActivationOffset=0, RteCyclicTriggerImplementation=Auto, RTEEventRef=CDDInterface6_Init1_InitEvent, MappedToTaskRef=Task_Init_6
        Task_10ms_6_4_Timer0 (RunnableEntityMapping): PositionInTask=4, ActivationOffset=0, RteCyclicTriggerImplementation=Auto, RTEEventRef=TMT_CDDInterface6_Per1, MappedToTaskRef=Task_10ms_6
      CDDInterface9_Sa_CDDInterface9_ECU_Composition: SoftwareComponentInstanceRef=CDDInterface9, ImplementationRef=Sa_CDDInterface9_Implementation
        Task_2ms_9_4_Timer0 (RunnableEntityMapping): PositionInTask=4, ActivationOffset=0, RteCyclicTriggerImplementation=Auto, RTEEventRef=TMT_CDDInterface9_Per1, MappedToTaskRef=Task_2ms_9
        Task_Init_9_0_Timer0 (RunnableEntityMapping): PositionInTask=0, ActivationOffset=0, RteCyclicTriggerImplementation=Auto, RTEEventRef=CDDInterface9_Init1_InitEvent, MappedToTaskRef=Task_Init_9
      ChkPtAp10_Ap_ChkPtAp10_ECU_Composition: SoftwareComponentInstanceRef=ChkPtAp10, ImplementationRef=Ap_ChkPtAp10_Implementation
        10 x RunnableEntityMapping, all with ActivationOffset=0, RteCyclicTriggerImplementation=Auto:
          Task_2ms_10_48_Timer0: PositionInTask=48, RTEEventRef=TMT_ChkPtAp10_2msEnd_Per, MappedToTaskRef=Task_2ms_10
          Task_4ms_10_4_Timer0: PositionInTask=4, RTEEventRef=TMT_ChkPtAp10_4msEnd_Per, MappedToTaskRef=Task_4ms_10
          Task_2ms_10_0_Timer0: PositionInTask=0, RTEEventRef=TMT_ChkPtAp10_2msStart_Per, MappedToTaskRef=Task_2ms_10
          Task_10ms_10a_4_Timer0: PositionInTask=4, RTEEventRef=TMT_ChkPtAp10_10msaEnd_Per, MappedToTaskRef=Task_10ms_10a
          Task_100ms_10_0_Timer0: PositionInTask=0, RTEEventRef=TMT_ChkPtAp10_100msStart_Per, MappedToTaskRef=Task_100ms_10
          Task_10ms_10a_0_Timer0: PositionInTask=0, RTEEventRef=TMT_ChkPtAp10_10msaStart_Per, MappedToTaskRef=Task_10ms_10a
          Task_10ms_10b_6_Timer0: PositionInTask=6, RTEEventRef=TMT_ChkPtAp10_10msbEnd_Per, MappedToTaskRef=Task_10ms_10b
          Task_100ms_10_8_Timer0: PositionInTask=8, RTEEventRef=TMT_ChkPtAp10_100msEnd_Per, MappedToTaskRef=Task_100ms_10
          Task_10ms_10b_0_Timer0: PositionInTask=0, RTEEventRef=TMT_ChkPtAp10_10msbStart_Per, MappedToTaskRef=Task_10ms_10b
          Task_4ms_10_0_Timer0: PositionInTask=0, RTEEventRef=TMT_ChkPtAp10_4msStart_Per, MappedToTaskRef=Task_4ms_10
      ChkPtAp11_Ap_ChkPtAp11_ECU_Composition: SoftwareComponentInstanceRef=ChkPtAp11, ImplementationRef=Ap_ChkPtAp11_Implementation
        6 x RunnableEntityMapping, all with ActivationOffset=0, RteCyclicTriggerImplementation=Auto:
          Task_100ms_11_0_Timer0: PositionInTask=0, RTEEventRef=TMT_ChkPtAp11_100msStart_Per, MappedToTaskRef=Task_100ms_11
          Task_100ms_11_5_Timer0: PositionInTask=5, RTEEventRef=TMT_ChkPtAp11_100msEnd_Per, MappedToTaskRef=Task_100ms_11
          Task_10ms_11_3_Timer0: PositionInTask=3, RTEEventRef=TMT_ChkPtAp11_10msEnd_Per, MappedToTaskRef=Task_10ms_11
          Task_2ms_11_9_Timer0: PositionInTask=9, RTEEventRef=TMT_ChkPtAp11_2msEnd_Per, MappedToTaskRef=Task_2ms_11
          Task_10ms_11_0_Timer0: PositionInTask=0, RTEEventRef=TMT_ChkPtAp11_10msStart_Per, MappedToTaskRef=Task_10ms_11
          Task_2ms_11_0_Timer0: PositionInTask=0, RTEEventRef=TMT_ChkPtAp11_2msStart_Per, MappedToTaskRef=Task_2ms_11
      ChkPtAp6_Ap_ChkPtAp6_ECU_Composition: SoftwareComponentInstanceRef=ChkPtAp6, ImplementationRef=Ap_ChkPtAp6_Implementation
        6 x RunnableEntityMapping, all with ActivationOffset=0, RteCyclicTriggerImplementation=Auto:
          Task_100ms_6_0_Timer0: PositionInTask=0, RTEEventRef=TMT_ChkPtAp6_100msStart_Per, MappedToTaskRef=Task_100ms_6
          Task_100ms_6_3_Timer0: PositionInTask=3, RTEEventRef=TMT_ChkPtAp6_100msEnd_Per, MappedToTaskRef=Task_100ms_6
          Task_2ms_6_0_Timer0: PositionInTask=0, RTEEventRef=TMT_ChkPtAp6_2msStart_Per, MappedToTaskRef=Task_2ms_6
          Task_2ms_6_3_Timer0: PositionInTask=3, RTEEventRef=TMT_ChkPtAp6_2msEnd_Per, MappedToTaskRef=Task_2ms_6
          Task_10ms_6_5_Timer0: PositionInTask=5, RTEEventRef=TMT_ChkPtAp6_10msEnd_Per, MappedToTaskRef=Task_10ms_6
          Task_10ms_6_0_Timer0: PositionInTask=0, RTEEventRef=TMT_ChkPtAp6_10msStart_Per, MappedToTaskRef=Task_10ms_6
      ChkPtAp9_Ap_ChkPtAp9_ECU_Composition: SoftwareComponentInstanceRef=ChkPtAp9, ImplementationRef=Ap_ChkPtAp9_Implementation
        8 x RunnableEntityMapping, all with ActivationOffset=0, RteCyclicTriggerImplementation=Auto:
          Task_4ms_9_0_Timer0: PositionInTask=0, RTEEventRef=TMT_ChkPtAp9_4msStart_Per, MappedToTaskRef=Task_4ms_9
          Task_2ms_9_0_Timer0: PositionInTask=0, RTEEventRef=TMT_ChkPtAp9_2msStart_Per, MappedToTaskRef=Task_2ms_9
          Task_4ms_9_2_Timer0: PositionInTask=2, RTEEventRef=TMT_ChkPtAp9_4msEnd_Per, MappedToTaskRef=Task_4ms_9
          Task_100ms_9_5_Timer0: PositionInTask=5, RTEEventRef=TMT_ChkPtAp9_100msEnd_Per, MappedToTaskRef=Task_100ms_9
          Task_10ms_9_7_Timer0: PositionInTask=7, RTEEventRef=TMT_ChkPtAp9_10msEnd_Per, MappedToTaskRef=Task_10ms_9
          Task_10ms_9_0_Timer0: PositionInTask=0, RTEEventRef=TMT_ChkPtAp9_10msStart_Per, MappedToTaskRef=Task_10ms_9
          Task_100ms_9_0_Timer0: PositionInTask=0, RTEEventRef=TMT_ChkPtAp9_100msStart_Per, MappedToTaskRef=Task_100ms_9
          Task_2ms_9_22_Timer0: PositionInTask=22, RTEEventRef=TMT_ChkPtAp9_2msEnd_Per, MappedToTaskRef=Task_2ms_9
      CmMtrCurr_Sa_CmMtrCurr_ECU_Composition: SoftwareComponentInstanceRef=CmMtrCurr, ImplementationRef=Sa_CmMtrCurr_Implementation
        4 x RunnableEntityMapping, all with ActivationOffset=0, RteCyclicTriggerImplementation=Auto:
          Task_2ms_11_4_Timer0: PositionInTask=4, RTEEventRef=TMT_CmMtrCurr_Per3, MappedToTaskRef=Task_2ms_11
          Task_Init_11b_5_Timer0: PositionInTask=5, RTEEventRef=CmMtrCurr_InitEvent, MappedToTaskRef=Task_Init_11b
          Task_100ms_11_1_Timer0: PositionInTask=1, RTEEventRef=TMT_CmMtrCurr_Per1, MappedToTaskRef=Task_100ms_11
          Task_2ms_11_3_Timer0: PositionInTask=3, RTEEventRef=TMT_CmMtrCurr_Per2, MappedToTaskRef=Task_2ms_11
        MAP_Rte_NvmBlock_CmMtrCurr_ShCurrCal (NVRamAllocation): SwNvRamMappingReference=CmMtrCurr.ShCurrCalBlk, NvmBlockRef=Rte_NvmBlock_CmMtrCurr_ShCurrCal
        MAP_Rte_NvmBlock_CmMtrCurr_CurrTempOffset (NVRamAllocation): SwNvRamMappingReference=CmMtrCurr.CurrTempOffsetBlk, NvmBlockRef=Rte_NvmBlock_CmMtrCurr_CurrTempOffset
      ComplErr_Ap_ComplErr_ECU_Composition: SoftwareComponentInstanceRef=ComplErr, ImplementationRef=Ap_ComplErr_Implementation
        Task_2ms_10_40_Timer0 (RunnableEntityMapping): PositionInTask=40, ActivationOffset=0, RteCyclicTriggerImplementation=Auto, RTEEventRef=TMT_ComplErr_Per1, MappedToTaskRef=Task_2ms_10
      CtrlTemp_Sa_CtrlTemp_ECU_Composition: SoftwareComponentInstanceRef=CtrlTemp, ImplementationRef=Sa_CtrlTemp_Implementation
        3 x RunnableEntityMapping, all with ActivationOffset=0, RteCyclicTriggerImplementation=Auto:
          Task_100ms_11_2_Timer0: PositionInTask=2, RTEEventRef=TMT_CtrlTemp_Per2, MappedToTaskRef=Task_100ms_11
          Task_2ms_11_7_Timer0: PositionInTask=7, RTEEventRef=TMT_CtrlTemp_Per1, MappedToTaskRef=Task_2ms_11
          Task_Init_11b_3_Timer0: PositionInTask=3, RTEEventRef=CtrlTemp_Init1_InitEvent, MappedToTaskRef=Task_Init_11b
      CtrldDisShtdn_Ap_CtrldDisShtdn_ECU_Composition: SoftwareComponentInstanceRef=CtrldDisShtdn, ImplementationRef=Ap_CtrldDisShtdn_Implementation
        Task_2ms_10_23_Timer0 (RunnableEntityMapping): PositionInTask=23, ActivationOffset=0, RteCyclicTriggerImplementation=Auto, RTEEventRef=TMT_CtrldDisShtdn_Per1, MappedToTaskRef=Task_2ms_10
      CurrCmd_Ap_CurrCmd_ECU_Composition: SoftwareComponentInstanceRef=CurrCmd, ImplementationRef=Ap_CurrCmd_Implementation
        Task_Init_10_8_Timer0 (RunnableEntityMapping): PositionInTask=8, ActivationOffset=0, RteCyclicTriggerImplementation=Auto, RTEEventRef=CurrCmd_InitEvent, MappedToTaskRef=Task_Init_10
        Task_2ms_10_30_Timer0 (RunnableEntityMapping): PositionInTask=30, ActivationOffset=0, RteCyclicTriggerImplementation=Auto, RTEEventRef=TMT_CurrCmd_Per1, MappedToTaskRef=Task_2ms_10
      CurrParamComp_Ap_CurrParamComp_ECU_Composition: SoftwareComponentInstanceRef=CurrParamComp, ImplementationRef=Ap_CurrParamComp_Implementation
        3 x RunnableEntityMapping, all with ActivationOffset=0, RteCyclicTriggerImplementation=Auto:
          Task_2ms_10_33_Timer0: PositionInTask=33, RTEEventRef=TMT_CurrParamComp_Per1, MappedToTaskRef=Task_2ms_10
          Task_Init_10_9_Timer0: PositionInTask=9, RTEEventRef=CurrParamComp_InitEvent, MappedToTaskRef=Task_Init_10
          Task_100ms_10_2_Timer0: PositionInTask=2, RTEEventRef=TMT_CurrParamComp_Per2, MappedToTaskRef=Task_100ms_10
        MAP_Rte_NvmBlock_CurrParamComp_EOLNomMtrParam (NVRamAllocation): SwNvRamMappingReference=CurrParamComp.EOLNomMtrParamBlk, NvmBlockRef=Rte_NvmBlock_CurrParamComp_EOLNomMtrParam
      CustBattDiag_Ap_CustBattDiag_ECU_Composition: SoftwareComponentInstanceRef=CustBattDiag, ImplementationRef=Ap_CustBattDiag_Implementation
        Task_100ms_9_2_Timer0 (RunnableEntityMapping): PositionInTask=2, ActivationOffset=0, RteCyclicTriggerImplementation=Auto, RTEEventRef=TMT_CustBattDiag_Per2, MappedToTaskRef=Task_100ms_9
        Task_10ms_9_4_Timer0 (RunnableEntityMapping): PositionInTask=4, ActivationOffset=0, RteCyclicTriggerImplementation=Auto, RTEEventRef=TMT_CustBattDiag_Per1, MappedToTaskRef=Task_10ms_9
      Damping_Ap_Damping_ECU_Composition: SoftwareComponentInstanceRef=Damping, ImplementationRef=Ap_Damping_Implementation
        Task_Init_10_13_Timer0 (RunnableEntityMapping): PositionInTask=13, ActivationOffset=0, RteCyclicTriggerImplementation=Auto, RTEEventRef=Damping_Init1_InitEvent, MappedToTaskRef=Task_Init_10
        Task_2ms_10_13_Timer0 (RunnableEntityMapping): PositionInTask=13, ActivationOffset=0, RteCyclicTriggerImplementation=Auto, RTEEventRef=TMT_Damping_Per1, MappedToTaskRef=Task_2ms_10
      DampingFirewall_Ap_DampingFirewall_ECU_Composition: SoftwareComponentInstanceRef=DampingFirewall, ImplementationRef=Ap_DampingFirewall_Implementation
        Task_Init_10_15_Timer0 (RunnableEntityMapping):
          PositionInTask = 15
          ActivationOffset = 0
          RteCyclicTriggerImplementation = Auto
          RTEEventRef = DampingFirewall_Init1_InitEvent
          MappedToTaskRef = Task_Init_10
        Task_2ms_10_15_Timer0 (RunnableEntityMapping): PositionInTask=15, ActivationOffset=0, RteCyclicTriggerImplementation=Auto, RTEEventRef=TMT_DampingFirewall_Per1, MappedToTaskRef=Task_2ms_10
      Dem_Dem_ECU_Composition: ServiceComponentPrototypeRef=Dem, ImplementationRef=Dem_Implementation
        Task_SchM_10ms_6_1_Timer0 (RunnableEntityMapping): PositionInTask=1, ActivationOffset=0, RteCyclicTriggerImplementation=Auto, RTEEventRef=TMT_Dem_MainFunction, MappedToTaskRef=Task_SchM_10ms_6
      DemIf_Ap_DemIf_ECU_Composition: SoftwareComponentInstanceRef=DemIf, ImplementationRef=Ap_DemIf_Implementation
        Task_SchM_10ms_6_2_Timer0 (RunnableEntityMapping): PositionInTask=2, ActivationOffset=0, RteCyclicTriggerImplementation=Auto, RTEEventRef=TMT_DemIf_DummyFunction, MappedToTaskRef=Task_SchM_10ms_6
      DiagMgr10_Ap_DiagMgr10_ECU_Composition: SoftwareComponentInstanceRef=DiagMgr10, ImplementationRef=Ap_DiagMgr10_Implementation
        4 x RunnableEntityMapping, all with ActivationOffset=0, RteCyclicTriggerImplementation=Auto:
          Task_2ms_10_24_Timer0: PositionInTask=24, RTEEventRef=TMT_DiagMgr_Per1, MappedToTaskRef=Task_2ms_10
          Task_100ms_10_7_Timer0: PositionInTask=7, RTEEventRef=TMT_DiagMgr10_Per, MappedToTaskRef=Task_100ms_10
          Task_Init_10_2_Timer0: PositionInTask=2, RTEEventRef=DiagMgr10_InitEvent, MappedToTaskRef=Task_Init_10
          Task_Trns_10_0_TrigModeSwitch0: PositionInTask=0, RTEEventRef=MST_DiagMgr10_Trns_0, MappedToTaskRef=Task_Trns_10
      DiagMgr11_Ap_DiagMgr11_ECU_Composition: SoftwareComponentInstanceRef=DiagMgr11, ImplementationRef=Ap_DiagMgr11_Implementation
        3 x RunnableEntityMapping, all with ActivationOffset=0, RteCyclicTriggerImplementation=Auto:
          Task_100ms_11_4_Timer0: PositionInTask=4, RTEEventRef=TMT_DiagMgr11_Per, MappedToTaskRef=Task_100ms_11
          Task_Trns_11_0_TrigModeSwitch0: PositionInTask=0, RTEEventRef=MST_DiagMgr11_Trns_0, MappedToTaskRef=Task_Trns_11
          Task_Init_11b_0_Timer0: PositionInTask=0, RTEEventRef=DiagMgr11_InitEvent, MappedToTaskRef=Task_Init_11b
      DiagMgr6_Ap_DiagMgr6_ECU_Composition: SoftwareComponentInstanceRef=DiagMgr6, ImplementationRef=Ap_DiagMgr6_Implementation
        6 x RunnableEntityMapping, all with ActivationOffset=0, RteCyclicTriggerImplementation=Auto:
          Task_100ms_6_2_Timer0: PositionInTask=2, RTEEventRef=TMT_DiagMgr6_Per, MappedToTaskRef=Task_100ms_6
          Task_Trns_6_0_TrigModeSwitch0: PositionInTask=0, RTEEventRef=MST_DiagMgr_Trns1_0, MappedToTaskRef=Task_Trns_6
          Task_Init_6_1_Timer0: PositionInTask=1, RTEEventRef=DiagMgr_Init1_InitEvent, MappedToTaskRef=Task_Init_6
          Task_Trns_6_1_TrigModeSwitch0: PositionInTask=1, RTEEventRef=MST_DiagMgr6_Trns_0, MappedToTaskRef=Task_Trns_6
          Task_Init_6_0_Timer0: PositionInTask=0, RTEEventRef=DiagMgr6_InitEvent, MappedToTaskRef=Task_Init_6
          Task_100ms_6_1_Timer0: PositionInTask=1, RTEEventRef=TMT_DiagMgr_Per2, MappedToTaskRef=Task_100ms_6
      DiagMgr9_Ap_DiagMgr9_ECU_Composition: SoftwareComponentInstanceRef=DiagMgr9, ImplementationRef=Ap_DiagMgr9_Implementation
        3 x RunnableEntityMapping, all with ActivationOffset=0, RteCyclicTriggerImplementation=Auto:
          Task_Init_9_1_Timer0: PositionInTask=1, RTEEventRef=DiagMgr9_InitEvent, MappedToTaskRef=Task_Init_9
          Task_Trns_9_0_TrigModeSwitch0: PositionInTask=0, RTEEventRef=MST_DiagMgr9_Trns_0, MappedToTaskRef=Task_Trns_9
          Task_100ms_9_4_Timer0: PositionInTask=4, RTEEventRef=TMT_DiagMgr9_Per, MappedToTaskRef=Task_100ms_9
      DiagSvc_Ap_DiagSvc_ECU_Composition: SoftwareComponentInstanceRef=DiagSvc, ImplementationRef=Ap_DiagSvc_Implementation
        Task_SchM_10ms_6_5_Timer0 (RunnableEntityMapping): PositionInTask=5, ActivationOffset=0, RteCyclicTriggerImplementation=Auto, RTEEventRef=TMT_DiagSvc_DummyFunction, MappedToTaskRef=Task_SchM_10ms_6
      DigHwTrqSENT_Sa_DigHwTrqSENT_ECU_Composition: SoftwareComponentInstanceRef=DigHwTrqSENT, ImplementationRef=Sa_DigHwTrqSENT_Implementation
        4 x RunnableEntityMapping, all with ActivationOffset=0, RteCyclicTriggerImplementation=Auto:
          Task_2ms_10_1_Timer0: PositionInTask=1, RTEEventRef=TMT_DigHwTrqSENT_Per1, MappedToTaskRef=Task_2ms_10
          Task_Init_10_18_Timer0: PositionInTask=18, RTEEventRef=DigHwTrqSENT_Init1_InitEvent, MappedToTaskRef=Task_Init_10
          Task_100ms_10_4_Timer0: PositionInTask=4, RTEEventRef=TMT_DigHwTrqSENT_Per3, MappedToTaskRef=Task_100ms_10
          Task_4ms_10_2_Timer0: PositionInTask=2, RTEEventRef=TMT_DigHwTrqSENT_Per2, MappedToTaskRef=Task_4ms_10
        MAP_Rte_NvmBlock_DigHwTrqSENT_DigTrqTrim (NVRamAllocation): SwNvRamMappingReference=DigHwTrqSENT.DigHwTrqSENTTrim, NvmBlockRef=Rte_NvmBlock_DigHwTrqSENT_DigTrqTrim
      DigMSB_Sa_DigMSB_ECU_Composition: SoftwareComponentInstanceRef=DigMSB, ImplementationRef=Sa_DigMSB_Implementation
        3 x RunnableEntityMapping, all with ActivationOffset=0, RteCyclicTriggerImplementation=Auto:
          Task_Init_10_20_Timer0: PositionInTask=20, RTEEventRef=DigMSB_InitEvent, MappedToTaskRef=Task_Init_10
          Task_2ms_10_8_Timer0: PositionInTask=8, RTEEventRef=TMT_DigMSB_Per2, MappedToTaskRef=Task_2ms_10
          Task_100ms_10_1_Timer0: PositionInTask=1, RTEEventRef=TMT_DigMSB_Per3, MappedToTaskRef=Task_100ms_10
        MAP_Rte_NvmBlock_DigMSB_DigMSBEOLData (NVRamAllocation): SwNvRamMappingReference=DigMSB.DigMSBEOLBlk, NvmBlockRef=Rte_NvmBlock_DigMSB_DigMSBEOLData
      DigPhsReasDiag_Ap_DigPhsReasDiag_ECU_Composition: SoftwareComponentInstanceRef=DigPhsReasDiag, ImplementationRef=Ap_DigPhsReasDiag_Implementation
        3 x RunnableEntityMapping, all with ActivationOffset=0, RteCyclicTriggerImplementation=Auto:
          Task_2ms_10_45_Timer0: PositionInTask=45, RTEEventRef=TMT_DigPhsReasDiag_Per1, MappedToTaskRef=Task_2ms_10
          Task_Trns_10_6_TrigModeSwitch0: PositionInTask=6, RTEEventRef=MST_DigPhsReasDiag_Trans1_0, MappedToTaskRef=Task_Trns_10
          Task_Init_10_7_Timer0: PositionInTask=7, RTEEventRef=DigPhsReasDiag_InitEvent, MappedToTaskRef=Task_Init_10
      EOTActuatorMng_Ap_EOTActuatorMng_ECU_Composition: SoftwareComponentInstanceRef=EOTActuatorMng, ImplementationRef=Ap_EOTActuatorMng_Implementation
        Task_2ms_9_7_Timer0 (RunnableEntityMapping): PositionInTask=7, ActivationOffset=0, RteCyclicTriggerImplementation=Auto, RTEEventRef=TMT_EOTActuatorMng_Per1, MappedToTaskRef=Task_2ms_9
      ElePwr_Ap_ElePwr_ECU_Composition: SoftwareComponentInstanceRef=ElePwr, ImplementationRef=Ap_ElePwr_Implementation
        Task_10ms_9_5_Timer0 (RunnableEntityMapping): PositionInTask=5, ActivationOffset=0, RteCyclicTriggerImplementation=Auto, RTEEventRef=TMT_ElePwr_Per1, MappedToTaskRef=Task_10ms_9
      EtDmpFw_Ap_EtDmpFw_ECU_Composition: SoftwareComponentInstanceRef=EtDmpFw, ImplementationRef=Ap_EtDmpFw_Implementation
        Task_2ms_10_17_Timer0 (RunnableEntityMapping): PositionInTask=17, ActivationOffset=0, RteCyclicTriggerImplementation=Auto, RTEEventRef=TMT_EtDmpFw_Per1, MappedToTaskRef=Task_2ms_10
      FaultLog_Ap_FaultLog_ECU_Composition: SoftwareComponentInstanceRef=FaultLog, ImplementationRef=Ap_FaultLog_Implementation
        3 x RunnableEntityMapping, all with ActivationOffset=0, RteCyclicTriggerImplementation=Auto:
          Task_Init_6_3_Timer0: PositionInTask=3, RTEEventRef=FaultLog_Init1_InitEvent, MappedToTaskRef=Task_Init_6
          Task_10ms_6_1_Timer0: PositionInTask=1, RTEEventRef=TMT_FaultLog_Per1, MappedToTaskRef=Task_10ms_6
          Task_Trns_6_4_TrigModeSwitch0: PositionInTask=4, RTEEventRef=MST_FaultLog_Trns1_0, MappedToTaskRef=Task_Trns_6
        MAP_Rte_NvmBlock_FaultLog_FaultLog (NVRamAllocation): SwNvRamMappingReference=FaultLog.FaultLogData, NvmBlockRef=Rte_NvmBlock_FaultLog_FaultLog
      FltInjection_Ap_FltInjection_ECU_Composition: SoftwareComponentInstanceRef=FltInjection, ImplementationRef=Ap_FltInjection_Implementation
        Task_2ms_10_47_Timer0 (RunnableEntityMapping): PositionInTask=47, ActivationOffset=0, RteCyclicTriggerImplementation=Auto, RTEEventRef=TMT_FltInjection_Per1, MappedToTaskRef=Task_2ms_10
      FrqDepDmpnInrtCmp_Ap_FrqDepDmpnInrtCmp_ECU_Composition: SoftwareComponentInstanceRef=FrqDepDmpnInrtCmp, ImplementationRef=Ap_FrqDepDmpnInrtCmp_Implementation
        Task_2ms_10_14_Timer0 (RunnableEntityMapping): PositionInTask=14, ActivationOffset=0, RteCyclicTriggerImplementation=Auto, RTEEventRef=TMT_FrqDepDmpnInrtCmp_Per1, MappedToTaskRef=Task_2ms_10
        Task_Init_10_12_Timer0 (RunnableEntityMapping): PositionInTask=12, ActivationOffset=0, RteCyclicTriggerImplementation=Auto, RTEEventRef=FrqDepDmpnInrtCmp_InitEvent, MappedToTaskRef=Task_Init_10
      GCCDiag_Ap_GCCDiag_ECU_Composition: SoftwareComponentInstanceRef=GCCDiag, ImplementationRef=Ap_GCCDiag_Implementation
        Task_Init_9_6_Timer0 (RunnableEntityMapping): PositionInTask=6, ActivationOffset=0, RteCyclicTriggerImplementation=Auto, RTEEventRef=GCCDiag_Init1_InitEvent, MappedToTaskRef=Task_Init_9
        Task_2ms_9_11_Timer0 (RunnableEntityMapping): PositionInTask=11, ActivationOffset=0, RteCyclicTriggerImplementation=Auto, RTEEventRef=TMT_GCCDiag_Per1, MappedToTaskRef=Task_2ms_9
      Gsod_Ap_Gsod_ECU_Composition: SoftwareComponentInstanceRef=Gsod, ImplementationRef=Ap_Gsod_Implementation
        Task_2ms_10_46_Timer0 (RunnableEntityMapping): PositionInTask=46, ActivationOffset=0, RteCyclicTriggerImplementation=Auto, RTEEventRef=TMT_Gsod_Per1, MappedToTaskRef=Task_2ms_10
      HiLoadStall_Ap_HiLoadStall_ECU_Composition: SoftwareComponentInstanceRef=HiLoadStall, ImplementationRef=Ap_HiLoadStall_Implementation
        Task_2ms_9_5_Timer0 (RunnableEntityMapping): PositionInTask=5, ActivationOffset=0, RteCyclicTriggerImplementation=Auto, RTEEventRef=TMT_HiLoadStall_Per1, MappedToTaskRef=Task_2ms_9
      HighFreqAssist_Ap_HighFreqAssist_ECU_Composition: SoftwareComponentInstanceRef=HighFreqAssist, ImplementationRef=Ap_HighFreqAssist_Implementation
        Task_2ms_10_3_Timer0 (RunnableEntityMapping): PositionInTask=3, ActivationOffset=0, RteCyclicTriggerImplementation=Auto, RTEEventRef=TMT_HighFreqAssist_Per1, MappedToTaskRef=Task_2ms_10
      HwPwUp_Ap_HwPwUp_ECU_Composition: SoftwareComponentInstanceRef=HwPwUp, ImplementationRef=Ap_HwPwUp_Implementation
        4 x RunnableEntityMapping, all with ActivationOffset=0, RteCyclicTriggerImplementation=Auto:
          Task_Trns_10_3_TrigModeSwitch0: PositionInTask=3, RTEEventRef=MST_HwPwUp_Trns2_0, MappedToTaskRef=Task_Trns_10
          Task_2ms_10_41_Timer0: PositionInTask=41, RTEEventRef=TMT_HwPwUp_Per1, MappedToTaskRef=Task_2ms_10
          Task_Trns_10_1_TrigModeSwitch1: PositionInTask=1, RTEEventRef=MST_HwPwUp_Trns1_1, MappedToTaskRef=Task_Trns_10
          Task_Trns_10_1_TrigModeSwitch0: PositionInTask=1, RTEEventRef=MST_HwPwUp_Trns1_0, MappedToTaskRef=Task_Trns_10
      HystComp_Ap_HystComp_ECU_Composition: SoftwareComponentInstanceRef=HystComp, ImplementationRef=Ap_HystComp_Implementation
        Task_2ms_10_5_Timer0 (RunnableEntityMapping): PositionInTask=5, ActivationOffset=0, RteCyclicTriggerImplementation=Auto, RTEEventRef=TMT_HystComp_Per1, MappedToTaskRef=Task_2ms_10
        Task_Init_10_11_Timer0 (RunnableEntityMapping): PositionInTask=11, ActivationOffset=0, RteCyclicTriggerImplementation=Auto, RTEEventRef=HystComp_Init1_InitEvent, MappedToTaskRef=Task_Init_10
      IoHwAb10_IoHwAb10_ECU_Composition: SoftwareComponentInstanceRef=IoHwAb10, ImplementationRef=IoHwAb10_Implementation
        Task_Init_10_4_Timer0 (RunnableEntityMapping): PositionInTask=4, ActivationOffset=0, RteCyclicTriggerImplementation=Auto, RTEEventRef=IoHwAb_InitEvent, MappedToTaskRef=Task_Init_10
        Task_2ms_10_38_Timer0 (RunnableEntityMapping): PositionInTask=38, ActivationOffset=0, RteCyclicTriggerImplementation=Auto, RTEEventRef=TMT_IoHwAb_ReadAdc, MappedToTaskRef=Task_2ms_10
      IoHwAb9_IoHwAb9_ECU_Composition: SoftwareComponentInstanceRef=IoHwAb9, ImplementationRef=IoHwAb9_Implementation
        Task_2ms_9_3_Timer0 (RunnableEntityMapping): PositionInTask=3, ActivationOffset=0, RteCyclicTriggerImplementation=Auto, RTEEventRef=TMT_IoHwAb_StartAdc, MappedToTaskRef=Task_2ms_9
      IoHwAbsDigSig_IoHwAbstraction_ECU_Composition: SoftwareComponentInstanceRef=IoHwAbsDigSig, ImplementationRef=IoHwAbstraction_Implementation
        Task_SchM_10ms_6_6_Timer0 (RunnableEntityMapping): PositionInTask=6, ActivationOffset=0, RteCyclicTriggerImplementation=Auto, RTEEventRef=TMT_IoHwAb_DummyFunction, MappedToTaskRef=Task_SchM_10ms_6
      LmtCod_Ap_LmtCod_ECU_Composition: SoftwareComponentInstanceRef=LmtCod, ImplementationRef=Ap_LmtCod_Implementation
        Task_2ms_10_19_Timer0 (RunnableEntityMapping): PositionInTask=19, ActivationOffset=0, RteCyclicTriggerImplementation=Auto, RTEEventRef=TMT_LmtCod_Per1, MappedToTaskRef=Task_2ms_10
      LrnEOT_Ap_LrnEOT_ECU_Composition: SoftwareComponentInstanceRef=LrnEOT, ImplementationRef=Ap_LrnEOT_Implementation
        Task_Init_9_9_Timer0 (RunnableEntityMapping): PositionInTask=9, ActivationOffset=0, RteCyclicTriggerImplementation=Auto, RTEEventRef=LrnEOT_Init1_InitEvent, MappedToTaskRef=Task_Init_9
        Task_10ms_9_2_Timer0 (RunnableEntityMapping): PositionInTask=2, ActivationOffset=0, RteCyclicTriggerImplementation=Auto, RTEEventRef=TMT_LrnEOT_Per1, MappedToTaskRef=Task_10ms_9
        MAP_Rte_NvmBlock_LrnEOT_LearnedEOT (NVRamAllocation): SwNvRamMappingReference=LrnEOT.EOTLearnedBlk, NvmBlockRef=Rte_NvmBlock_LrnEOT_LearnedEOT
      MtrDrvDiag_Sa_MtrDrvDiag_ECU_Composition: SoftwareComponentInstanceRef=MtrDrvDiag, ImplementationRef=Sa_MtrDrvDiag_Implementation
        3 x RunnableEntityMapping, all with ActivationOffset=0, RteCyclicTriggerImplementation=Auto:
          Task_2ms_10_44_Timer0: PositionInTask=44, RTEEventRef=TMT_MtrDrvDiag_Per2, MappedToTaskRef=Task_2ms_10
          Task_Trns_10_2_TrigModeSwitch0: PositionInTask=2, RTEEventRef=MST_MtrDrvDiag_Trns1_0, MappedToTaskRef=Task_Trns_10
          Task_2ms_10_43_Timer0: PositionInTask=43, RTEEventRef=TMT_MtrDrvDiag_Per1, MappedToTaskRef=Task_2ms_10
      MtrTempEst_Ap_MtrTempEst_ECU_Composition: SoftwareComponentInstanceRef=MtrTempEst, ImplementationRef=Ap_MtrTempEst_Implementation
        Task_Init_11b_4_Timer0 (RunnableEntityMapping): PositionInTask=4, ActivationOffset=0, RteCyclicTriggerImplementation=Auto, RTEEventRef=MtrTempEst_Init1_InitEvent, MappedToTaskRef=Task_Init_11b
        Task_100ms_11_3_Timer0 (RunnableEntityMapping): PositionInTask=3, ActivationOffset=0, RteCyclicTriggerImplementation=Auto, RTEEventRef=TMT_MtrTempEst_Per1, MappedToTaskRef=Task_100ms_11
      MtrVel_Sa_MtrVel_ECU_Composition: SoftwareComponentInstanceRef=MtrVel, ImplementationRef=Sa_MtrVel_Implementation
        3 x RunnableEntityMapping, all with ActivationOffset=0, RteCyclicTriggerImplementation=Auto:
          Task_Init_10_21_Timer0: PositionInTask=21, RTEEventRef=MtrVel_InitEvent, MappedToTaskRef=Task_Init_10
          Task_2ms_10_10_Timer0: PositionInTask=10, RTEEventRef=TMT_MtrVel_Per1, MappedToTaskRef=Task_2ms_10
          Task_2ms_10_9_Timer0: PositionInTask=9, RTEEventRef=TMT_MtrVel_Per2, MappedToTaskRef=Task_2ms_10
      MtrVel2_Sa_MtrVel2_ECU_Composition: SoftwareComponentInstanceRef=MtrVel2, ImplementationRef=Sa_MtrVel2_Implementation
        3 x RunnableEntityMapping, all with ActivationOffset=0, RteCyclicTriggerImplementation=Auto:
          Task_2ms_11_2_Timer0: PositionInTask=2, RTEEventRef=TMT_MtrVel2_Per2, MappedToTaskRef=Task_2ms_11
          Task_Init_11b_2_Timer0: PositionInTask=2, RTEEventRef=MtrVel2_InitEvent, MappedToTaskRef=Task_Init_11b
          Task_2ms_11_1_Timer0: PositionInTask=1, RTEEventRef=TMT_MtrVel2_Per1, MappedToTaskRef=Task_2ms_11
      MtrVel3_Sa_MtrVel3_ECU_Composition: SoftwareComponentInstanceRef=MtrVel3, ImplementationRef=Sa_MtrVel3_Implementation
        Task_Init_10_22_Timer0 (RunnableEntityMapping): PositionInTask=22, ActivationOffset=0, RteCyclicTriggerImplementation=Auto, RTEEventRef=MtrVel3_InitEvent, MappedToTaskRef=Task_Init_10
      NexteerLibs_NexteerLibs_ECU_Composition: ServiceComponentPrototypeRef=NexteerLibs, ImplementationRef=NexteerLibs_Implementation
        Task_2ms_10_37_Timer0 (RunnableEntityMapping): PositionInTask=37, ActivationOffset=0, RteCyclicTriggerImplementation=Auto, RTEEventRef=TMT_SystemTime_Per1, MappedToTaskRef=Task_2ms_10
      Nhet1_Cd_Nhet1_ECU_Composition: SoftwareComponentInstanceRef=Nhet1, ImplementationRef=Cd_Nhet1_Implementation
        Task_2ms_9_2_Timer0 (RunnableEntityMapping): PositionInTask=2, ActivationOffset=0, RteCyclicTriggerImplementation=Auto, RTEEventRef=TMT_Nhet1_Per1, MappedToTaskRef=Task_2ms_9
        Task_2ms_9_15_Timer0 (RunnableEntityMapping): PositionInTask=15, ActivationOffset=0, RteCyclicTriggerImplementation=Auto, RTEEventRef=TMT_Nhet1_Per2, MappedToTaskRef=Task_2ms_9
      NtWrap_NtWrap_ECU_Composition: SoftwareComponentInstanceRef=NtWrap, ImplementationRef=NtWrap_Implementation
        Task_100ms_10_6_Timer0 (RunnableEntityMapping): PositionInTask=6, ActivationOffset=0, RteCyclicTriggerImplementation=Auto, RTEEventRef=TMT_NtWrap_Per1, MappedToTaskRef=Task_100ms_10
      NvMProxy_NvMProxy_ECU_Composition: ServiceComponentPrototypeRef=NvMProxy, ImplementationRef=NvMProxy_Implementation
        Task_SchM_10ms_6_4_Timer0 (RunnableEntityMapping): PositionInTask=4, ActivationOffset=0, RteCyclicTriggerImplementation=Auto, RTEEventRef=TMT_NvMProxy_MainFunction, MappedToTaskRef=Task_SchM_10ms_6
      OvrVoltMon_Sa_OvrVoltMon_ECU_Composition: SoftwareComponentInstanceRef=OvrVoltMon, ImplementationRef=Sa_OvrVoltMon_Implementation
        Task_2ms_10_42_Timer0 (RunnableEntityMapping): PositionInTask=42, ActivationOffset=0, RteCyclicTriggerImplementation=Auto, RTEEventRef=TMT_OvrVoltMon_Per1, MappedToTaskRef=Task_2ms_10
      PICurrCntrl_Ap_PICurrCntrl_ECU_Composition: SoftwareComponentInstanceRef=PICurrCntrl, ImplementationRef=Ap_PICurrCntrl_Implementation
        Task_2ms_10_32_Timer0 (RunnableEntityMapping): PositionInTask=32, ActivationOffset=0, RteCyclicTriggerImplementation=Auto, RTEEventRef=TMT_PICurrCntrl_Per2, MappedToTaskRef=Task_2ms_10
      PSASH_Ap_PSASH_ECU_Composition: SoftwareComponentInstanceRef=PSASH, ImplementationRef=Ap_PSASH_Implementation
        Task_Init_9_7_Timer0 (RunnableEntityMapping): PositionInTask=7, ActivationOffset=0, RteCyclicTriggerImplementation=Auto, RTEEventRef=PSASH_Init1_InitEvent, MappedToTaskRef=Task_Init_9
        Task_2ms_9_18_Timer0 (RunnableEntityMapping): PositionInTask=18, ActivationOffset=0, RteCyclicTriggerImplementation=Auto, RTEEventRef=TMT_PSASH_Per1, MappedToTaskRef=Task_2ms_9
      PSATA_Ap_PSATA_ECU_Composition: SoftwareComponentInstanceRef=PSATA, ImplementationRef=Ap_PSATA_Implementation
        Task_Init_10_23_Timer0 (RunnableEntityMapping): PositionInTask=23, ActivationOffset=0, RteCyclicTriggerImplementation=Auto, RTEEventRef=PSATA_Init1_InitEvent, MappedToTaskRef=Task_Init_10
        Task_2ms_10_20_Timer0 (RunnableEntityMapping): PositionInTask=20, ActivationOffset=0, RteCyclicTriggerImplementation=Auto, RTEEventRef=TMT_PSATA_Per1, MappedToTaskRef=Task_2ms_10
      PeakCurrEst_Ap_PeakCurrEst_ECU_Composition: SoftwareComponentInstanceRef=PeakCurrEst, ImplementationRef=Ap_PeakCurrEst_Implementation
        Task_100ms_10_3_Timer0 (RunnableEntityMapping): PositionInTask=3, ActivationOffset=0, RteCyclicTriggerImplementation=Auto, RTEEventRef=TMT_PeakCurrEst_Per2, MappedToTaskRef=Task_100ms_10
        Task_2ms_10_34_Timer0 (RunnableEntityMapping): PositionInTask=34, ActivationOffset=0, RteCyclicTriggerImplementation=Auto, RTEEventRef=TMT_PeakCurrEst_Per1, MappedToTaskRef=Task_2ms_10
      Polarity_Ap_Polarity_ECU_Composition: SoftwareComponentInstanceRef=Polarity, ImplementationRef=Ap_Polarity_Implementation
        Task_10ms_10b_4_Timer0 (RunnableEntityMapping): PositionInTask=4, ActivationOffset=0, RteCyclicTriggerImplementation=Auto, RTEEventRef=TMT_Polarity_Per1, MappedToTaskRef=Task_10ms_10b
        Task_Init_10_0_Timer0 (RunnableEntityMapping): PositionInTask=0, ActivationOffset=0, RteCyclicTriggerImplementation=Auto, RTEEventRef=Polarity_Init1_InitEvent, MappedToTaskRef=Task_Init_10
        MAP_Rte_NvmBlock_Polarity_Polarity_Cnt_Str (NVRamAllocation): SwNvRamMappingReference=Polarity.PolarityBlock, NvmBlockRef=Rte_NvmBlock_Polarity_Polarity_Cnt_Str
      PosServo_Ap_PosServo_ECU_Composition: SoftwareComponentInstanceRef=PosServo, ImplementationRef=Ap_PosServo_Implementation
        Task_2ms_9_12_Timer0 (RunnableEntityMapping): PositionInTask=12, ActivationOffset=0, RteCyclicTriggerImplementation=Auto, RTEEventRef=TMT_PosServo_Per1, MappedToTaskRef=Task_2ms_9
        Task_Init_9_8_Timer0 (RunnableEntityMapping): PositionInTask=8, ActivationOffset=0, RteCyclicTriggerImplementation=Auto, RTEEventRef=PosServo_Init1_InitEvent, MappedToTaskRef=Task_Init_9
      PwrLmtFuncCr_Ap_PwrLmtFuncCr_ECU_Composition: SoftwareComponentInstanceRef=PwrLmtFuncCr, ImplementationRef=Ap_PwrLmtFuncCr_Implementation
        3 x RunnableEntityMapping, all with ActivationOffset=0, RteCyclicTriggerImplementation=Auto:
          Task_10ms_10a_1_Timer0: PositionInTask=1, RTEEventRef=TMT_PwrLmtFuncCr_Per2, MappedToTaskRef=Task_10ms_10a
          Task_Init_10_17_Timer0: PositionInTask=17, RTEEventRef=PwrLmtFuncCr_Init1_InitEvent, MappedToTaskRef=Task_Init_10
          Task_2ms_10_26_Timer0: PositionInTask=26, RTEEventRef=TMT_PwrLmtFuncCr_Per1, MappedToTaskRef=Task_2ms_10
      QuadDet_Ap_QuadDet_ECU_Composition: SoftwareComponentInstanceRef=QuadDet, ImplementationRef=Ap_QuadDet_Implementation
        Task_2ms_10_29_Timer0 (RunnableEntityMapping): PositionInTask=29, ActivationOffset=0, RteCyclicTriggerImplementation=Auto, RTEEventRef=TMT_QuadDet_Per1, MappedToTaskRef=Task_2ms_10
      Return_Ap_Return_ECU_Composition: SoftwareComponentInstanceRef=Return, ImplementationRef=Ap_Return_Implementation
        Task_2ms_9_8_Timer0 (RunnableEntityMapping): PositionInTask=8, ActivationOffset=0, RteCyclicTriggerImplementation=Auto, RTEEventRef=TMT_Return_Per1, MappedToTaskRef=Task_2ms_9
      ReturnFirewall_Ap_ReturnFirewall_ECU_Composition: SoftwareComponentInstanceRef=ReturnFirewall, ImplementationRef=Ap_ReturnFirewall_Implementation
        Task_2ms_10_16_Timer0 (RunnableEntityMapping): PositionInTask=16, ActivationOffset=0, RteCyclicTriggerImplementation=Auto, RTEEventRef=TMT_ReturnFirewall_Per1, MappedToTaskRef=Task_2ms_10
      RteErrata10_RteErrata10_ECU_Composition: SoftwareComponentInstanceRef=RteErrata10, ImplementationRef=RteErrata10_Implementation
        4 x RunnableEntityMapping, all with PositionInTask=7, ActivationOffset=0, RteCyclicTriggerImplementation=Auto, MappedToTaskRef=Task_Trns_10:
          Task_Trns_10_7_TrigModeSwitch3: RTEEventRef=MST_RteErrata10_Trns_3
          Task_Trns_10_7_TrigModeSwitch2: RTEEventRef=MST_RteErrata10_Trns_2
          Task_Trns_10_7_TrigModeSwitch1: RTEEventRef=MST_RteErrata10_Trns_1
          Task_Trns_10_7_TrigModeSwitch0: RTEEventRef=MST_RteErrata10_Trns_0
      RteErrata11_RteErrata11_ECU_Composition: SoftwareComponentInstanceRef=RteErrata11, ImplementationRef=RteErrata11_Implementation
        4 x RunnableEntityMapping, all with PositionInTask=1, ActivationOffset=0, RteCyclicTriggerImplementation=Auto, MappedToTaskRef=Task_Trns_11:
          Task_Trns_11_1_TrigModeSwitch3: RTEEventRef=MST_RteErrata11_Trns_3
          Task_Trns_11_1_TrigModeSwitch2: RTEEventRef=MST_RteErrata11_Trns_2
          Task_Trns_11_1_TrigModeSwitch1: RTEEventRef=MST_RteErrata11_Trns_1
          Task_Trns_11_1_TrigModeSwitch0: RTEEventRef=MST_RteErrata11_Trns_0
      RteErrata6_RteErrata6_ECU_Composition: SoftwareComponentInstanceRef=RteErrata6, ImplementationRef=RteErrata6_Implementation
        4 x RunnableEntityMapping, all with PositionInTask=5, ActivationOffset=0, RteCyclicTriggerImplementation=Auto, MappedToTaskRef=Task_Trns_6:
          Task_Trns_6_5_TrigModeSwitch3: RTEEventRef=MST_RteErrata6_Trns_3
          Task_Trns_6_5_TrigModeSwitch2: RTEEventRef=MST_RteErrata6_Trns_2
          Task_Trns_6_5_TrigModeSwitch1: RTEEventRef=MST_RteErrata6_Trns_1
          Task_Trns_6_5_TrigModeSwitch0: RTEEventRef=MST_RteErrata6_Trns_0
      RteErrata9_RteErrata9_ECU_Composition: SoftwareComponentInstanceRef=RteErrata9, ImplementationRef=RteErrata9_Implementation
        4 x RunnableEntityMapping, all with PositionInTask=11, ActivationOffset=0, RteCyclicTriggerImplementation=Auto, MappedToTaskRef=Task_Trns_9:
          Task_Trns_9_11_TrigModeSwitch3: RTEEventRef=MST_RteErrata9_Trns_3
          Task_Trns_9_11_TrigModeSwitch2: RTEEventRef=MST_RteErrata9_Trns_2
          Task_Trns_9_11_TrigModeSwitch1: RTEEventRef=MST_RteErrata9_Trns_1
          Task_Trns_9_11_TrigModeSwitch0: RTEEventRef=MST_RteErrata9_Trns_0
      ShtdnMech_Sa_ShtdnMech_ECU_Composition: SoftwareComponentInstanceRef=ShtdnMech, ImplementationRef=Sa_ShtdnMech_Implementation
        Task_10ms_10b_5_Timer0 (RunnableEntityMapping): PositionInTask=5, ActivationOffset=0, RteCyclicTriggerImplementation=Auto, RTEEventRef=TMT_ShtdnMech_Per1, MappedToTaskRef=Task_10ms_10b
      SignlCondn_Ap_SignlCondn_ECU_Composition: SoftwareComponentInstanceRef=SignlCondn, ImplementationRef=Ap_SignlCondn_Implementation
        Task_2ms_11_5_Timer0 (RunnableEntityMapping): PositionInTask=5, ActivationOffset=0, RteCyclicTriggerImplementation=Auto, RTEEventRef=TMT_SignlCondn_Per1, MappedToTaskRef=Task_2ms_11
      SrlComDriver_Cd_SrlComDriver_ECU_Composition: SoftwareComponentInstanceRef=SrlComDriver, ImplementationRef=Cd_SrlComDriver_Implementation
        4 x RunnableEntityMapping, all with ActivationOffset=0, RteCyclicTriggerImplementation=Auto:
          Task_10ms_6_2_Timer0: PositionInTask=2, RTEEventRef=TMT_SrlComDriver_Per1, MappedToTaskRef=Task_10ms_6
          Task_Init_6_2_Timer0: PositionInTask=2, RTEEventRef=SrlComDriver_Init1_InitEvent, MappedToTaskRef=Task_Init_6
          Task_Trns_6_3_TrigModeSwitch0: PositionInTask=3, RTEEventRef=MST_SrlComDriver_Trns2_0, MappedToTaskRef=Task_Trns_6
          Task_Trns_6_2_TrigModeSwitch0: PositionInTask=2, RTEEventRef=MST_SrlComDriver_Trns1_0, MappedToTaskRef=Task_Trns_6
      SrlComInput_Ap_SrlComInput_ECU_Composition: SoftwareComponentInstanceRef=SrlComInput, ImplementationRef=Ap_SrlComInput_Implementation
        3 x RunnableEntityMapping, all with ActivationOffset=0, RteCyclicTriggerImplementation=Auto:
          Task_Trns_10_4_TrigModeSwitch0: PositionInTask=4, RTEEventRef=MST_SrlComInput_Trns1_0, MappedToTaskRef=Task_Trns_10
          Task_10ms_10b_1_Timer0: PositionInTask=1, RTEEventRef=TMT_SrlComInput_Per1, MappedToTaskRef=Task_10ms_10b
          Task_Init_10_27_Timer0: PositionInTask=27, RTEEventRef=SrlComInput_InitEvent, MappedToTaskRef=Task_Init_10
        3 x NVRamAllocation:
          MAP_Rte_NvmBlock_SrlComInput_VVHTYPEData: SwNvRamMappingReference=SrlComInput.VVHTYPE, NvmBlockRef=Rte_NvmBlock_SrlComInput_VVHTYPEData
          MAP_Rte_NvmBlock_SrlComInput_ShutdownTimeData: SwNvRamMappingReference=SrlComInput.ShutdownTime, NvmBlockRef=Rte_NvmBlock_SrlComInput_ShutdownTimeData
          MAP_Rte_NvmBlock_SrlComInput_ElecIntData: SwNvRamMappingReference=SrlComInput.ElecInt, NvmBlockRef=Rte_NvmBlock_SrlComInput_ElecIntData
      SrlComOutput_Ap_SrlComOutput_ECU_Composition: SoftwareComponentInstanceRef=SrlComOutput, ImplementationRef=Ap_SrlComOutput_Implementation
        Task_10ms_10a_3_Timer0 (RunnableEntityMapping): PositionInTask=3, ActivationOffset=0, RteCyclicTriggerImplementation=Auto, RTEEventRef=TMT_SrlComOutput_Per1, MappedToTaskRef=Task_10ms_10a
        Task_Init_10_28_Timer0 (RunnableEntityMapping): PositionInTask=28, ActivationOffset=0, RteCyclicTriggerImplementation=Auto, RTEEventRef=SrlComOutput_InitEvent, MappedToTaskRef=Task_Init_10
      StOpCtrl_Ap_StOpCtrl_ECU_Composition: SoftwareComponentInstanceRef=StOpCtrl, ImplementationRef=Ap_StOpCtrl_Implementation
        Task_2ms_10_18_Timer0 (RunnableEntityMapping): PositionInTask=18, ActivationOffset=0, RteCyclicTriggerImplementation=Auto, RTEEventRef=TMT_StOpCtrl_Per1, MappedToTaskRef=Task_2ms_10
      StaMd_Ap_StaMd_ECU_Composition: SoftwareComponentInstanceRef=StaMd, ImplementationRef=Ap_StaMd_Implementation
        Task_Trns_10_5_TrigModeSwitch0 (RunnableEntityMapping): PositionInTask=5, ActivationOffset=0, RteCyclicTriggerImplementation=Auto, RTEEventRef=MST_StaMd_Trns1_0, MappedToTaskRef=Task_Trns_10
        StaMds_MilestoneRqst_WARMINIT_ExclArea (ExclusiveAreaImplementation): ExclusiveAreaImplMechanism=INTERRUPT_BLOCKING, ExclusiveAreaRef=StaMds_MilestoneRqst_WARMINIT_ExclArea
        Task_2ms_10_25_Timer0 (RunnableEntityMapping): PositionInTask=25, ActivationOffset=0, RteCyclicTriggerImplementation=Auto, RTEEventRef=TMT_StaMd_Per1, MappedToTaskRef=Task_2ms_10
        Task_Init_10_3_Timer0 (RunnableEntityMapping): PositionInTask=3, ActivationOffset=0, RteCyclicTriggerImplementation=Auto, RTEEventRef=StaMd_Init1_InitEvent, MappedToTaskRef=Task_Init_10
      StaMd11_Ap_StaMd11_ECU_Composition: SoftwareComponentInstanceRef=StaMd11, ImplementationRef=Ap_StaMd11_Implementation
        Task_2ms_11_8_Timer0 (RunnableEntityMapping): PositionInTask=8, ActivationOffset=0, RteCyclicTriggerImplementation=Auto, RTEEventRef=TMT_StaMd11_Per1, MappedToTaskRef=Task_2ms_11
        StaMds11_MilestoneRqst_WARMINIT_ExclArea (ExclusiveAreaImplementation): ExclusiveAreaImplMechanism=INTERRUPT_BLOCKING, ExclusiveAreaRef=StaMds11_MilestoneRqst_WARMINIT_ExclArea
      StaMd6_Ap_StaMd6_ECU_Composition: SoftwareComponentInstanceRef=StaMd6, ImplementationRef=Ap_StaMd6_Implementation
        Task_2ms_6_1_Timer0 (RunnableEntityMapping): PositionInTask=1, ActivationOffset=0, RteCyclicTriggerImplementation=Auto, RTEEventRef=TMT_StaMd6_Per1, MappedToTaskRef=Task_2ms_6
        StaMds6_MilestoneRqst_WARMINIT_ExclArea (ExclusiveAreaImplementation): ExclusiveAreaImplMechanism=INTERRUPT_BLOCKING, ExclusiveAreaRef=StaMds6_MilestoneRqst_WARMINIT_ExclArea
        Task_SchM_Trns_6_0_Timer0 (RunnableEntityMapping): PositionInTask=0, ActivationOffset=0, RteCyclicTriggerImplementation=Auto, RTEEventRef=TMT_StaMd6_Trns_DemShutdown, MappedToTaskRef=Task_SchM_Trns_6
      StaMd9_Ap_StaMd9_ECU_Composition: SoftwareComponentInstanceRef=StaMd9, ImplementationRef=Ap_StaMd9_Implementation
        Task_2ms_9_20_Timer0 (RunnableEntityMapping): PositionInTask=20, ActivationOffset=0, RteCyclicTriggerImplementation=Auto, RTEEventRef=TMT_StaMd9_Per1, MappedToTaskRef=Task_2ms_9
        StaMds9_MilestoneRqst_WARMINIT_ExclArea (ExclusiveAreaImplementation): ExclusiveAreaImplMechanism=INTERRUPT_BLOCKING, ExclusiveAreaRef=StaMds9_MilestoneRqst_WARMINIT_ExclArea
      StabilityComp_Ap_StabilityComp_ECU_Composition: SoftwareComponentInstanceRef=StabilityComp, ImplementationRef=Ap_StabilityComp_Implementation
        Task_Init_10_16_Timer0 (RunnableEntityMapping): PositionInTask=16, ActivationOffset=0, RteCyclicTriggerImplementation=Auto, RTEEventRef=StabilityComp_Init1_InitEvent, MappedToTaskRef=Task_Init_10
        Task_2ms_10_7_Timer0 (RunnableEntityMapping): PositionInTask=7, ActivationOffset=0, RteCyclicTriggerImplementation=Auto, RTEEventRef=TMT_StabilityComp_Per1, MappedToTaskRef=Task_2ms_10
      StabilityComp2_Ap_StabilityComp2_ECU_Composition: SoftwareComponentInstanceRef=StabilityComp2, ImplementationRef=Ap_StabilityComp2_Implementation
        Task_2ms_11_6_Timer0 (RunnableEntityMapping): PositionInTask=6, ActivationOffset=0, RteCyclicTriggerImplementation=Auto, RTEEventRef=TMT_StabilityComp2_Per1, MappedToTaskRef=Task_2ms_11
        Task_Init_11b_1_Timer0 (RunnableEntityMapping): PositionInTask=1, ActivationOffset=0, RteCyclicTriggerImplementation=Auto, RTEEventRef=StabilityComp2_Init1_InitEvent, MappedToTaskRef=Task_Init_11b
      Sweep_Ap_Sweep_ECU_Composition: SoftwareComponentInstanceRef=Sweep, ImplementationRef=Ap_Sweep_Implementation
        Task_2ms_10_2_Timer0 (RunnableEntityMapping): PositionInTask=2, ActivationOffset=0, RteCyclicTriggerImplementation=Auto, RTEEventRef=TMT_Sweep_Per1, MappedToTaskRef=Task_2ms_10
        Task_Init_10_26_Timer0 (RunnableEntityMapping): PositionInTask=26, ActivationOffset=0, RteCyclicTriggerImplementation=Auto, RTEEventRef=Sweep_InitEvent, MappedToTaskRef=Task_Init_10
      Sweep2_Ap_Sweep2_ECU_Composition: SoftwareComponentInstanceRef=Sweep2, ImplementationRef=Ap_Sweep2_Implementation
        Task_2ms_10_22_Timer0 (RunnableEntityMapping): PositionInTask=22, ActivationOffset=0, RteCyclicTriggerImplementation=Auto, RTEEventRef=TMT_Sweep2_Per1, MappedToTaskRef=Task_2ms_10
      ThrmlDutyCycle_Ap_ThrmlDutyCycle_ECU_Composition: SoftwareComponentInstanceRef=ThrmlDutyCycle, ImplementationRef=Ap_ThrmlDutyCycle_Implementation
        3 x RunnableEntityMapping, all with ActivationOffset=0, RteCyclicTriggerImplementation=Auto:
          Task_Trns_9_9_TrigModeSwitch0: PositionInTask=9, RTEEventRef=MST_ThrmlDutyCycle_Trns1_0, MappedToTaskRef=Task_Trns_9
          Task_100ms_9_3_Timer0: PositionInTask=3, RTEEventRef=TMT_ThrmlDutyCycle_Per1, MappedToTaskRef=Task_100ms_9
          Task_Init_9_3_Timer0: PositionInTask=3, RTEEventRef=ThrmlDutyCycle_Init1_InitEvent, MappedToTaskRef=Task_Init_9
        MAP_Rte_NvmBlock_ThrmlDutyCycle_ThrmlDutyCycle_FltStVal (NVRamAllocation): SwNvRamMappingReference=ThrmlDutyCycle.ThrmlDutyCycle_FltStVar, NvmBlockRef=Rte_NvmBlock_ThrmlDutyCycle_ThrmlDutyCycle_FltStVal
      TmprlMon_Sa_TmprlMon_ECU_Composition: SoftwareComponentInstanceRef=TmprlMon, ImplementationRef=Sa_TmprlMon_Implementation
        5 x RunnableEntityMapping, all with ActivationOffset=0, RteCyclicTriggerImplementation=Auto:
          Task_Trns_9_5_TrigModeSwitch0: PositionInTask=5, RTEEventRef=MST_TmprlMon_Trns2_0, MappedToTaskRef=Task_Trns_9
          Task_2ms_9_1_Timer0: PositionInTask=1, RTEEventRef=TMT_TmprlMon_Per1, MappedToTaskRef=Task_2ms_9
          Task_2ms_9_21_Timer0: PositionInTask=21, RTEEventRef=TMT_TmprlMon_Per2, MappedToTaskRef=Task_2ms_9
          Task_Trns_9_3_TrigModeSwitch0: PositionInTask=3, RTEEventRef=MST_TmprlMon_Trns1_0, MappedToTaskRef=Task_Trns_9
          Task_10ms_9_6_Timer0: PositionInTask=6, RTEEventRef=TMT_TmprlMon_Per3, MappedToTaskRef=Task_10ms_9
      TmprlMon2_Sa_TmprlMon2_ECU_Composition: SoftwareComponentInstanceRef=TmprlMon2, ImplementationRef=Sa_TmprlMon2_Implementation
        Task_2ms_10_36_Timer0 (RunnableEntityMapping): PositionInTask=36, ActivationOffset=0, RteCyclicTriggerImplementation=Auto, RTEEventRef=TMT_TmprlMon2_Per1, MappedToTaskRef=Task_2ms_10
      TqRsDg_Ap_TqRsDg_ECU_Composition: SoftwareComponentInstanceRef=TqRsDg, ImplementationRef=Ap_TqRsDg_Implementation
        Task_Init_10_14_Timer0 (RunnableEntityMapping): PositionInTask=14, ActivationOffset=0, RteCyclicTriggerImplementation=Auto, RTEEventRef=TqRsDg_Init1_InitEvent, MappedToTaskRef=Task_Init_10
        Task_2ms_10_27_Timer0 (RunnableEntityMapping): PositionInTask=27, ActivationOffset=0, RteCyclicTriggerImplementation=Auto, RTEEventRef=TMT_TqRsDg_Per1, MappedToTaskRef=Task_2ms_10
      TrqCanc_Ap_TrqCanc_ECU_Composition: SoftwareComponentInstanceRef=TrqCanc, ImplementationRef=Ap_TrqCanc_Implementation
        Task_2ms_10_31_Timer0 (RunnableEntityMapping): PositionInTask=31, ActivationOffset=0, RteCyclicTriggerImplementation=Auto, RTEEventRef=TMT_TrqCanc_Per1, MappedToTaskRef=Task_2ms_10
        Task_Init_10_10_Timer0 (RunnableEntityMapping): PositionInTask=10, ActivationOffset=0, RteCyclicTriggerImplementation=Auto, RTEEventRef=TrqCanc_InitEvent, MappedToTaskRef=Task_Init_10
        MAP_Rte_NvmBlock_TrqCanc_CogTrqRplComp (NVRamAllocation): SwNvRamMappingReference=TrqCanc.CogTrqRplCompBlk, NvmBlockRef=Rte_NvmBlock_TrqCanc_CogTrqRplComp
        MAP_Rte_NvmBlock_TrqCanc_CogTrqCal (NVRamAllocation): SwNvRamMappingReference=TrqCanc.CogTrqCalBlk, NvmBlockRef=Rte_NvmBlock_TrqCanc_CogTrqCal
      TrqCmdScl_Ap_TrqCmdScl_ECU_Composition: SoftwareComponentInstanceRef=TrqCmdScl, ImplementationRef=Ap_TrqCmdScl_Implementation
        Task_2ms_10_28_Timer0 (RunnableEntityMapping): PositionInTask=28, ActivationOffset=0, RteCyclicTriggerImplementation=Auto, RTEEventRef=TMT_TrqCmdScl_Per1, MappedToTaskRef=Task_2ms_10
        MAP_Rte_NvmBlock_TrqCmdScl_TorqueCmdSF_Uls_f32 (NVRamAllocation): SwNvRamMappingReference=TrqCmdScl.TorqueCmdSF_EOLData, NvmBlockRef=Rte_NvmBlock_TrqCmdScl_TorqueCmdSF_Uls_f32
      TuningSelAuth_Ap_TuningSelAuth_ECU_Composition: SoftwareComponentInstanceRef=TuningSelAuth, ImplementationRef=Ap_TuningSelAuth_Implementation
        Task_10ms_11_2_Timer0 (RunnableEntityMapping): PositionInTask=2, ActivationOffset=0, RteCyclicTriggerImplementation=Auto, RTEEventRef=TMT_TuningSelAuth_Per1, MappedToTaskRef=Task_10ms_11
        Task_Init_11a_1_Timer0 (RunnableEntityMapping): PositionInTask=1, ActivationOffset=0, RteCyclicTriggerImplementation=Auto, RTEEventRef=TuningSelAuth_Init1_InitEvent, MappedToTaskRef=Task_Init_11a
      VehDyn_Ap_VehDyn_ECU_Composition: SoftwareComponentInstanceRef=VehDyn, ImplementationRef=Ap_VehDyn_Implementation
        3 x RunnableEntityMapping, all with ActivationOffset=0, RteCyclicTriggerImplementation=Auto:
          Task_Init_9_11_Timer0: PositionInTask=11, RTEEventRef=VehDyn_Init1_InitEvent, MappedToTaskRef=Task_Init_9
          Task_2ms_9_14_Timer0: PositionInTask=14, RTEEventRef=TMT_VehDyn_Per1, MappedToTaskRef=Task_2ms_9
          Task_Trns_9_10_TrigModeSwitch0: PositionInTask=10, RTEEventRef=MST_VehDyn_Trns1_0, MappedToTaskRef=Task_Trns_9
        MAP_Rte_NvmBlock_VehDyn_MotPosReset (NVRamAllocation): SwNvRamMappingReference=VehDyn.VehDynReset, NvmBlockRef=Rte_NvmBlock_VehDyn_MotPosReset
      VehPwrMd_Ap_VehPwrMd_ECU_Composition: SoftwareComponentInstanceRef=VehPwrMd, ImplementationRef=Ap_VehPwrMd_Implementation
        Task_2ms_9_19_Timer0 (RunnableEntityMapping): PositionInTask=19, ActivationOffset=0, RteCyclicTriggerImplementation=Auto, RTEEventRef=TMT_VehPwrMd_Per1, MappedToTaskRef=Task_2ms_9
        Task_Init_9_2_Timer0 (RunnableEntityMapping): PositionInTask=2, ActivationOffset=0, RteCyclicTriggerImplementation=Auto, RTEEventRef=VehPwrMd_Init1_InitEvent, MappedToTaskRef=Task_Init_9
      VehSpdLmt_Ap_VehSpdLmt_ECU_Composition: SoftwareComponentInstanceRef=VehSpdLmt, ImplementationRef=Ap_VehSpdLmt_Implementation
        Task_2ms_9_6_Timer0 (RunnableEntityMapping): PositionInTask=6, ActivationOffset=0, RteCyclicTriggerImplementation=Auto, RTEEventRef=TMT_VehSpdLmt_Per1, MappedToTaskRef=Task_2ms_9
      WdgM_WdgM_ECU_Composition: ServiceComponentPrototypeRef=WdgM, ImplementationRef=WdgM_Implementation
        Task_SchM_10ms_6_0_Timer0 (RunnableEntityMapping): PositionInTask=0, ActivationOffset=0, RteCyclicTriggerImplementation=Auto, RTEEventRef=TMT_MainFunction, MappedToTaskRef=Task_SchM_10ms_6
      ePWM2_Ap_ePWM2_ECU_Composition: SoftwareComponentInstanceRef=ePWM2, ImplementationRef=Ap_ePWM2_Implementation
        3 x RunnableEntityMapping, all with ActivationOffset=0, RteCyclicTriggerImplementation=Auto:
          Task_Trns_9_1_TrigModeSwitch0: PositionInTask=1, RTEEventRef=MST_ePWM2_Trns2_0, MappedToTaskRef=Task_Trns_9
          Task_Trns_9_7_TrigModeSwitch0: PositionInTask=7, RTEEventRef=MST_ePWM2_Trns1_0, MappedToTaskRef=Task_Trns_9
          Task_2ms_9_16_Timer0: PositionInTask=16, RTEEventRef=TMT_ePWM2_Per1, MappedToTaskRef=Task_2ms_9
      uDiag_Cd_uDiag_ECU_Composition: SoftwareComponentInstanceRef=uDiag, ImplementationRef=Cd_uDiag_Implementation
        7 x RunnableEntityMapping, all with ActivationOffset=0, RteCyclicTriggerImplementation=Auto:
          Task_100ms_10_5_Timer0: PositionInTask=5, RTEEventRef=TMT_uDiagStaticRegs_Per, MappedToTaskRef=Task_100ms_10
          Task_10ms_10b_3_Timer0: PositionInTask=3, RTEEventRef=TMT_uDiagVIM_Per, MappedToTaskRef=Task_10ms_10b
          Task_Init_10_6_Timer0: PositionInTask=6, RTEEventRef=uDiagPeriphStartup_InitEvent, MappedToTaskRef=Task_Init_10
          Task_10ms_10b_2_Timer0: PositionInTask=2, RTEEventRef=TMT_uDiagECC_Per, MappedToTaskRef=Task_10ms_10b
          Task_4ms_10_1_Timer0: PositionInTask=1, RTEEventRef=TMT_uDiagLossOfExec_Per3, MappedToTaskRef=Task_4ms_10
          Task_Init_10_5_Timer0: PositionInTask=5, RTEEventRef=uDiagResetHandler_InitEvent, MappedToTaskRef=Task_Init_10
          Task_2ms_10_39_Timer0: PositionInTask=39, RTEEventRef=TMT_uDiagLossOfExec_Per2, MappedToTaskRef=Task_2ms_10
    80 x ComponentTypeCalibration, all with CalibrationSupportEnabled=false:
      Ap_AbsHwPos: ComponentTypeRef=Ap_AbsHwPos
      Ap_ActivePull: ComponentTypeRef=Ap_ActivePull
      Ap_ApXcp: ComponentTypeRef=Ap_ApXcp
      Ap_Assist: ComponentTypeRef=Ap_Assist
      Ap_AssistFirewall: ComponentTypeRef=Ap_AssistFirewall
      Ap_AstLmt: ComponentTypeRef=Ap_AstLmt
      Ap_AvgFricLrn: ComponentTypeRef=Ap_AvgFricLrn
      Ap_BVDiag: ComponentTypeRef=Ap_BVDiag
      Ap_BatteryVoltage: ComponentTypeRef=Ap_BatteryVoltage
      Ap_ChkPtAp10: ComponentTypeRef=Ap_ChkPtAp10
      Ap_ChkPtAp11: ComponentTypeRef=Ap_ChkPtAp11
      Ap_ChkPtAp6: ComponentTypeRef=Ap_ChkPtAp6
      Ap_ChkPtAp9: ComponentTypeRef=Ap_ChkPtAp9
      Ap_ComplErr: ComponentTypeRef=Ap_ComplErr
      Ap_CtrldDisShtdn: ComponentTypeRef=Ap_CtrldDisShtdn
      Ap_CurrCmd: ComponentTypeRef=Ap_CurrCmd
      Ap_CurrParamComp: ComponentTypeRef=Ap_CurrParamComp
      Ap_CustBattDiag: ComponentTypeRef=Ap_CustBattDiag
      Ap_Damping: ComponentTypeRef=Ap_Damping
      Ap_DampingFirewall: ComponentTypeRef=Ap_DampingFirewall
      Ap_DemIf: ComponentTypeRef=Ap_DemIf
      Ap_DiagMgr10: ComponentTypeRef=Ap_DiagMgr10
      Ap_DiagMgr11: ComponentTypeRef=Ap_DiagMgr11
      Ap_DiagMgr6: ComponentTypeRef=Ap_DiagMgr6
      Ap_DiagMgr9: ComponentTypeRef=Ap_DiagMgr9
      Ap_DiagSvc: ComponentTypeRef=Ap_DiagSvc
      Ap_DigPhsReasDiag: ComponentTypeRef=Ap_DigPhsReasDiag
      Ap_EOTActuatorMng: ComponentTypeRef=Ap_EOTActuatorMng
      Ap_ElePwr: ComponentTypeRef=Ap_ElePwr
      Ap_EtDmpFw: ComponentTypeRef=Ap_EtDmpFw
      Ap_FaultLog: ComponentTypeRef=Ap_FaultLog
      Ap_FltInjection: ComponentTypeRef=Ap_FltInjection
      Ap_FrqDepDmpnInrtCmp: ComponentTypeRef=Ap_FrqDepDmpnInrtCmp
      Ap_GCCDiag: ComponentTypeRef=Ap_GCCDiag
      Ap_Gsod: ComponentTypeRef=Ap_Gsod
      Ap_HiLoadStall: ComponentTypeRef=Ap_HiLoadStall
      Ap_HighFreqAssist: ComponentTypeRef=Ap_HighFreqAssist
      Ap_HwPwUp: ComponentTypeRef=Ap_HwPwUp
      Ap_HystComp: ComponentTypeRef=Ap_HystComp
      IoHwAb10: ComponentTypeRef=IoHwAb10
      IoHwAb9: ComponentTypeRef=IoHwAb9
      Ap_LmtCod: ComponentTypeRef=Ap_LmtCod
      Ap_LrnEOT: ComponentTypeRef=Ap_LrnEOT
      Ap_MtrTempEst: ComponentTypeRef=Ap_MtrTempEst
      NtWrap: ComponentTypeRef=NtWrap
      Ap_PICurrCntrl: ComponentTypeRef=Ap_PICurrCntrl
      Ap_PSASH: ComponentTypeRef=Ap_PSASH
      Ap_PSATA: ComponentTypeRef=Ap_PSATA
      Ap_PeakCurrEst: ComponentTypeRef=Ap_PeakCurrEst
      Ap_Polarity: ComponentTypeRef=Ap_Polarity
      Ap_PosServo: ComponentTypeRef=Ap_PosServo
      Ap_PwrLmtFuncCr: ComponentTypeRef=Ap_PwrLmtFuncCr
      Ap_QuadDet: ComponentTypeRef=Ap_QuadDet
      Ap_Return: ComponentTypeRef=Ap_Return
      Ap_ReturnFirewall: ComponentTypeRef=Ap_ReturnFirewall
      RteErrata10: ComponentTypeRef=RteErrata10
      RteErrata11: ComponentTypeRef=RteErrata11
      RteErrata6: ComponentTypeRef=RteErrata6
      RteErrata9: ComponentTypeRef=RteErrata9
      Ap_SignlCondn: ComponentTypeRef=Ap_SignlCondn
      Ap_SrlComInput: ComponentTypeRef=Ap_SrlComInput
      Ap_SrlComOutput: ComponentTypeRef=Ap_SrlComOutput
      Ap_StOpCtrl: ComponentTypeRef=Ap_StOpCtrl
      Ap_StaMd: ComponentTypeRef=Ap_StaMd
      Ap_StaMd11: ComponentTypeRef=Ap_StaMd11
      Ap_StaMd6: ComponentTypeRef=Ap_StaMd6
      Ap_StaMd9: ComponentTypeRef=Ap_StaMd9
      Ap_StabilityComp: ComponentTypeRef=Ap_StabilityComp
      Ap_StabilityComp2: ComponentTypeRef=Ap_StabilityComp2
      Ap_Sweep: ComponentTypeRef=Ap_Sweep
      Ap_Sweep2: ComponentTypeRef=Ap_Sweep2
      Ap_ThrmlDutyCycle: ComponentTypeRef=Ap_ThrmlDutyCycle
      Ap_TqRsDg: ComponentTypeRef=Ap_TqRsDg
      Ap_TrqCanc: ComponentTypeRef=Ap_TrqCanc
      Ap_TrqCmdScl: ComponentTypeRef=Ap_TrqCmdScl
      Ap_TuningSelAuth: ComponentTypeRef=Ap_TuningSelAuth
      Ap_VehDyn: ComponentTypeRef=Ap_VehDyn
      Ap_VehPwrMd: ComponentTypeRef=Ap_VehPwrMd
      Ap_VehSpdLmt: ComponentTypeRef=Ap_VehSpdLmt
      Ap_ePWM2: ComponentTypeRef=Ap_ePWM2
  module config ShtdnMech: implementation-config-variant=VARIANT-PRE-COMPILE  # Configuration of the Nexteer ShtdnMech module.
    ShtdnMechGeneral
    CommonPublishedInformation: ArMajorVersion=3, ArMinorVersion=2, ArPatchVersion=0, SwMajorVersion=0, SwMinorVersion=0, SwPatchVersion=0, ModuleId=0, VendorId=0
  module config SignlCondn: implementation-config-variant=VARIANT-PRE-COMPILE  # Configuration of the Nexteer SignlCondn module.
    SignlCondnGeneral
    CommonPublishedInformation: ArMajorVersion=3, ArMinorVersion=2, ArPatchVersion=0, SwMajorVersion=0, SwMinorVersion=0, SwPatchVersion=0, ModuleId=0, VendorId=0
  module config StabilityComp: implementation-config-variant=VARIANT-PRE-COMPILE  # Configuration of the Nexteer StabilityComp module.
    StabilityCompGeneral
    CommonPublishedInformation: ArMajorVersion=3, ArMinorVersion=2, ArPatchVersion=0, SwMajorVersion=0, SwMinorVersion=0, SwPatchVersion=0, ModuleId=0, VendorId=0
  module config StabilityComp2: implementation-config-variant=VARIANT-PRE-COMPILE  # Configuration of the Nexteer StabilityComp2 module.
    StabilityComp2General
    CommonPublishedInformation: ArMajorVersion=3, ArMinorVersion=2, ArPatchVersion=0, SwMajorVersion=0, SwMinorVersion=0, SwPatchVersion=0, ModuleId=0, VendorId=0
  module config StaMd: implementation-config-variant=VARIANT-PRE-COMPILE  # Configuration of the Nexteer States and Modes module.
    StaMdGeneral:
      TypeHDataSize = 100
      StaMdTODType = TOD_SteadyState
      StaMdNvMWriteAllAPI = NvMProxy_WriteAll
      StaMdNvMGetErrorStatusAPI = NvMProxy_GetErrorStatus
      StaMdTrnsDiagMgrShtDwnTaskActivation = Task_SchM_Trns_6
      GenerateExcludeOsAppRef = Ap_0
      StaMdCoreOsAppRef = Ap_10
      StaMdSComOsAppRef = Ap_6
      StaMdSysCovOsAppRef = Ap_11
    CommonPublishedInformation: ArMajorVersion=3, ArMinorVersion=2, ArPatchVersion=0, SwMajorVersion=0, SwMinorVersion=0, SwPatchVersion=0, ModuleId=0, VendorId=0
  module config StOpCtrl: implementation-config-variant=VARIANT-PRE-COMPILE  # Configuration of the Nexteer StOpCtrl module.
    StOpCtrlGeneral
    CommonPublishedInformation: ArMajorVersion=3, ArMinorVersion=2, ArPatchVersion=0, SwMajorVersion=0, SwMinorVersion=0, SwPatchVersion=0, ModuleId=0, VendorId=0
  module config ThrmlDutyCycle: implementation-config-variant=VARIANT-PRE-COMPILE  # Configuration of the Nexteer ThrmlDutyCycle module.
    ThrmlDutyCycleGeneral
    CommonPublishedInformation: ArMajorVersion=3, ArMinorVersion=2, ArPatchVersion=0, SwMajorVersion=0, SwMinorVersion=0, SwPatchVersion=0, ModuleId=0, VendorId=0
  module config TmprlMon: implementation-config-variant=VARIANT-PRE-COMPILE  # Configuration of the Nexteer TmprlMon module.
    TmprlMonGeneral
    CommonPublishedInformation: ArMajorVersion=3, ArMinorVersion=2, ArPatchVersion=0, SwMajorVersion=0, SwMinorVersion=0, SwPatchVersion=0, ModuleId=0, VendorId=0
  module config TmprlMon2: implementation-config-variant=VARIANT-PRE-COMPILE  # Configuration of the Nexteer TmprlMon2 module.
    TmprlMon2General
    CommonPublishedInformation: ArMajorVersion=3, ArMinorVersion=2, ArPatchVersion=0, SwMajorVersion=0, SwMinorVersion=0, SwPatchVersion=0, ModuleId=0, VendorId=0
  module config TqRsDg: implementation-config-variant=VARIANT-PRE-COMPILE  # Configuration of the Nexteer TqRsDg module.
    TqRsDgGeneral
    CommonPublishedInformation: ArMajorVersion=3, ArMinorVersion=2, ArPatchVersion=0, SwMajorVersion=0, SwMinorVersion=0, SwPatchVersion=0, ModuleId=0, VendorId=0
  module config TrqCanc: implementation-config-variant=VARIANT-PRE-COMPILE  # Configuration of the Nexteer TrqCanc module.
    TrqCancGeneral
    CommonPublishedInformation: ArMajorVersion=3, ArMinorVersion=2, ArPatchVersion=0, SwMajorVersion=0, SwMinorVersion=0, SwPatchVersion=0, ModuleId=0, VendorId=0
  module config TrqCmdScl: implementation-config-variant=VARIANT-PRE-COMPILE  # Configuration of the Nexteer TrqCmdScl module.
    TrqCmdSclGeneral
    CommonPublishedInformation: ArMajorVersion=3, ArMinorVersion=2, ArPatchVersion=0, SwMajorVersion=0, SwMinorVersion=0, SwPatchVersion=0, ModuleId=0, VendorId=0
  module config TuningSelAuth: implementation-config-variant=VARIANT-PRE-COMPILE  # Configuration of the Nexteer TuningSelAuth module.
    TuningSelAuthGeneral
    CommonPublishedInformation: ArMajorVersion=3, ArMinorVersion=2, ArPatchVersion=0, SwMajorVersion=0, SwMinorVersion=0, SwPatchVersion=0, ModuleId=0, VendorId=0

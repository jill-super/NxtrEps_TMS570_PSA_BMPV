[part 3 of 3: package /ActiveEcuC]
AUTOSAR XML (schema 3.0.2)
package /ActiveEcuC  (continued)
  module config uDiag: implementation-config-variant=VARIANT-PRE-COMPILE  # Configuration of the Microprocessor diagnostics module
    RuntimeRegCheck (uDiagRegChkConfigSet)
      GHVSRC (uDiagRegCheck): uDiagRegAddress=4294967112, uDiagRegValue=16842753
      FBPARERR (uDiagRegCheckLnk): uDiagRegAddress=4294966776, uDiagRegValueLnk=VIM_Fallback, uDiagRegUseSizeofInOffset=false, uDiagRegValueLnkOffset=0
      205 x uDiagRegCheck:
        RCLKSRC: uDiagRegAddress=4294967120, uDiagRegValue=9
        BMMCR1: uDiagRegAddress=4294967236, uDiagRegValue=10
        CLKCNTL: uDiagRegAddress=4294967248, uDiagRegValue=16843008
        LOGICPDPWRCTRL0: uDiagRegAddress=4294901760, uDiagRegValue=84216325
        MEMPDPWRCTRL0: uDiagRegAddress=4294901776, uDiagRegValue=84541440
        PDCLKDISREG: uDiagRegAddress=4294901792, uDiagRegValue=4
        GLOBALCTRL1: uDiagRegAddress=4294901920, uDiagRegValue=0
        PINMMR00: uDiagRegAddress=4294961936, uDiagRegValue=33685504
        PINMMR01: uDiagRegAddress=4294961940, uDiagRegValue=16843776
        PINMMR02: uDiagRegAddress=4294961944, uDiagRegValue=67174657
        PINMMR03: uDiagRegAddress=4294961948, uDiagRegValue=17039361
        PINMMR04: uDiagRegAddress=4294961952, uDiagRegValue=269484292
        PINMMR05: uDiagRegAddress=4294961956, uDiagRegValue=17302532
        PINMMR06: uDiagRegAddress=4294961960, uDiagRegValue=16843024
        PINMMR07: uDiagRegAddress=4294961964, uDiagRegValue=16843009
        PINMMR08: uDiagRegAddress=4294961968, uDiagRegValue=16843009
        PINMMR09: uDiagRegAddress=4294961972, uDiagRegValue=16843009
        PINMMR10: uDiagRegAddress=4294961976, uDiagRegValue=16843009
        PINMMR11: uDiagRegAddress=4294961980, uDiagRegValue=16843009
        PINMMR12: uDiagRegAddress=4294961984, uDiagRegValue=16843009
        PINMMR13: uDiagRegAddress=4294961988, uDiagRegValue=16843009
        PINMMR14: uDiagRegAddress=4294961992, uDiagRegValue=16843009
        PINMMR15: uDiagRegAddress=4294961996, uDiagRegValue=16843009
        PINMMR16: uDiagRegAddress=4294962000, uDiagRegValue=16843009
        PINMMR17: uDiagRegAddress=4294962004, uDiagRegValue=16843009
        PINMMR18: uDiagRegAddress=4294962008, uDiagRegValue=65537
        PINMMR19: uDiagRegAddress=4294962012, uDiagRegValue=16843009
        PINMMR20: uDiagRegAddress=4294962016, uDiagRegValue=16843009
        PINMMR21: uDiagRegAddress=4294962020, uDiagRegValue=16842753
        PINMMR22: uDiagRegAddress=4294962024, uDiagRegValue=16843009
        PINMMR23: uDiagRegAddress=4294962028, uDiagRegValue=1
        PINMMR24: uDiagRegAddress=4294962032, uDiagRegValue=0
        PINMMR25: uDiagRegAddress=4294962036, uDiagRegValue=0
        PINMMR26: uDiagRegAddress=4294962040, uDiagRegValue=16842752
        PINMMR27: uDiagRegAddress=4294962044, uDiagRegValue=16843009
        PINMMR28: uDiagRegAddress=4294962048, uDiagRegValue=16843009
        PINMMR29: uDiagRegAddress=4294962052, uDiagRegValue=257
        PINMMR30: uDiagRegAddress=4294962056, uDiagRegValue=514
        FRDCNTL: uDiagRegAddress=4294471680, uDiagRegValue=785
        FEDACTRL1: uDiagRegAddress=4294471688, uDiagRegValue=656906
        RAMCTRL_EVEN: uDiagRegAddress=4294965248, uDiagRegValue=327690
        RAMTHRESHOLD_EVEN: uDiagRegAddress=4294965252, uDiagRegValue=1
        RAMINTCTRL_EVEN: uDiagRegAddress=4294965260, uDiagRegValue=1
        RAMTEST_EVEN: uDiagRegAddress=4294965296, uDiagRegValue=5
        RAMCTRL_ODD: uDiagRegAddress=4294965504, uDiagRegValue=327690
        RAMTHRESHOLD_ODD: uDiagRegAddress=4294965508, uDiagRegValue=1
        RAMINTCTRL_ODD: uDiagRegAddress=4294965516, uDiagRegValue=1
        RAMTEST_ODD: uDiagRegAddress=4294965552, uDiagRegValue=5
        PACT: uDiagRegAddress=4294960512, uDiagRegValue=0
        STCGCR1: uDiagRegAddress=4294960644, uDiagRegValue=5
        CCMKEYR: uDiagRegAddress=4294964740, uDiagRegValue=0
        PLLCTL1: uDiagRegAddress=4294967152, uDiagRegValue=352000
        PLLCTL2: uDiagRegAddress=4294967156, uDiagRegValue=29184
        PLLCTL3: uDiagRegAddress=4294959360, uDiagRegValue=1610964736
        DCCGCTRL_DCC1: uDiagRegAddress=4294962176, uDiagRegValue=10
        DCCCNT0SEED_DCC1: uDiagRegAddress=4294962184, uDiagRegValue=9333
        DCCVALID0SEED_DCC1: uDiagRegAddress=4294962188, uDiagRegValue=39666
        DCCCNT1SEED_DCC1: uDiagRegAddress=4294962192, uDiagRegValue=9800
        DCCCNT1CLKSRC_DCC1: uDiagRegAddress=4294962212, uDiagRegValue=40963
        DCCCNT0CLKSRC_DCC1: uDiagRegAddress=4294962216, uDiagRegValue=0
        DCCGCTRL_DCC2: uDiagRegAddress=4294964224, uDiagRegValue=10
        DCCCNT0SEED_DCC2: uDiagRegAddress=4294964232, uDiagRegValue=19417
        DCCVALID0SEED_DCC2: uDiagRegAddress=4294964236, uDiagRegValue=1201
        DCCCNT1SEED_DCC2: uDiagRegAddress=4294964240, uDiagRegValue=80000
        DCCCNT1CLKSRC_DCC2: uDiagRegAddress=4294964260, uDiagRegValue=40968
        DCCCNT0CLKSRC_DCC2: uDiagRegAddress=4294964264, uDiagRegValue=0
        ESMEEPAPR1: uDiagRegAddress=4294964480, uDiagRegValue=0
        ESMIESR1: uDiagRegAddress=4294964488, uDiagRegValue=1411910606
        ESMILSR1: uDiagRegAddress=4294964496, uDiagRegValue=2048
        ESMLTCPR: uDiagRegAddress=4294964532, uDiagRegValue=16383
        ESMIEPSR4: uDiagRegAddress=4294964544, uDiagRegValue=0
        ESMIESR4: uDiagRegAddress=4294964552, uDiagRegValue=1073741860
        ESMILSR4: uDiagRegAddress=4294964560, uDiagRegValue=0
        RTIGCTRL: uDiagRegAddress=4294966272, uDiagRegValue=3
        RTITBCTRL: uDiagRegAddress=4294966276, uDiagRegValue=0
        RTISETINTENA: uDiagRegAddress=4294966400, uDiagRegValue=1
        RTIDWDCTRL: uDiagRegAddress=4294966416, uDiagRegValue=2844088794
        RTIDWDPRLD: uDiagRegAddress=4294966420, uDiagRegValue=57
        RTIWWDRXNCTRL: uDiagRegAddress=4294966436, uDiagRegValue=5
        RTIWWDSIZECTRL: uDiagRegAddress=4294966440, uDiagRegValue=5
        CRC_CTRL1: uDiagRegAddress=4261412872, uDiagRegValue=0
        PARCTL: uDiagRegAddress=4294966768, uDiagRegValue=10
        FIRQPR0_FIQ_IRQ: uDiagRegAddress=4294966800, uDiagRegValue=3
        FIRQPR1_FIQ_IRQ: uDiagRegAddress=4294966804, uDiagRegValue=0
        FIRQPR2_FIQ_IRQ: uDiagRegAddress=4294966808, uDiagRegValue=0
        CHANCTRL0: uDiagRegAddress=4294966912, uDiagRegValue=75779
        CHANCTRL23: uDiagRegAddress=4294967004, uDiagRegValue=50529027
        ADOPMODECR_ADC1: uDiagRegAddress=4294426628, uDiagRegValue=2148794369
        ADCLOCKCR_ADC1: uDiagRegAddress=4294426632, uDiagRegValue=4
        ADCALCR_ADC1: uDiagRegAddress=4294426636, uDiagRegValue=0
        ADEVMODECR_ADC1: uDiagRegAddress=4294426640, uDiagRegValue=65585
        ADG1MODECR_ADC1: uDiagRegAddress=4294426644, uDiagRegValue=65584
        ADG2MODECR_ADC1: uDiagRegAddress=4294426648, uDiagRegValue=65592
        ADEVSRC_ADC1: uDiagRegAddress=4294426652, uDiagRegValue=0
        ADG1SRC_ADC1: uDiagRegAddress=4294426656, uDiagRegValue=0
        ADG2SRC_ADC1: uDiagRegAddress=4294426660, uDiagRegValue=1
        ADEVINTENA_ADC1: uDiagRegAddress=4294426664, uDiagRegValue=0
        ADG1INTENA_ADC1: uDiagRegAddress=4294426668, uDiagRegValue=0
        ADG2INTENA_ADC1: uDiagRegAddress=4294426672, uDiagRegValue=0
        ADBNDCR_ADC1: uDiagRegAddress=4294426712, uDiagRegValue=1966110
        ADBNDEND_ADC1: uDiagRegAddress=4294426716, uDiagRegValue=2
        ADEVSAMP_ADC1: uDiagRegAddress=4294426720, uDiagRegValue=6
        ADG1SAMP_ADC1: uDiagRegAddress=4294426724, uDiagRegValue=6
        ADG2SAMP_ADC1: uDiagRegAddress=4294426728, uDiagRegValue=6
        ADEVSEL_ADC1: uDiagRegAddress=4294426744, uDiagRegValue=0
        ADG1SEL_ADC1: uDiagRegAddress=4294426748, uDiagRegValue=0
        ADG2SEL_ADC1: uDiagRegAddress=4294426752, uDiagRegValue=8481
        ADPARCR_ADC1: uDiagRegAddress=4294427008, uDiagRegValue=10
        ADOPMODECR_ADC2: uDiagRegAddress=4294427140, uDiagRegValue=2148794369
        ADCLOCKCR_ADC2: uDiagRegAddress=4294427144, uDiagRegValue=4
        ADCALCR_ADC2: uDiagRegAddress=4294427148, uDiagRegValue=0
        ADEVMODECR_ADC2: uDiagRegAddress=4294427152, uDiagRegValue=65584
        ADG1MODECR_ADC2: uDiagRegAddress=4294427156, uDiagRegValue=65592
        ADG2MODECR_ADC2: uDiagRegAddress=4294427160, uDiagRegValue=65584
        ADEVSRC_ADC2: uDiagRegAddress=4294427164, uDiagRegValue=0
        ADG1SRC_ADC2: uDiagRegAddress=4294427168, uDiagRegValue=3
        ADG2SRC_ADC2: uDiagRegAddress=4294427172, uDiagRegValue=0
        ADEVINTENA_ADC2: uDiagRegAddress=4294427176, uDiagRegValue=0
        ADG1INTENA_ADC2: uDiagRegAddress=4294427180, uDiagRegValue=0
        ADG2INTENA_ADC2: uDiagRegAddress=4294427184, uDiagRegValue=0
        ADBNDCR_ADC2: uDiagRegAddress=4294427224, uDiagRegValue=2
        ADBNDEND_ADC2: uDiagRegAddress=4294427228, uDiagRegValue=2
        ADEVSAMP_ADC2: uDiagRegAddress=4294427232, uDiagRegValue=6
        ADG1SAMP_ADC2: uDiagRegAddress=4294427236, uDiagRegValue=6
        ADG2SAMP_ADC2: uDiagRegAddress=4294427240, uDiagRegValue=6
        ADEVSEL_ADC2: uDiagRegAddress=4294427256, uDiagRegValue=0
        ADG1SEL_ADC2: uDiagRegAddress=4294427260, uDiagRegValue=8451
        ADG2SEL_ADC2: uDiagRegAddress=4294427264, uDiagRegValue=0
        ADPARCR_ADC2: uDiagRegAddress=4294427520, uDiagRegValue=10
        HETGCR_HET1: uDiagRegAddress=4294424576, uDiagRegValue=393217
        HETPFR_HET1: uDiagRegAddress=4294424580, uDiagRegValue=1792
        HETEXC1_HET1: uDiagRegAddress=4294424604, uDiagRegValue=0
        HETPRY_HET1: uDiagRegAddress=4294424612, uDiagRegValue=0
        HETAND_HET1: uDiagRegAddress=4294424620, uDiagRegValue=0
        HETHRSH_HET1: uDiagRegAddress=4294424628, uDiagRegValue=0
        HETXOR_HET1: uDiagRegAddress=4294424632, uDiagRegValue=0
        HETREQENS_HET1: uDiagRegAddress=4294424636, uDiagRegValue=22
        HETREQDS_HET1: uDiagRegAddress=4294424644, uDiagRegValue=16
        HETPCR_HET1: uDiagRegAddress=4294424692, uDiagRegValue=10
        HETPPR_HET1: uDiagRegAddress=4294424700, uDiagRegValue=0
        HETLBPSEL_HET1: uDiagRegAddress=4294424716, uDiagRegValue=0
        HETLBPDIR_HET1: uDiagRegAddress=4294424720, uDiagRegValue=327680
        HETPINDIS_HET1: uDiagRegAddress=4294424724, uDiagRegValue=0
        HETGCR_HET2: uDiagRegAddress=4294424832, uDiagRegValue=196609
        HETPFR_HET2: uDiagRegAddress=4294424836, uDiagRegValue=1024
        HETEXC1_HET2: uDiagRegAddress=4294424860, uDiagRegValue=0
        HETPRY_HET2: uDiagRegAddress=4294424868, uDiagRegValue=0
        HETAND_HET2: uDiagRegAddress=4294424876, uDiagRegValue=0
        HETHRSH_HET2: uDiagRegAddress=4294424884, uDiagRegValue=244
        HETXOR_HET2: uDiagRegAddress=4294424888, uDiagRegValue=0
        HETREQENS_HET2: uDiagRegAddress=4294424892, uDiagRegValue=0
        HETREQDS_HET2: uDiagRegAddress=4294424900, uDiagRegValue=0
        HETDIR_HET2: uDiagRegAddress=4294424908, uDiagRegValue=0
        HETPCR_HET2: uDiagRegAddress=4294424948, uDiagRegValue=10
        HETPPR_HET2: uDiagRegAddress=4294424956, uDiagRegValue=0
        HETLBPSEL_HET2: uDiagRegAddress=4294424972, uDiagRegValue=0
        HETLBPDIR_HET2: uDiagRegAddress=4294424976, uDiagRegValue=327680
        HETPINDIS_HET2: uDiagRegAddress=4294424980, uDiagRegValue=0
        HTU__GC_HTU1: uDiagRegAddress=4294419456, uDiagRegValue=65792
        HTU__MP1S_HTU1: uDiagRegAddress=4294419532, uDiagRegValue=0
        HTU__MP1E_HTU1: uDiagRegAddress=4294419536, uDiagRegValue=0
        HTU__GC_HTU2: uDiagRegAddress=4294419712, uDiagRegValue=0
        HTU_IHADDRCT_HTU1: uDiagRegAddress=4283301896, uDiagRegValue=0
        HTU_ITCOUNT_HTU1: uDiagRegAddress=4283301900, uDiagRegValue=0
        GIOGCR0: uDiagRegAddress=4294425600, uDiagRegValue=1
        GIOINTDET: uDiagRegAddress=4294425608, uDiagRegValue=0
        GIOPOL: uDiagRegAddress=4294425612, uDiagRegValue=0
        GIODIR_A_: uDiagRegAddress=4294425652, uDiagRegValue=0
        GIODIR_B_: uDiagRegAddress=4294425684, uDiagRegValue=0
        DMA_DMAMPCTRL: uDiagRegAddress=4294963632, uDiagRegValue=252250377
        DMA_DMAMPR0S: uDiagRegAddress=4294963640, uDiagRegValue=4278845440
        DMA_DMAMPR0E: uDiagRegAddress=4294963644, uDiagRegValue=4282859519
        DMA_DMAMPR1S: uDiagRegAddress=4294963648, uDiagRegValue=4244081664
        DMA_DMAMPR1E: uDiagRegAddress=4294963652, uDiagRegValue=4261413375
        DMA_DMAMPR3S: uDiagRegAddress=4294963664, uDiagRegValue=2097152
        DMA_DMAMPR3E: uDiagRegAddress=4294963668, uDiagRegValue=4294967295
        DMA_CP00_IDADDR: uDiagRegAddress=4294443012, uDiagRegValue=4261412968
        DMA_CP00_ITCOUNT: uDiagRegAddress=4294443016, uDiagRegValue=65537
        DMA_CP00_CHCTRL: uDiagRegAddress=4294443024, uDiagRegValue=61440
        DMA_CP01_IDADDR: uDiagRegAddress=4294443044, uDiagRegValue=4261412960
        DMA_CP01_CHCTRL: uDiagRegAddress=4294443056, uDiagRegValue=61704
        DMA_CP02_ISADDR: uDiagRegAddress=4294443072, uDiagRegValue=4278977026
        DMA_CP02_ITCOUNT: uDiagRegAddress=4294443080, uDiagRegValue=65539
        DMA_CP02_CHCTRL: uDiagRegAddress=4294443088, uDiagRegValue=20767
        DMA_CP02_EIOFF: uDiagRegAddress=4294443092, uDiagRegValue=131076
        DMA_CP03_ISADDR: uDiagRegAddress=4294443104, uDiagRegValue=4281991170
        DMA_CP03_ITCOUNT: uDiagRegAddress=4294443112, uDiagRegValue=65540
        DMA_CP03_CHCTRL: uDiagRegAddress=4294443120, uDiagRegValue=20767
        DMA_CP03_EIOFF: uDiagRegAddress=4294443124, uDiagRegValue=131076
        DMA_CP05_IDADDR: uDiagRegAddress=4294443172, uDiagRegValue=4282777832
        DMA_CP05_ITCOUNT: uDiagRegAddress=4294443176, uDiagRegValue=65537
        DMA_CP05_CHCTRL: uDiagRegAddress=4294443184, uDiagRegValue=499969
        DMA_CP06_IDADDR: uDiagRegAddress=4294443204, uDiagRegValue=4244081680
        DMA_CP06_ITCOUNT: uDiagRegAddress=4294443208, uDiagRegValue=262146
        DMA_CP06_CHCTRL: uDiagRegAddress=4294443216, uDiagRegValue=20767
        DMA_CP06_EIOFF: uDiagRegAddress=4294443220, uDiagRegValue=393218
        DMA_CP06_FIOFF: uDiagRegAddress=4294443224, uDiagRegValue=16777220
        DMA_CP09_ISADDR: uDiagRegAddress=4294443296, uDiagRegValue=4282253554
        DMA_CP09_ITCOUNT: uDiagRegAddress=4294443304, uDiagRegValue=65540
        DMA_CP09_CHCTRL: uDiagRegAddress=4294443312, uDiagRegValue=20767
        DMA_CP09_EIOFF: uDiagRegAddress=4294443316, uDiagRegValue=131076
        DMA_CP12_ISADDR: uDiagRegAddress=4294443392, uDiagRegValue=4278845954
        DMA_CP12_ITCOUNT: uDiagRegAddress=4294443400, uDiagRegValue=65539
        DMA_CP12_CHCTRL: uDiagRegAddress=4294443408, uDiagRegValue=20767
        DMA_CP12_EIOFF: uDiagRegAddress=4294443412, uDiagRegValue=131076
      12 x uDiagRegCheckLnk:
        DMA_CP02_IDADDR: uDiagRegAddress=4294443076, uDiagRegValueLnk=DMAData_G_str.FastSPI_Cnt_u16[0], uDiagRegUseSizeofInOffset=false, uDiagRegValueLnkOffset=0
        DMA_CP03_IDADDR: uDiagRegAddress=4294443108, uDiagRegValueLnk=DMAData_G_str.FastADC_Cnt_u16[0], uDiagRegUseSizeofInOffset=false, uDiagRegValueLnkOffset=0
        DMA_CP05_ISADDR: uDiagRegAddress=4294443168, uDiagRegValueLnk=DMAData_G_str.PWMPeriod_Cnt_u32, uDiagRegUseSizeofInOffset=false, uDiagRegValueLnkOffset=0
        DMA_CP06_ISADDR: uDiagRegAddress=4294443200, uDiagRegValueLnk=DMAData_G_str.PWMCmp_Cnt_u16[0][0], uDiagRegUseSizeofInOffset=false, uDiagRegValueLnkOffset=0
        DMA_CP09_IDADDR: uDiagRegAddress=4294443300, uDiagRegValueLnk=DMAData_G_str.SlowADC_Cnt_u16[0], uDiagRegUseSizeofInOffset=false, uDiagRegValueLnkOffset=0
        DMA_CP12_IDADDR: uDiagRegAddress=4294443396, uDiagRegValueLnk=DMAData_G_str.SlowSPI_Cnt_u16[0], uDiagRegUseSizeofInOffset=false, uDiagRegValueLnkOffset=0
        DMA_DMAMPR2S: uDiagRegAddress=4294963656, uDiagRegValueLnk=DMAData_G_str, uDiagRegUseSizeofInOffset=false, uDiagRegValueLnkOffset=0
        DMA_DMAMPR2E: uDiagRegAddress=4294963660, uDiagRegValueLnk=DMAData_G_str, uDiagRegUseSizeofInOffset=true, uDiagRegValueLnkOffset=-1
        HTU__MP0S_HTU1: uDiagRegAddress=4294419572, uDiagRegValueLnk=Nhet_HtuDataTrq_Cnt_G_str, uDiagRegUseSizeofInOffset=false, uDiagRegValueLnkOffset=0
        HTU__MP0E_HTU1: uDiagRegAddress=4294419576, uDiagRegValueLnk=Nhet_HtuDataTrq_Cnt_G_str, uDiagRegUseSizeofInOffset=false, uDiagRegValueLnkOffset=60
        HTU_IFADDRA_HTU1: uDiagRegAddress=4283301904, uDiagRegValueLnk=Nhet_HtuDataTrq_Cnt_G_str.HtuDataTrq1_Cnt_u32[0], uDiagRegUseSizeofInOffset=false, uDiagRegValueLnkOffset=0
        HTU_IFADDRB_HTU1: uDiagRegAddress=4283301920, uDiagRegValueLnk=Nhet_HtuDataTrq_Cnt_G_str.HtuDataTrq2_Cnt_u32[0], uDiagRegUseSizeofInOffset=false, uDiagRegValueLnkOffset=0
    CommonPublishedInformation: ArMajorVersion=1, ArMinorVersion=2, ArPatchVersion=0, SwMajorVersion=1, SwMinorVersion=0, SwPatchVersion=0, ModuleId=104, VendorId=0
    uDiagGeneral:
      uDiagVCLK_kHz = 80000
      uDiagEnableFPUDiag = STD_OFF
      uDiagGladiatorCompatible = STD_OFF
      uDiagVIMPerTrusted = STD_OFF
      uDiagECCPerTrusted = STD_OFF
      uDiagVimTableName = osaIRQTable
      WdgMVersion = TTTech_v2.0.3
      uDiagIncludes = Nhet.h
      uDiagIncludes = Usr_RegCkDefs.h
      uDiagIncludes = Dma.h
  module config VehSpdLmt: implementation-config-variant=VARIANT-PRE-COMPILE  # Configuration of the Nexteer VehSpdLmt module.
    VehSpdLmtGeneral
    CommonPublishedInformation: ArMajorVersion=3, ArMinorVersion=2, ArPatchVersion=0, SwMajorVersion=0, SwMinorVersion=0, SwPatchVersion=0, ModuleId=0, VendorId=0
  module config Wdg_internal_TMS570LS3x: definition=Wdg, implementation-config-variant=VARIANT-PRE-COMPILE, module-description=Wdg_Impl  # Configuration of the Wdg (Watchdog driver) module. This is the TMS570LS3x internal watchdog driver.
    WdgGeneral:
      WdgDevErrorDetect = false
      WdgDemReport = false
      WdgDisableAllowed = false
      WdgVersionInfoApi = false
      WdgInternalTickCounter = true
      WdgUseOsSuspendInterrupt = true
      WdgInitialTimeout = 0.006
      WdgGlobalMemoryAppTaskRef = Ap_0
    WdgModeConfig (WdgSettingsConfig): WdgDefaultMode=WDGIF_SLOW_MODE
      WdgWindowStart: Value=0
      WdgRtiKhz: Value=80000
  module config WdgIf: implementation-config-variant=VARIANT-PRE-COMPILE, module-description=WdgIf_Impl  # Configuration of the WdgIf (Watchdog Interface) module.
    Wdg_internal_TMS570LS3x (WdgIfDevice): WdgIfDeviceIndex=0, WdgIfDriverRef=WdgGeneral
    WdgIfGeneral: WdgIfDevErrorDetect=false, WdgIfDemReport=false, WdgIfVersionInfoApi=false, WdgIfInternalTickCounterRef=Wdg_internal_TMS570LS3x
  module config WdgM: implementation-config-variant=VARIANT-PRE-COMPILE, module-description=WdgM_Impl  # Configuration of the WdgM (Watchdog Manager) module.
    WdgM_Runtime (WdgMConfigSet): WdgMInitialMode=WdgMMode
      WdgMMode: WdgMExpiredSupervisionCycleTol=0, WdgMModeId=0, WdgMTicksPerSecond=1000000, WdgMSupervisionCycle=0.004, WdgMInitialTriggerModeId=0
        SE_2ms_Alive0 (WdgMAliveSupervision):
          WdgMExpectedAliveIndications = 2
          WdgMMaxMargin = 0
          WdgMMinMargin = 0
          WdgMSupervisionReferenceCycle = 1
          WdgMAliveSupervisionCheckpointRef = ChkPtAp9_2msStart_CP
        WdgMProgramFlowSupervision: WdgMGlobalCheckpointInitialRef=ChkPtAp9_2msStart_CP
          11 x WdgMGlobalTransition:
            GT_2ms_9_10: WdgMGlobalTransitionDestRef=ChkPtAp10_2msStart_CP, WdgMGlobalTransitionSourceRef=ChkPtAp9_2msEnd_CP
            GT_2ms_10_11: WdgMGlobalTransitionDestRef=ChkPtAp11_2msStart_CP, WdgMGlobalTransitionSourceRef=ChkPtAp10_2msEnd_CP
            GT_2ms_11_6: WdgMGlobalTransitionDestRef=ChkPtAp6_2msStart_CP, WdgMGlobalTransitionSourceRef=ChkPtAp11_2msEnd_CP
            GT_4ms_9_10: WdgMGlobalTransitionDestRef=ChkPtAp10_4msStart_CP, WdgMGlobalTransitionSourceRef=ChkPtAp9_4msEnd_CP
            GT_10ms_9_10a: WdgMGlobalTransitionDestRef=ChkPtAp10_10msaStart_CP, WdgMGlobalTransitionSourceRef=ChkPtAp9_10msEnd_CP
            GT_10ms_10a_6: WdgMGlobalTransitionDestRef=ChkPtAp6_10msStart_CP, WdgMGlobalTransitionSourceRef=ChkPtAp10_10msaEnd_CP
            GT_10ms_6_10b: WdgMGlobalTransitionDestRef=ChkPtAp10_10msbStart_CP, WdgMGlobalTransitionSourceRef=ChkPtAp6_10msEnd_CP
            GT_10ms_10b_11: WdgMGlobalTransitionDestRef=ChkPtAp11_10msStart_CP, WdgMGlobalTransitionSourceRef=ChkPtAp10_10msbEnd_CP
            GT_100ms_9_10: WdgMGlobalTransitionDestRef=ChkPtAp10_100msStart_CP, WdgMGlobalTransitionSourceRef=ChkPtAp9_100msEnd_CP
            GT_100ms_10_11: WdgMGlobalTransitionDestRef=ChkPtAp11_100msStart_CP, WdgMGlobalTransitionSourceRef=ChkPtAp10_100msEnd_CP
            GT_100ms_11_6: WdgMGlobalTransitionDestRef=ChkPtAp6_100msStart_CP, WdgMGlobalTransitionSourceRef=ChkPtAp11_100msEnd_CP
        WdgMTrigger: WdgMWatchdogMode=WDGIF_SLOW_MODE, WdgMTriggerConditionValue=6, WdgMTriggerWindowStart=2, WdgMTriggerModeId=0, WdgMTriggerWatchdogRef=WdgMWatchdog
        SE_2ms_9_Status (WdgMLocalStatusParams):
          WdgMFailedSupervisionRefCycleTol = 0
          WdgMSupervisedEntityInitialMode = WDGM_LOCAL_STATUS_OK
          WdgMFailedDeadlineRefCycleTol = 0
          WdgMDeadlineReferenceCycle = 0
          WdgMFailedProgramFlowRefCycleTol = 0
          WdgMProgramFlowReferenceCycle = 0
          WdgMLocalStatusSupervisedEntityRef = SE_2ms_9
        7 x WdgMAliveSupervision, all with WdgMMaxMargin=0, WdgMMinMargin=0:
          SE_2ms_Alive1: WdgMExpectedAliveIndications=2, WdgMSupervisionReferenceCycle=1, WdgMAliveSupervisionCheckpointRef=ChkPtAp6_2msEnd_CP
          SE_4ms_Alive0: WdgMExpectedAliveIndications=1, WdgMSupervisionReferenceCycle=1, WdgMAliveSupervisionCheckpointRef=ChkPtAp9_4msStart_CP
          SE_4ms_Alive1: WdgMExpectedAliveIndications=1, WdgMSupervisionReferenceCycle=1, WdgMAliveSupervisionCheckpointRef=ChkPtAp10_4msEnd_CP
          SE_10ms_Alive0: WdgMExpectedAliveIndications=2, WdgMSupervisionReferenceCycle=5, WdgMAliveSupervisionCheckpointRef=ChkPtAp9_10msStart_CP
          SE_10ms_Alive1: WdgMExpectedAliveIndications=2, WdgMSupervisionReferenceCycle=5, WdgMAliveSupervisionCheckpointRef=ChkPtAp11_10msEnd_CP
          SE_100ms_Alive0: WdgMExpectedAliveIndications=1, WdgMSupervisionReferenceCycle=25, WdgMAliveSupervisionCheckpointRef=ChkPtAp9_100msStart_CP
          SE_100ms_Alive1: WdgMExpectedAliveIndications=1, WdgMSupervisionReferenceCycle=25, WdgMAliveSupervisionCheckpointRef=ChkPtAp6_100msEnd_CP
        14 x WdgMLocalStatusParams, all with WdgMFailedSupervisionRefCycleTol=0, WdgMSupervisedEntityInitialMode=WDGM_LOCAL_STATUS_OK, WdgMFailedDeadlineRefCycleTol=0, WdgMDeadlineReferenceCycle=0, WdgMFailedProgramFlowRefCycleTol=0, WdgMProgramFlowReferenceCycle=0:
          SE_2ms_10_Status: WdgMLocalStatusSupervisedEntityRef=SE_2ms_10
          SE_2ms_11_Status: WdgMLocalStatusSupervisedEntityRef=SE_2ms_11
          SE_2ms_6_Status: WdgMLocalStatusSupervisedEntityRef=SE_2ms_6
          SE_4ms_9_Status: WdgMLocalStatusSupervisedEntityRef=SE_4ms_9
          SE_4ms_10_Status: WdgMLocalStatusSupervisedEntityRef=SE_4ms_10
          SE_10ms_9_Status: WdgMLocalStatusSupervisedEntityRef=SE_10ms_9
          SE_10ms_10a_Status: WdgMLocalStatusSupervisedEntityRef=SE_10ms_10a
          SE_10ms_6_Status: WdgMLocalStatusSupervisedEntityRef=SE_10ms_6
          SE_10ms_10b_Status: WdgMLocalStatusSupervisedEntityRef=SE_10ms_10b
          SE_10ms_11_Status: WdgMLocalStatusSupervisedEntityRef=SE_10ms_11
          SE_100ms_{9..11}_Status: WdgMLocalStatusSupervisedEntityRef=SE_100ms_{9..11}
          SE_100ms_6_Status: WdgMLocalStatusSupervisedEntityRef=SE_100ms_6
    WdgMGeneral:
      WdgMDevErrorDetect = false
      WdgMDemReport = false
      WdgMImmediateReset = true
      WdgMOffModeEnabled = false
      WdgMVersionInfoApi = false
      WdgMDefensiveBehavior = true
      WdgMUseRte = true
      WdgMDemSupervisionReport = false
      WdgMFirstCycleAliveCounterReset = true
      WdgMUseOsSuspendInterrupt = true
      WdgMTimebaseSource = WDGM_INTERNAL_HARDWARE_TICK
      WdgMSecondResetPath = false
      WdgMTickOverrunCorrection = true
      WdgMEntityDeactivationEnabled = false
      WdgMStateChangeNotification = false
      WdgMGlobalMemoryAppTaskRef = Ap_0
      SE_2ms_9 (WdgMSupervisedEntity):
        WdgMSupervisedEntityId = 0
        WdgMEnableEntityDeactivation = false
        WdgMSupportedAutosarAPI = API_4_0
        WdgMLocalCheckpointFinalRef = ChkPtAp9_2msEnd_CP
        WdgMLocalCheckpointInitialRef = ChkPtAp9_2msStart_CP
        WdgMAppTaskRef = Ap_9
        ChkPtAp9_2msStart_CP (WdgMCheckpoint): WdgMCheckpointId=0
        LT_2ms_9 (WdgMLocalTransition): WdgMLocalTransitionDestRef=ChkPtAp9_2msEnd_CP, WdgMLocalTransitionSourceRef=ChkPtAp9_2msStart_CP
        ChkPtAp9_2msEnd_CP (WdgMCheckpoint): WdgMCheckpointId=1
      WdgMWatchdog: WdgMWatchdogName=Watchdog, WdgIfDeviceRef=Wdg_internal_TMS570LS3x
      WdgMCallerIds: WdgMCallerId=0
      14 x WdgMSupervisedEntity, all with WdgMEnableEntityDeactivation=false, WdgMSupportedAutosarAPI=API_4_0:
        SE_2ms_10: WdgMSupervisedEntityId=1, WdgMLocalCheckpointFinalRef=ChkPtAp10_2msEnd_CP, WdgMLocalCheckpointInitialRef=ChkPtAp10_2msStart_CP, WdgMAppTaskRef=Ap_10
          ChkPtAp10_2msStart_CP (WdgMCheckpoint): WdgMCheckpointId=0
          LT_2ms_10 (WdgMLocalTransition): WdgMLocalTransitionDestRef=ChkPtAp10_2msEnd_CP, WdgMLocalTransitionSourceRef=ChkPtAp10_2msStart_CP
          ChkPtAp10_2msEnd_CP (WdgMCheckpoint): WdgMCheckpointId=1
        SE_2ms_11: WdgMSupervisedEntityId=2, WdgMLocalCheckpointFinalRef=ChkPtAp11_2msEnd_CP, WdgMLocalCheckpointInitialRef=ChkPtAp11_2msStart_CP, WdgMAppTaskRef=Ap_11
          ChkPtAp11_2msStart_CP (WdgMCheckpoint): WdgMCheckpointId=0
          LT_2ms_11 (WdgMLocalTransition): WdgMLocalTransitionDestRef=ChkPtAp11_2msEnd_CP, WdgMLocalTransitionSourceRef=ChkPtAp11_2msStart_CP
          ChkPtAp11_2msEnd_CP (WdgMCheckpoint): WdgMCheckpointId=1
        SE_2ms_6: WdgMSupervisedEntityId=3, WdgMLocalCheckpointFinalRef=ChkPtAp6_2msEnd_CP, WdgMLocalCheckpointInitialRef=ChkPtAp6_2msStart_CP, WdgMAppTaskRef=Ap_6
          ChkPtAp6_2msStart_CP (WdgMCheckpoint): WdgMCheckpointId=0
          LT_2ms_6 (WdgMLocalTransition): WdgMLocalTransitionDestRef=ChkPtAp6_2msEnd_CP, WdgMLocalTransitionSourceRef=ChkPtAp6_2msStart_CP
          ChkPtAp6_2msEnd_CP (WdgMCheckpoint): WdgMCheckpointId=1
        SE_4ms_9: WdgMSupervisedEntityId=4, WdgMLocalCheckpointFinalRef=ChkPtAp9_4msEnd_CP, WdgMLocalCheckpointInitialRef=ChkPtAp9_4msStart_CP, WdgMAppTaskRef=Ap_9
          ChkPtAp9_4msStart_CP (WdgMCheckpoint): WdgMCheckpointId=0
          LT_4ms_9 (WdgMLocalTransition): WdgMLocalTransitionDestRef=ChkPtAp9_4msEnd_CP, WdgMLocalTransitionSourceRef=ChkPtAp9_4msStart_CP
          ChkPtAp9_4msEnd_CP (WdgMCheckpoint): WdgMCheckpointId=1
        SE_4ms_10: WdgMSupervisedEntityId=5, WdgMLocalCheckpointFinalRef=ChkPtAp10_4msEnd_CP, WdgMLocalCheckpointInitialRef=ChkPtAp10_4msStart_CP, WdgMAppTaskRef=Ap_10
          ChkPtAp10_4msStart_CP (WdgMCheckpoint): WdgMCheckpointId=0
          LT_4ms_10 (WdgMLocalTransition): WdgMLocalTransitionDestRef=ChkPtAp10_4msEnd_CP, WdgMLocalTransitionSourceRef=ChkPtAp10_4msStart_CP
          ChkPtAp10_4msEnd_CP (WdgMCheckpoint): WdgMCheckpointId=1
        SE_10ms_9: WdgMSupervisedEntityId=6, WdgMLocalCheckpointFinalRef=ChkPtAp9_10msEnd_CP, WdgMLocalCheckpointInitialRef=ChkPtAp9_10msStart_CP, WdgMAppTaskRef=Ap_9
          ChkPtAp9_10msStart_CP (WdgMCheckpoint): WdgMCheckpointId=0
          LT_10ms_9 (WdgMLocalTransition): WdgMLocalTransitionDestRef=ChkPtAp9_10msEnd_CP, WdgMLocalTransitionSourceRef=ChkPtAp9_10msStart_CP
          ChkPtAp9_10msEnd_CP (WdgMCheckpoint): WdgMCheckpointId=1
        SE_10ms_10a: WdgMSupervisedEntityId=7, WdgMLocalCheckpointFinalRef=ChkPtAp10_10msaEnd_CP, WdgMLocalCheckpointInitialRef=ChkPtAp10_10msaStart_CP, WdgMAppTaskRef=Ap_10
          ChkPtAp10_10msaStart_CP (WdgMCheckpoint): WdgMCheckpointId=0
          LT_10ms_10a (WdgMLocalTransition): WdgMLocalTransitionDestRef=ChkPtAp10_10msaEnd_CP, WdgMLocalTransitionSourceRef=ChkPtAp10_10msaStart_CP
          ChkPtAp10_10msaEnd_CP (WdgMCheckpoint): WdgMCheckpointId=1
        SE_10ms_6: WdgMSupervisedEntityId=8, WdgMLocalCheckpointFinalRef=ChkPtAp6_10msEnd_CP, WdgMLocalCheckpointInitialRef=ChkPtAp6_10msStart_CP, WdgMAppTaskRef=Ap_6
          ChkPtAp6_10msStart_CP (WdgMCheckpoint): WdgMCheckpointId=0
          LT_10ms_6 (WdgMLocalTransition): WdgMLocalTransitionDestRef=ChkPtAp6_10msEnd_CP, WdgMLocalTransitionSourceRef=ChkPtAp6_10msStart_CP
          ChkPtAp6_10msEnd_CP (WdgMCheckpoint): WdgMCheckpointId=1
        SE_10ms_10b: WdgMSupervisedEntityId=9, WdgMLocalCheckpointFinalRef=ChkPtAp10_10msbEnd_CP, WdgMLocalCheckpointInitialRef=ChkPtAp10_10msbStart_CP, WdgMAppTaskRef=Ap_10
          ChkPtAp10_10msbStart_CP (WdgMCheckpoint): WdgMCheckpointId=0
          LT_10ms_10b (WdgMLocalTransition): WdgMLocalTransitionDestRef=ChkPtAp10_10msbEnd_CP, WdgMLocalTransitionSourceRef=ChkPtAp10_10msbStart_CP
          ChkPtAp10_10msbEnd_CP (WdgMCheckpoint): WdgMCheckpointId=1
        SE_10ms_11: WdgMSupervisedEntityId=10, WdgMLocalCheckpointFinalRef=ChkPtAp11_10msEnd_CP, WdgMLocalCheckpointInitialRef=ChkPtAp11_10msStart_CP, WdgMAppTaskRef=Ap_11
          ChkPtAp11_10msStart_CP (WdgMCheckpoint): WdgMCheckpointId=0
          LT_10ms_11 (WdgMLocalTransition): WdgMLocalTransitionDestRef=ChkPtAp11_10msEnd_CP, WdgMLocalTransitionSourceRef=ChkPtAp11_10msStart_CP
          ChkPtAp11_10msEnd_CP (WdgMCheckpoint): WdgMCheckpointId=1
        SE_100ms_9: WdgMSupervisedEntityId=11, WdgMLocalCheckpointFinalRef=ChkPtAp9_100msEnd_CP, WdgMLocalCheckpointInitialRef=ChkPtAp9_100msStart_CP, WdgMAppTaskRef=Ap_9
          ChkPtAp9_100msStart_CP (WdgMCheckpoint): WdgMCheckpointId=0
          LT_100ms_9 (WdgMLocalTransition): WdgMLocalTransitionDestRef=ChkPtAp9_100msEnd_CP, WdgMLocalTransitionSourceRef=ChkPtAp9_100msStart_CP
          ChkPtAp9_100msEnd_CP (WdgMCheckpoint): WdgMCheckpointId=1
        SE_100ms_10: WdgMSupervisedEntityId=12, WdgMLocalCheckpointFinalRef=ChkPtAp10_100msEnd_CP, WdgMLocalCheckpointInitialRef=ChkPtAp10_100msStart_CP, WdgMAppTaskRef=Ap_10
          ChkPtAp10_100msStart_CP (WdgMCheckpoint): WdgMCheckpointId=0
          LT_100ms_10 (WdgMLocalTransition): WdgMLocalTransitionDestRef=ChkPtAp10_100msEnd_CP, WdgMLocalTransitionSourceRef=ChkPtAp10_100msStart_CP
          ChkPtAp10_100msEnd_CP (WdgMCheckpoint): WdgMCheckpointId=1
        SE_100ms_11: WdgMSupervisedEntityId=13, WdgMLocalCheckpointFinalRef=ChkPtAp11_100msEnd_CP, WdgMLocalCheckpointInitialRef=ChkPtAp11_100msStart_CP, WdgMAppTaskRef=Ap_11
          ChkPtAp11_100msStart_CP (WdgMCheckpoint): WdgMCheckpointId=0
          LT_100ms_11 (WdgMLocalTransition): WdgMLocalTransitionDestRef=ChkPtAp11_100msEnd_CP, WdgMLocalTransitionSourceRef=ChkPtAp11_100msStart_CP
          ChkPtAp11_100msEnd_CP (WdgMCheckpoint): WdgMCheckpointId=1
        SE_100ms_6: WdgMSupervisedEntityId=14, WdgMLocalCheckpointFinalRef=ChkPtAp6_100msEnd_CP, WdgMLocalCheckpointInitialRef=ChkPtAp6_100msStart_CP, WdgMAppTaskRef=Ap_6
          ChkPtAp6_100msStart_CP (WdgMCheckpoint): WdgMCheckpointId=0
          LT_100ms_6 (WdgMLocalTransition): WdgMLocalTransitionDestRef=ChkPtAp6_100msEnd_CP, WdgMLocalTransitionSourceRef=ChkPtAp6_100msStart_CP
          ChkPtAp6_100msEnd_CP (WdgMCheckpoint): WdgMCheckpointId=1
  module config EcuM: implementation-config-variant=VARIANT-PRE-COMPILE, module-description=EcuM_Impl  # Configuration of the EcuM (ECU State Manager) module.
    EcuMConfiguration:
      EcuMConfigConsistencyHash = 0
      EcuMNvramReadallTimeout = 0
      EcuMNvramWriteallTimeout = 0
      EcuMRunMinimumDuration = 0.1
      EcuMSleepActivityPeriod = 0
      EcuMComStackTypesIncludeFile = ComStack_Types.h
      EcuMDefaultAppMode = OSDEFAULTAPPMODE
      EcuMModuleConfigurationRef = McuModuleConfiguration
      EcuMModuleConfigurationRef = Gpt_Runtime
      EcuMModuleConfigurationRef = Port_Runtime
      EcuMNormalMcuModeRef = (unset)
      EcuMDefaultShutdownTarget: EcuMDefaultState=EcuMStateOff, EcuMDefaultSleepModeRef=(unset)
      EcuMDriverInitListZero
      EcuMDriverInitListOne
        Code1 (EcuMDriverInitItem): EcuMModuleID=Code, EcuMModuleService=(unset), EcuMAdditionalInitCode=EcuStartup_Init1();
      EcuMDriverInitListTwo
        Code1 (EcuMDriverInitItem): EcuMModuleID=Code, EcuMModuleService=(unset), EcuMAdditionalInitCode=EcuStartup_Init2();
      EcuMDriverInitListThree
        EcuMDriverInitItem: EcuMModuleID=Code, EcuMModuleService=(unset), EcuMAdditionalInitCode=/* Inserted to fix build error */
      EcuMDriverRestartList
        EcuMDriverInitItem: EcuMModuleID=Code, EcuMModuleService=(unset), EcuMAdditionalInitCode=/* Inserted to fix build error */
      InitialEcuMSleepModeEcuMSleepMode (EcuMSleepMode):
        EcuMSleepModeSuspend = false
        EcuMSleepModeId = 0
        EcuMSleepModeName = EcuMSleepMode
        EcuMMcuMode = (unset)
        EcuMWakeupSourceMask = ECUM_WKSOURCE_RESET
        EcuMWakeupSourceMask = ECUM_WKSOURCE_POWER
        EcuMWakeupSourceMask = ECUM_WKSOURCE_INTERNAL_RESET
        EcuMWakeupSourceMask = ECUM_WKSOURCE_INTERNAL_WDG
        EcuMWakeupSourceMask = ECUM_WKSOURCE_EXTERNAL_WDG
        EcuMSleepModeMcuModeRef = McuModeConf
      EcuMTTII: EcuMDivisor=1, EcuMSleepModeRef=(unset), EcuMSuccessorRef=(unset)
      EcuMUsrCfg_EPS (EcuMUserConfig): EcuMUser=1
      ECUM_WKSOURCE_POWER (EcuMWakeupSource): EcuMResetReason=6, EcuMValidationTimeout=0, EcuMWakeupSourceId=1, EcuMWakeupSourcePolling=false
      EcuMWdgM:
        EcuMWdgMPostRunModeRef = Mode_0
        EcuMWdgMRunModeRef = Mode_0
        EcuMWdgMShutdownModeRef = Mode_0
        EcuMWdgMStartupModeRef = (unset)
        EcuMWdgMWakeupModeRef = Mode_0
        EcuMSupervisedEntityRef = (unset)
      8 x EcuMWakeupSource, all with EcuMValidationTimeout=0, EcuMWakeupSourcePolling=false:
        ECUM_WKSOURCE_RESET: EcuMResetReason=-1, EcuMWakeupSourceId=2
        ECUM_WKSOURCE_INTERNAL_RESET: EcuMResetReason=3, EcuMWakeupSourceId=4
        ECUM_WKSOURCE_INTERNAL_WDG: EcuMResetReason=4, EcuMWakeupSourceId=8
        ECUM_WKSOURCE_EXTERNAL_WDG: EcuMResetReason=-1, EcuMWakeupSourceId=16
        ECUM_WKSOURCE_SOFTWARE_RESET: EcuMResetReason=2, EcuMWakeupSourceId=32
        ECUM_WKSOURCE_OSCI_OR_PLLSLIP_RESET: EcuMResetReason=5, EcuMWakeupSourceId=64
        ECUM_WKSOURCE_EXTERNAL_RESET: EcuMResetReason=1, EcuMWakeupSourceId=128
        ECUM_WKSOURCE_RESET_UNDEFINED: EcuMResetReason=7, EcuMWakeupSourceId=256
    EcuMGeneral:
      EcuMMainFunctionPeriod = 0.01
      EcuMIncludeDem = false
      EcuMIncludeDet = true
      EcuMIncludeNvramMgr = true
      EcuMIncludeWdgM = false
      EcuMIncludeComM = false
      EcuMIncludeRte = true
      EcuMIncludeSchM = false
      EcuMTTIIEnabled = false
      EcuMVersionInfoApi = false
      EcuMDevErrorDetect = true
      EcuMCheckParameter = true
      EcuMCheckPointerParameter = true
      EcuMCheckConfigType = true
      EcuMCheckUnInit = true
      EcuMCheckStateParameter = true
      EcuMCheckWkSourceParameter = true
      EcuMCheckBootTargetParameter = true
      EcuMCheckSleepModeParameter = true
      EcuMCheckUserParameter = true
      EcuMEnableProdErrorReporting = false
      EcuMDetErrorhookFunction = Det_ReportError
      EcuMDemSetError = Dem_ReportErrorStatus
      EcuMMcuIncludeFile = Mcu.h
      EcuMWdgMIncludeFile = WdgM.h
      EcuMComMIncludeFile = ComM.h
      EcuMSchMIncludeFile = SchM.h
      EcuMComMCallbackFile = ComM_EcuM.h
      EcuMRteIncludeFile = Rte_Main.h
      EcuMNvmIncludeFile = Nvm.h
      EcuMDetIncludeFile = Det.h
      EcuMDemIncludeFile = Dem.h
      EcuMOsIncludeFile = Os.h
      EcuMProdErrorDetectIncludeFile = Dem.h
      EcuMDevErrorDetectIncludeFile = Det.h
      EcuMAdditionalIncludes = EcuStartup.h
      EcuMNvmTypesFile = Nvm.h
      EcuMNvmCancelWriteAllTimeout = 60
      EcuMTTIISleepModeRef = (unset)
      EcuMIrqHandling = InterruptFunctionSet
      EcuMTTIIWakeupSourceRef = (unset)
      EcuMApiSwitches: EcuMKillAllRUNRequestApi=true, EcuMGetValidatedWakeupEventsApi=true, EcuMGetExpiredWakeupEventsApi=true, EcuMGetStatusOfWakeupSourceApi=true
      EcuMCalloutSwitches:
        EcuMOnRTEStartupCallout = true
        EcuMOnEnterRunCallout = true
        EcuMOnExitRunCallout = true
        EcuMOnExitPostRunCallout = true
        EcuMOnPrepShutdownCallout = true
        EcuMOnGoSleepCallout = true
        EcuMOnGoOffOneCallout = true
        EcuMOnGoOffTwoCallout = true
        EcuMOnWakeupReactionCallout = true
        EcuMGeneratorCompatibilityError = false
      EcuMServicePortConfig:
        EcuMGenStateRequestPort = true
        EcuMGenBootTargetPort = false
        EcuMGenApplicationModePort = false
        EcuMGenShutdownTargetPort = false
        EcuMGenModeSwitchPort = false
        EcuMModeSwitchCbkName = (unset)
        EcuMModeSwitchRteAck = true
        EcuMServiceComponentName = EcuM
    VectorCommonData: BswmdVersion=4.08.00
  module config Dem: implementation-config-variant=VARIANT-LINK-TIME, module-description=Dem_Impl  # Configuration of the Dem (Diagnostic Event Manager) module.
    DemConfigSet: DemActiveDsdServiceTableRef=
      DtcClass0 (DemDTCClass): DemDTC=0, DemDTCKind=DEM_DTC_KIND_ALL_DTCS, DemDTCSeverity=DEM_DTC_SEV_NO_SEVERITY, DemDTCFunctionalUnit=0, DemDTCSupportWarningIndicator=false
      NVM_E_REQ_FAILED (DemEventParameter):
        DemEventID = 65
        DemInitMonitorName = (unset)
        DemEventKind = DEM_EVENT_KIND_BSW
        DemImportedEvent = false
        DemExtendedDataRef = (unset)
        DemDTCClassRef = DtcClass17
        DemEventClass:
          DemEventPriority = 0
          DemFFPrestorageSupported = false
          DemHealingAllowed = false
          DemHealingCycleCounter = 1
          DemHealingCycleRef = (unset)
          DemOperationCycleRef = DEM_IGNITION
          DemPredebounceAlgorithmClass
            DemPreDebounceCounterBased: DemCountInStepSize=1, DemCountOutStepSize=1, DemJumpDown=false, DemJumpUp=true, DemPreDebounceName=DEM_PRE_DEBOUNCE_COUNTER_BASED
      4 x DemGroupOfDTC:
        DEM_DTC_GROUP_ALL_DTCS: DemGroupDTCs=(unset)
        DEM_DTC_GROUP_CHASSIS_DTCS: DemGroupDTCs=4194304
        DEM_DTC_GROUP_BODY_DTCS: DemGroupDTCs=8388608
        DEM_DTC_GROUP_NETWORK_COM_DTCS: DemGroupDTCs=12582912
      75 x DemDTCClass, all with DemDTCKind=DEM_DTC_KIND_ALL_DTCS, DemDTCSeverity=DEM_DTC_SEV_NO_SEVERITY:
        DtcClass{1..28}: DemDTC=0, DemDTCFunctionalUnit=0, DemDTCSupportWarningIndicator=false
        DtcClass29: DemDTC=5651087, DemDTCFunctionalUnit=255, DemDTCSupportWarningIndicator=false, DemTriggerOnDTCStatusTargetRef=CBDTCStatusChange_FaultLog, DemTriggerOnDTCStatusTargetRef=CBDTCStatusChange_DemIf
        DtcClass30: DemDTC=5506712, DemDTCFunctionalUnit=255, DemDTCSupportWarningIndicator=true, DemTriggerOnDTCStatusTargetRef=CBDTCStatusChange_FaultLog, DemTriggerOnDTCStatusTargetRef=CBDTCStatusChange_DemIf
        DtcClass31: DemDTC=5507862, DemDTCFunctionalUnit=255, DemDTCSupportWarningIndicator=false, DemTriggerOnDTCStatusTargetRef=CBDTCStatusChange_FaultLog, DemTriggerOnDTCStatusTargetRef=CBDTCStatusChange_DemIf
        DtcClass32: DemDTC=5376257, DemDTCFunctionalUnit=255, DemDTCSupportWarningIndicator=false, DemTriggerOnDTCStatusTargetRef=CBDTCStatusChange_FaultLog, DemTriggerOnDTCStatusTargetRef=CBDTCStatusChange_DemIf
        DtcClass33: DemDTC=13632392, DemDTCFunctionalUnit=255, DemDTCSupportWarningIndicator=false, DemTriggerOnDTCStatusTargetRef=CBDTCStatusChange_FaultLog, DemTriggerOnDTCStatusTargetRef=CBDTCStatusChange_DemIf
        DtcClass34: DemDTC=13834240, DemDTCFunctionalUnit=255, DemDTCSupportWarningIndicator=false, DemTriggerOnDTCStatusTargetRef=CBDTCStatusChange_FaultLog, DemTriggerOnDTCStatusTargetRef=CBDTCStatusChange_DemIf
        DtcClass35: DemDTC=13703303, DemDTCFunctionalUnit=255, DemDTCSupportWarningIndicator=false, DemTriggerOnDTCStatusTargetRef=CBDTCStatusChange_FaultLog, DemTriggerOnDTCStatusTargetRef=CBDTCStatusChange_DemIf
        DtcClass36: DemDTC=13767553, DemDTCFunctionalUnit=255, DemDTCSupportWarningIndicator=false, DemTriggerOnDTCStatusTargetRef=CBDTCStatusChange_FaultLog, DemTriggerOnDTCStatusTargetRef=CBDTCStatusChange_DemIf
        DtcClass37: DemDTC=13830144, DemDTCFunctionalUnit=255, DemDTCSupportWarningIndicator=false, DemTriggerOnDTCStatusTargetRef=CBDTCStatusChange_FaultLog, DemTriggerOnDTCStatusTargetRef=CBDTCStatusChange_DemIf
        DtcClass38: DemDTC=5507072, DemDTCFunctionalUnit=255, DemDTCSupportWarningIndicator=false, DemTriggerOnDTCStatusTargetRef=CBDTCStatusChange_FaultLog, DemTriggerOnDTCStatusTargetRef=CBDTCStatusChange_DemIf
        DtcClass39: DemDTC=13832960, DemDTCFunctionalUnit=255, DemDTCSupportWarningIndicator=false, DemTriggerOnDTCStatusTargetRef=CBDTCStatusChange_FaultLog, DemTriggerOnDTCStatusTargetRef=CBDTCStatusChange_DemIf
        DtcClass40: DemDTC=13833090, DemDTCFunctionalUnit=255, DemDTCSupportWarningIndicator=false, DemTriggerOnDTCStatusTargetRef=CBDTCStatusChange_FaultLog, DemTriggerOnDTCStatusTargetRef=CBDTCStatusChange_DemIf
        DtcClass41: DemDTC=13833091, DemDTCFunctionalUnit=255, DemDTCSupportWarningIndicator=false, DemTriggerOnDTCStatusTargetRef=CBDTCStatusChange_FaultLog, DemTriggerOnDTCStatusTargetRef=CBDTCStatusChange_DemIf
        DtcClass42: DemDTC=13631496, DemDTCFunctionalUnit=255, DemDTCSupportWarningIndicator=false, DemTriggerOnDTCStatusTargetRef=CBDTCStatusChange_FaultLog, DemTriggerOnDTCStatusTargetRef=CBDTCStatusChange_DemIf
        DtcClass43: DemDTC=13699207, DemDTCFunctionalUnit=255, DemDTCSupportWarningIndicator=false, DemTriggerOnDTCStatusTargetRef=CBDTCStatusChange_FaultLog, DemTriggerOnDTCStatusTargetRef=CBDTCStatusChange_DemIf
        DtcClass44: DemDTC=13702023, DemDTCFunctionalUnit=255, DemDTCSupportWarningIndicator=false, DemTriggerOnDTCStatusTargetRef=CBDTCStatusChange_FaultLog, DemTriggerOnDTCStatusTargetRef=CBDTCStatusChange_DemIf
        DtcClass45: DemDTC=13764737, DemDTCFunctionalUnit=255, DemDTCSupportWarningIndicator=false, DemTriggerOnDTCStatusTargetRef=CBDTCStatusChange_FaultLog, DemTriggerOnDTCStatusTargetRef=CBDTCStatusChange_DemIf
        DtcClass46: DemDTC=13698439, DemDTCFunctionalUnit=255, DemDTCSupportWarningIndicator=false, DemTriggerOnDTCStatusTargetRef=CBDTCStatusChange_FaultLog, DemTriggerOnDTCStatusTargetRef=CBDTCStatusChange_DemIf
        DtcClass47: DemDTC=13763969, DemDTCFunctionalUnit=255, DemDTCSupportWarningIndicator=false, DemTriggerOnDTCStatusTargetRef=CBDTCStatusChange_FaultLog, DemTriggerOnDTCStatusTargetRef=CBDTCStatusChange_DemIf
        DtcClass48: DemDTC=13829376, DemDTCFunctionalUnit=255, DemDTCSupportWarningIndicator=false, DemTriggerOnDTCStatusTargetRef=CBDTCStatusChange_FaultLog, DemTriggerOnDTCStatusTargetRef=CBDTCStatusChange_DemIf
        DtcClass49: DemDTC=13829506, DemDTCFunctionalUnit=255, DemDTCSupportWarningIndicator=false, DemTriggerOnDTCStatusTargetRef=CBDTCStatusChange_FaultLog, DemTriggerOnDTCStatusTargetRef=CBDTCStatusChange_DemIf
        DtcClass50: DemDTC=13829507, DemDTCFunctionalUnit=255, DemDTCSupportWarningIndicator=false, DemTriggerOnDTCStatusTargetRef=CBDTCStatusChange_FaultLog, DemTriggerOnDTCStatusTargetRef=CBDTCStatusChange_DemIf
        DtcClass51: DemDTC=13768833, DemDTCFunctionalUnit=255, DemDTCSupportWarningIndicator=false, DemTriggerOnDTCStatusTargetRef=CBDTCStatusChange_FaultLog, DemTriggerOnDTCStatusTargetRef=CBDTCStatusChange_DemIf
        DtcClass52: DemDTC=13704583, DemDTCFunctionalUnit=255, DemDTCSupportWarningIndicator=false, DemTriggerOnDTCStatusTargetRef=CBDTCStatusChange_FaultLog, DemTriggerOnDTCStatusTargetRef=CBDTCStatusChange_DemIf
        DtcClass53: DemDTC=13770113, DemDTCFunctionalUnit=255, DemDTCSupportWarningIndicator=false, DemTriggerOnDTCStatusTargetRef=CBDTCStatusChange_FaultLog, DemTriggerOnDTCStatusTargetRef=CBDTCStatusChange_DemIf
        DtcClass54: DemDTC=13835520, DemDTCFunctionalUnit=255, DemDTCSupportWarningIndicator=false, DemTriggerOnDTCStatusTargetRef=CBDTCStatusChange_FaultLog, DemTriggerOnDTCStatusTargetRef=CBDTCStatusChange_DemIf
        DtcClass55: DemDTC=13835650, DemDTCFunctionalUnit=255, DemDTCSupportWarningIndicator=false, DemTriggerOnDTCStatusTargetRef=CBDTCStatusChange_FaultLog, DemTriggerOnDTCStatusTargetRef=CBDTCStatusChange_DemIf
        DtcClass56: DemDTC=13835651, DemDTCFunctionalUnit=255, DemDTCSupportWarningIndicator=false, DemTriggerOnDTCStatusTargetRef=CBDTCStatusChange_FaultLog, DemTriggerOnDTCStatusTargetRef=CBDTCStatusChange_DemIf
        DtcClass57: DemDTC=328082, DemDTCFunctionalUnit=255, DemDTCSupportWarningIndicator=false, DemTriggerOnDTCStatusTargetRef=CBDTCStatusChange_FaultLog, DemTriggerOnDTCStatusTargetRef=CBDTCStatusChange_DemIf
        DtcClass58: DemDTC=5506945, DemDTCFunctionalUnit=255, DemDTCSupportWarningIndicator=false, DemTriggerOnDTCStatusTargetRef=CBDTCStatusChange_FaultLog, DemTriggerOnDTCStatusTargetRef=CBDTCStatusChange_DemIf
        DtcClass59: DemDTC=5507207, DemDTCFunctionalUnit=255, DemDTCSupportWarningIndicator=false, DemTriggerOnDTCStatusTargetRef=CBDTCStatusChange_FaultLog, DemTriggerOnDTCStatusTargetRef=CBDTCStatusChange_DemIf
        DtcClass60: DemDTC=5311057, DemDTCFunctionalUnit=255, DemDTCSupportWarningIndicator=true, DemTriggerOnDTCStatusTargetRef=CBDTCStatusChange_FaultLog, DemTriggerOnDTCStatusTargetRef=CBDTCStatusChange_DemIf
        DtcClass61: DemDTC=5311393, DemDTCFunctionalUnit=255, DemDTCSupportWarningIndicator=false, DemTriggerOnDTCStatusTargetRef=CBDTCStatusChange_FaultLog, DemTriggerOnDTCStatusTargetRef=CBDTCStatusChange_DemIf
        DtcClass62: DemDTC=5311394, DemDTCFunctionalUnit=255, DemDTCSupportWarningIndicator=true, DemTriggerOnDTCStatusTargetRef=CBDTCStatusChange_FaultLog, DemTriggerOnDTCStatusTargetRef=CBDTCStatusChange_DemIf
        DtcClass63: DemDTC=5311395, DemDTCFunctionalUnit=255, DemDTCSupportWarningIndicator=true, DemTriggerOnDTCStatusTargetRef=CBDTCStatusChange_FaultLog, DemTriggerOnDTCStatusTargetRef=CBDTCStatusChange_DemIf
        DtcClass64: DemDTC=5311489, DemDTCFunctionalUnit=255, DemDTCSupportWarningIndicator=true, DemTriggerOnDTCStatusTargetRef=CBDTCStatusChange_FaultLog, DemTriggerOnDTCStatusTargetRef=CBDTCStatusChange_DemIf
        DtcClass65: DemDTC=5311492, DemDTCFunctionalUnit=255, DemDTCSupportWarningIndicator=true, DemTriggerOnDTCStatusTargetRef=CBDTCStatusChange_FaultLog, DemTriggerOnDTCStatusTargetRef=CBDTCStatusChange_DemIf
        DtcClass66: DemDTC=5311516, DemDTCFunctionalUnit=255, DemDTCSupportWarningIndicator=true, DemTriggerOnDTCStatusTargetRef=CBDTCStatusChange_FaultLog, DemTriggerOnDTCStatusTargetRef=CBDTCStatusChange_DemIf
        DtcClass67: DemDTC=5311555, DemDTCFunctionalUnit=255, DemDTCSupportWarningIndicator=true, DemTriggerOnDTCStatusTargetRef=CBDTCStatusChange_FaultLog, DemTriggerOnDTCStatusTargetRef=CBDTCStatusChange_DemIf
        DtcClass68: DemDTC=5311586, DemDTCFunctionalUnit=255, DemDTCSupportWarningIndicator=true, DemTriggerOnDTCStatusTargetRef=CBDTCStatusChange_FaultLog, DemTriggerOnDTCStatusTargetRef=CBDTCStatusChange_DemIf
        DtcClass69: DemDTC=5311638, DemDTCFunctionalUnit=255, DemDTCSupportWarningIndicator=true, DemTriggerOnDTCStatusTargetRef=CBDTCStatusChange_FaultLog, DemTriggerOnDTCStatusTargetRef=CBDTCStatusChange_DemIf
        DtcClass70: DemDTC=5311640, DemDTCFunctionalUnit=255, DemDTCSupportWarningIndicator=true, DemTriggerOnDTCStatusTargetRef=CBDTCStatusChange_FaultLog, DemTriggerOnDTCStatusTargetRef=CBDTCStatusChange_DemIf
        DtcClass71: DemDTC=5478485, DemDTCFunctionalUnit=255, DemDTCSupportWarningIndicator=true, DemTriggerOnDTCStatusTargetRef=CBDTCStatusChange_FaultLog, DemTriggerOnDTCStatusTargetRef=CBDTCStatusChange_DemIf
        DtcClass72: DemDTC=5508096, DemDTCFunctionalUnit=255, DemDTCSupportWarningIndicator=false, DemTriggerOnDTCStatusTargetRef=CBDTCStatusChange_FaultLog, DemTriggerOnDTCStatusTargetRef=CBDTCStatusChange_DemIf
        DtcClass73: DemDTC=5596815, DemDTCFunctionalUnit=255, DemDTCSupportWarningIndicator=false, DemTriggerOnDTCStatusTargetRef=CBDTCStatusChange_FaultLog, DemTriggerOnDTCStatusTargetRef=CBDTCStatusChange_DemIf
        DtcClass74: DemDTC=5508352, DemDTCFunctionalUnit=255, DemDTCSupportWarningIndicator=false, DemTriggerOnDTCStatusTargetRef=CBDTCStatusChange_FaultLog, DemTriggerOnDTCStatusTargetRef=CBDTCStatusChange_DemIf
        DtcClass75: DemDTC=5653508, DemDTCFunctionalUnit=255, DemDTCSupportWarningIndicator=false, DemTriggerOnDTCStatusTargetRef=CBDTCStatusChange_FaultLog, DemTriggerOnDTCStatusTargetRef=CBDTCStatusChange_DemIf
      59 x DemEventParameter, all with DemInitMonitorName=(unset), DemExtendedDataRef=(unset):
        NVM_E_INTEGRITY_FAILED: DemEventID=66, DemEventKind=DEM_EVENT_KIND_BSW, DemImportedEvent=false, DemDTCClassRef=DtcClass18
          DemEventClass:
            DemEventPriority = 0
            DemFFPrestorageSupported = false
            DemHealingAllowed = false
            DemHealingCycleCounter = 1
            DemHealingCycleRef = (unset)
            DemOperationCycleRef = DEM_IGNITION
            DemPredebounceAlgorithmClass
              DemPreDebounceCounterBased: DemCountInStepSize=1, DemCountOutStepSize=1, DemJumpDown=false, DemJumpUp=true, DemPreDebounceName=DEM_PRE_DEBOUNCE_COUNTER_BASED
        WDGM_E_SET_MODE: DemEventID=75, DemEventKind=DEM_EVENT_KIND_BSW, DemImportedEvent=false, DemDTCClassRef=DtcClass27
          DemEventClass:
            DemEventPriority = 0
            DemFFPrestorageSupported = false
            DemHealingAllowed = false
            DemHealingCycleCounter = 1
            DemHealingCycleRef = (unset)
            DemOperationCycleRef = DEM_IGNITION
            DemPredebounceAlgorithmClass
              DemPreDebounceCounterBased: DemCountInStepSize=1, DemCountOutStepSize=1, DemJumpDown=false, DemJumpUp=true, DemPreDebounceName=DEM_PRE_DEBOUNCE_COUNTER_BASED
        WDGM_E_ALIVE_SUPERVISION: DemEventID=76, DemEventKind=DEM_EVENT_KIND_BSW, DemImportedEvent=false, DemDTCClassRef=DtcClass28
          DemEventClass:
            DemEventPriority = 0
            DemFFPrestorageSupported = false
            DemHealingAllowed = false
            DemHealingCycleCounter = 1
            DemHealingCycleRef = (unset)
            DemOperationCycleRef = DEM_IGNITION
            DemPredebounceAlgorithmClass
              DemPreDebounceCounterBased: DemCountInStepSize=1, DemCountOutStepSize=1, DemJumpDown=false, DemJumpUp=true, DemPreDebounceName=DEM_PRE_DEBOUNCE_COUNTER_BASED
        CTC_0x563A8F: DemEventID=25, DemEventKind=DEM_EVENT_KIND_SWC, DemImportedEvent=true, DemDTCClassRef=DtcClass29, DemFreezeFrameClassRef=Snapshot_22
          DemEventClass:
            DemEventPriority = 0
            DemFFPrestorageSupported = false
            DemHealingAllowed = true
            DemEventDestination = DEM_DTC_ORIGIN_PRIMARY_MEMORY
            DemHealingCycleCounter = 40
            DemHealingCycleRef = DEM_IGNITION
            DemOperationCycleRef = DEM_IGNITION
            DemPredebounceAlgorithmClass
              DemPreDebounceCounterBased: DemCountInStepSize=0, DemCountOutStepSize=0, DemJumpDown=false, DemJumpUp=true, DemPreDebounceName=DEM_PRE_DEBOUNCE_COUNTER_BASED
        CTC_0x540698: DemEventID=33, DemEventKind=DEM_EVENT_KIND_SWC, DemImportedEvent=true, DemDTCClassRef=DtcClass30, DemFreezeFrameClassRef=Snapshot_14
          DemEventClass:
            DemEventPriority = 0
            DemFFPrestorageSupported = false
            DemHealingAllowed = true
            DemEventDestination = DEM_DTC_ORIGIN_PRIMARY_MEMORY
            DemHealingCycleCounter = 40
            DemHealingCycleRef = DEM_IGNITION
            DemOperationCycleRef = DEM_IGNITION
            DemIndicator0 (DemIndicatorAttribute): DemIndicatorBehaviour=1, DemLinkedIndicator=ETATDA2
            DemPredebounceAlgorithmClass
              DemPreDebounceCounterBased: DemCountInStepSize=0, DemCountOutStepSize=0, DemJumpDown=false, DemJumpUp=true, DemPreDebounceName=DEM_PRE_DEBOUNCE_COUNTER_BASED
        CTC_0x540B16: DemEventID=29, DemEventKind=DEM_EVENT_KIND_SWC, DemImportedEvent=true, DemDTCClassRef=DtcClass31, DemFreezeFrameClassRef=Snapshot_18
          DemEventClass:
            DemEventPriority = 0
            DemFFPrestorageSupported = false
            DemHealingAllowed = true
            DemEventDestination = DEM_DTC_ORIGIN_PRIMARY_MEMORY
            DemHealingCycleCounter = 40
            DemHealingCycleRef = DEM_IGNITION
            DemOperationCycleRef = DEM_IGNITION
            DemPredebounceAlgorithmClass
              DemPreDebounceCounterBased: DemCountInStepSize=0, DemCountOutStepSize=0, DemJumpDown=false, DemJumpUp=true, DemPreDebounceName=DEM_PRE_DEBOUNCE_COUNTER_BASED
        CTC_0x520901: DemEventID=35, DemEventKind=DEM_EVENT_KIND_SWC, DemImportedEvent=true, DemDTCClassRef=DtcClass32, DemFreezeFrameClassRef=Snapshot_12
          DemEventClass:
            DemEventPriority = 0
            DemFFPrestorageSupported = false
            DemHealingAllowed = true
            DemEventDestination = DEM_DTC_ORIGIN_PRIMARY_MEMORY
            DemHealingCycleCounter = 40
            DemHealingCycleRef = DEM_IGNITION
            DemOperationCycleRef = DEM_IGNITION
            DemPredebounceAlgorithmClass
              DemPreDebounceCounterBased: DemCountInStepSize=0, DemCountOutStepSize=0, DemJumpDown=false, DemJumpUp=true, DemPreDebounceName=DEM_PRE_DEBOUNCE_COUNTER_BASED
        CTC_0xD00388: DemEventID=22, DemEventKind=DEM_EVENT_KIND_SWC, DemImportedEvent=true, DemDTCClassRef=DtcClass33, DemFreezeFrameClassRef=Snapshot_25
          DemEventClass:
            DemEventPriority = 0
            DemFFPrestorageSupported = false
            DemHealingAllowed = true
            DemEventDestination = DEM_DTC_ORIGIN_PRIMARY_MEMORY
            DemHealingCycleCounter = 40
            DemHealingCycleRef = DEM_IGNITION
            DemOperationCycleRef = DEM_IGNITION
            DemPredebounceAlgorithmClass
              DemPreDebounceCounterBased: DemCountInStepSize=0, DemCountOutStepSize=0, DemJumpDown=false, DemJumpUp=true, DemPreDebounceName=DEM_PRE_DEBOUNCE_COUNTER_BASED
        CTC_0xD31800: DemEventID=4, DemEventKind=DEM_EVENT_KIND_SWC, DemImportedEvent=true, DemDTCClassRef=DtcClass34, DemFreezeFrameClassRef=Snapshot_43
          DemEventClass:
            DemEventPriority = 0
            DemFFPrestorageSupported = false
            DemHealingAllowed = true
            DemEventDestination = DEM_DTC_ORIGIN_PRIMARY_MEMORY
            DemHealingCycleCounter = 40
            DemHealingCycleRef = DEM_IGNITION
            DemOperationCycleRef = DEM_IGNITION
            DemPredebounceAlgorithmClass
              DemPreDebounceCounterBased: DemCountInStepSize=0, DemCountOutStepSize=0, DemJumpDown=false, DemJumpUp=true, DemPreDebounceName=DEM_PRE_DEBOUNCE_COUNTER_BASED
        CTC_0xD11887: DemEventID=18, DemEventKind=DEM_EVENT_KIND_SWC, DemImportedEvent=true, DemDTCClassRef=DtcClass35, DemFreezeFrameClassRef=Snapshot_29
          DemEventClass:
            DemEventPriority = 0
            DemFFPrestorageSupported = false
            DemHealingAllowed = true
            DemEventDestination = DEM_DTC_ORIGIN_PRIMARY_MEMORY
            DemHealingCycleCounter = 40
            DemHealingCycleRef = DEM_IGNITION
            DemOperationCycleRef = DEM_IGNITION
            DemPredebounceAlgorithmClass
              DemPreDebounceCounterBased: DemCountInStepSize=0, DemCountOutStepSize=0, DemJumpDown=false, DemJumpUp=true, DemPreDebounceName=DEM_PRE_DEBOUNCE_COUNTER_BASED
        CTC_0xD21381: DemEventID=14, DemEventKind=DEM_EVENT_KIND_SWC, DemImportedEvent=true, DemDTCClassRef=DtcClass36, DemFreezeFrameClassRef=Snapshot_33
          DemEventClass:
            DemEventPriority = 0
            DemFFPrestorageSupported = false
            DemHealingAllowed = true
            DemEventDestination = DEM_DTC_ORIGIN_PRIMARY_MEMORY
            DemHealingCycleCounter = 40
            DemHealingCycleRef = DEM_IGNITION
            DemOperationCycleRef = DEM_IGNITION
            DemPredebounceAlgorithmClass
              DemPreDebounceCounterBased: DemCountInStepSize=0, DemCountOutStepSize=0, DemJumpDown=false, DemJumpUp=true, DemPreDebounceName=DEM_PRE_DEBOUNCE_COUNTER_BASED
        CTC_0xD30800: DemEventID=8, DemEventKind=DEM_EVENT_KIND_SWC, DemImportedEvent=true, DemDTCClassRef=DtcClass37, DemFreezeFrameClassRef=Snapshot_39
          DemEventClass:
            DemEventPriority = 0
            DemFFPrestorageSupported = false
            DemHealingAllowed = true
            DemEventDestination = DEM_DTC_ORIGIN_PRIMARY_MEMORY
            DemHealingCycleCounter = 40
            DemHealingCycleRef = DEM_IGNITION
            DemOperationCycleRef = DEM_IGNITION
            DemPredebounceAlgorithmClass
              DemPreDebounceCounterBased: DemCountInStepSize=0, DemCountOutStepSize=0, DemJumpDown=false, DemJumpUp=true, DemPreDebounceName=DEM_PRE_DEBOUNCE_COUNTER_BASED
        CTC_0x540800: DemEventID=31, DemEventKind=DEM_EVENT_KIND_SWC, DemImportedEvent=true, DemDTCClassRef=DtcClass38, DemFreezeFrameClassRef=Snapshot_16
          DemEventClass:
            DemEventPriority = 0
            DemFFPrestorageSupported = false
            DemHealingAllowed = true
            DemEventDestination = DEM_DTC_ORIGIN_PRIMARY_MEMORY
            DemHealingCycleCounter = 40
            DemHealingCycleRef = DEM_IGNITION
            DemOperationCycleRef = DEM_IGNITION
            DemPredebounceAlgorithmClass
              DemPreDebounceCounterBased: DemCountInStepSize=0, DemCountOutStepSize=0, DemJumpDown=false, DemJumpUp=true, DemPreDebounceName=DEM_PRE_DEBOUNCE_COUNTER_BASED
        CTC_0xD31300: DemEventID=7, DemEventKind=DEM_EVENT_KIND_SWC, DemImportedEvent=true, DemDTCClassRef=DtcClass39, DemFreezeFrameClassRef=Snapshot_40
          DemEventClass:
            DemEventPriority = 0
            DemFFPrestorageSupported = false
            DemHealingAllowed = true
            DemEventDestination = DEM_DTC_ORIGIN_PRIMARY_MEMORY
            DemHealingCycleCounter = 40
            DemHealingCycleRef = DEM_IGNITION
            DemOperationCycleRef = DEM_IGNITION
            DemPredebounceAlgorithmClass
              DemPreDebounceCounterBased: DemCountInStepSize=0, DemCountOutStepSize=0, DemJumpDown=false, DemJumpUp=true, DemPreDebounceName=DEM_PRE_DEBOUNCE_COUNTER_BASED
        CTC_0xD31382: DemEventID=6, DemEventKind=DEM_EVENT_KIND_SWC, DemImportedEvent=true, DemDTCClassRef=DtcClass40, DemFreezeFrameClassRef=Snapshot_41
          DemEventClass:
            DemEventPriority = 0
            DemFFPrestorageSupported = false
            DemHealingAllowed = true
            DemEventDestination = DEM_DTC_ORIGIN_PRIMARY_MEMORY
            DemHealingCycleCounter = 40
            DemHealingCycleRef = DEM_IGNITION
            DemOperationCycleRef = DEM_IGNITION
            DemPredebounceAlgorithmClass
              DemPreDebounceCounterBased: DemCountInStepSize=0, DemCountOutStepSize=0, DemJumpDown=false, DemJumpUp=true, DemPreDebounceName=DEM_PRE_DEBOUNCE_COUNTER_BASED
        CTC_0xD31383: DemEventID=5, DemEventKind=DEM_EVENT_KIND_SWC, DemImportedEvent=true, DemDTCClassRef=DtcClass41, DemFreezeFrameClassRef=Snapshot_42
          DemEventClass:
            DemEventPriority = 0
            DemFFPrestorageSupported = false
            DemHealingAllowed = true
            DemEventDestination = DEM_DTC_ORIGIN_PRIMARY_MEMORY
            DemHealingCycleCounter = 40
            DemHealingCycleRef = DEM_IGNITION
            DemOperationCycleRef = DEM_IGNITION
            DemPredebounceAlgorithmClass
              DemPreDebounceCounterBased: DemCountInStepSize=0, DemCountOutStepSize=0, DemJumpDown=false, DemJumpUp=true, DemPreDebounceName=DEM_PRE_DEBOUNCE_COUNTER_BASED
        CTC_0xD00008: DemEventID=23, DemEventKind=DEM_EVENT_KIND_SWC, DemImportedEvent=true, DemDTCClassRef=DtcClass42, DemFreezeFrameClassRef=Snapshot_24
          DemEventClass:
            DemEventPriority = 0
            DemFFPrestorageSupported = false
            DemHealingAllowed = true
            DemEventDestination = DEM_DTC_ORIGIN_PRIMARY_MEMORY
            DemHealingCycleCounter = 40
            DemHealingCycleRef = DEM_IGNITION
            DemOperationCycleRef = DEM_IGNITION
            DemPredebounceAlgorithmClass
              DemPreDebounceCounterBased: DemCountInStepSize=0, DemCountOutStepSize=0, DemJumpDown=false, DemJumpUp=true, DemPreDebounceName=DEM_PRE_DEBOUNCE_COUNTER_BASED
        CTC_0xD10887: DemEventID=20, DemEventKind=DEM_EVENT_KIND_SWC, DemImportedEvent=true, DemDTCClassRef=DtcClass43, DemFreezeFrameClassRef=Snapshot_27
          DemEventClass:
            DemEventPriority = 0
            DemFFPrestorageSupported = false
            DemHealingAllowed = true
            DemEventDestination = DEM_DTC_ORIGIN_PRIMARY_MEMORY
            DemHealingCycleCounter = 40
            DemHealingCycleRef = DEM_IGNITION
            DemOperationCycleRef = DEM_IGNITION
            DemPredebounceAlgorithmClass
              DemPreDebounceCounterBased: DemCountInStepSize=0, DemCountOutStepSize=0, DemJumpDown=false, DemJumpUp=true, DemPreDebounceName=DEM_PRE_DEBOUNCE_COUNTER_BASED
        CTC_0xD11387: DemEventID=19, DemEventKind=DEM_EVENT_KIND_SWC, DemImportedEvent=true, DemDTCClassRef=DtcClass44, DemFreezeFrameClassRef=Snapshot_28
          DemEventClass:
            DemEventPriority = 0
            DemFFPrestorageSupported = false
            DemHealingAllowed = true
            DemEventDestination = DEM_DTC_ORIGIN_PRIMARY_MEMORY
            DemHealingCycleCounter = 40
            DemHealingCycleRef = DEM_IGNITION
            DemOperationCycleRef = DEM_IGNITION
            DemPredebounceAlgorithmClass
              DemPreDebounceCounterBased: DemCountInStepSize=0, DemCountOutStepSize=0, DemJumpDown=false, DemJumpUp=true, DemPreDebounceName=DEM_PRE_DEBOUNCE_COUNTER_BASED
        CTC_0xD20881: DemEventID=15, DemEventKind=DEM_EVENT_KIND_SWC, DemImportedEvent=true, DemDTCClassRef=DtcClass45, DemFreezeFrameClassRef=Snapshot_32
          DemEventClass:
            DemEventPriority = 0
            DemFFPrestorageSupported = false
            DemHealingAllowed = true
            DemEventDestination = DEM_DTC_ORIGIN_PRIMARY_MEMORY
            DemHealingCycleCounter = 40
            DemHealingCycleRef = DEM_IGNITION
            DemOperationCycleRef = DEM_IGNITION
            DemPredebounceAlgorithmClass
              DemPreDebounceCounterBased: DemCountInStepSize=0, DemCountOutStepSize=0, DemJumpDown=false, DemJumpUp=true, DemPreDebounceName=DEM_PRE_DEBOUNCE_COUNTER_BASED
        CTC_0xD10587: DemEventID=21, DemEventKind=DEM_EVENT_KIND_SWC, DemImportedEvent=true, DemDTCClassRef=DtcClass46, DemFreezeFrameClassRef=Snapshot_26
          DemEventClass:
            DemEventPriority = 0
            DemFFPrestorageSupported = false
            DemHealingAllowed = true
            DemEventDestination = DEM_DTC_ORIGIN_PRIMARY_MEMORY
            DemHealingCycleCounter = 40
            DemHealingCycleRef = DEM_IGNITION
            DemOperationCycleRef = DEM_IGNITION
            DemPredebounceAlgorithmClass
              DemPreDebounceCounterBased: DemCountInStepSize=0, DemCountOutStepSize=0, DemJumpDown=false, DemJumpUp=true, DemPreDebounceName=DEM_PRE_DEBOUNCE_COUNTER_BASED
        CTC_0xD20581: DemEventID=16, DemEventKind=DEM_EVENT_KIND_SWC, DemImportedEvent=true, DemDTCClassRef=DtcClass47, DemFreezeFrameClassRef=Snapshot_31
          DemEventClass:
            DemEventPriority = 0
            DemFFPrestorageSupported = false
            DemHealingAllowed = true
            DemEventDestination = DEM_DTC_ORIGIN_PRIMARY_MEMORY
            DemHealingCycleCounter = 40
            DemHealingCycleRef = DEM_IGNITION
            DemOperationCycleRef = DEM_IGNITION
            DemPredebounceAlgorithmClass
              DemPreDebounceCounterBased: DemCountInStepSize=0, DemCountOutStepSize=0, DemJumpDown=false, DemJumpUp=true, DemPreDebounceName=DEM_PRE_DEBOUNCE_COUNTER_BASED
        CTC_0xD30500: DemEventID=11, DemEventKind=DEM_EVENT_KIND_SWC, DemImportedEvent=true, DemDTCClassRef=DtcClass48, DemFreezeFrameClassRef=Snapshot_36
          DemEventClass:
            DemEventPriority = 0
            DemFFPrestorageSupported = false
            DemHealingAllowed = true
            DemEventDestination = DEM_DTC_ORIGIN_PRIMARY_MEMORY
            DemHealingCycleCounter = 40
            DemHealingCycleRef = DEM_IGNITION
            DemOperationCycleRef = DEM_IGNITION
            DemPredebounceAlgorithmClass
              DemPreDebounceCounterBased: DemCountInStepSize=0, DemCountOutStepSize=0, DemJumpDown=false, DemJumpUp=true, DemPreDebounceName=DEM_PRE_DEBOUNCE_COUNTER_BASED
        CTC_0xD30582: DemEventID=10, DemEventKind=DEM_EVENT_KIND_SWC, DemImportedEvent=true, DemDTCClassRef=DtcClass49, DemFreezeFrameClassRef=Snapshot_37
          DemEventClass:
            DemEventPriority = 0
            DemFFPrestorageSupported = false
            DemHealingAllowed = true
            DemEventDestination = DEM_DTC_ORIGIN_PRIMARY_MEMORY
            DemHealingCycleCounter = 40
            DemHealingCycleRef = DEM_IGNITION
            DemOperationCycleRef = DEM_IGNITION
            DemPredebounceAlgorithmClass
              DemPreDebounceCounterBased: DemCountInStepSize=0, DemCountOutStepSize=0, DemJumpDown=false, DemJumpUp=true, DemPreDebounceName=DEM_PRE_DEBOUNCE_COUNTER_BASED
        CTC_0xD30583: DemEventID=9, DemEventKind=DEM_EVENT_KIND_SWC, DemImportedEvent=true, DemDTCClassRef=DtcClass50, DemFreezeFrameClassRef=Snapshot_38
          DemEventClass:
            DemEventPriority = 0
            DemFFPrestorageSupported = false
            DemHealingAllowed = true
            DemEventDestination = DEM_DTC_ORIGIN_PRIMARY_MEMORY
            DemHealingCycleCounter = 40
            DemHealingCycleRef = DEM_IGNITION
            DemOperationCycleRef = DEM_IGNITION
            DemPredebounceAlgorithmClass
              DemPreDebounceCounterBased: DemCountInStepSize=0, DemCountOutStepSize=0, DemJumpDown=false, DemJumpUp=true, DemPreDebounceName=DEM_PRE_DEBOUNCE_COUNTER_BASED
        CTC_0xD21881: DemEventID=13, DemEventKind=DEM_EVENT_KIND_SWC, DemImportedEvent=true, DemDTCClassRef=DtcClass51, DemFreezeFrameClassRef=Snapshot_34
          DemEventClass:
            DemEventPriority = 0
            DemFFPrestorageSupported = false
            DemHealingAllowed = true
            DemEventDestination = DEM_DTC_ORIGIN_PRIMARY_MEMORY
            DemHealingCycleCounter = 40
            DemHealingCycleRef = DEM_IGNITION
            DemOperationCycleRef = DEM_IGNITION
            DemPredebounceAlgorithmClass
              DemPreDebounceCounterBased: DemCountInStepSize=0, DemCountOutStepSize=0, DemJumpDown=false, DemJumpUp=true, DemPreDebounceName=DEM_PRE_DEBOUNCE_COUNTER_BASED
        CTC_0xD11D87: DemEventID=17, DemEventKind=DEM_EVENT_KIND_SWC, DemImportedEvent=true, DemDTCClassRef=DtcClass52, DemFreezeFrameClassRef=Snapshot_30
          DemEventClass:
            DemEventPriority = 0
            DemFFPrestorageSupported = false
            DemHealingAllowed = true
            DemEventDestination = DEM_DTC_ORIGIN_PRIMARY_MEMORY
            DemHealingCycleCounter = 40
            DemHealingCycleRef = DEM_IGNITION
            DemOperationCycleRef = DEM_IGNITION
            DemPredebounceAlgorithmClass
              DemPreDebounceCounterBased: DemCountInStepSize=0, DemCountOutStepSize=0, DemJumpDown=false, DemJumpUp=true, DemPreDebounceName=DEM_PRE_DEBOUNCE_COUNTER_BASED
        CTC_0xD21D81: DemEventID=12, DemEventKind=DEM_EVENT_KIND_SWC, DemImportedEvent=true, DemDTCClassRef=DtcClass53, DemFreezeFrameClassRef=Snapshot_35
          DemEventClass:
            DemEventPriority = 0
            DemFFPrestorageSupported = false
            DemHealingAllowed = true
            DemEventDestination = DEM_DTC_ORIGIN_PRIMARY_MEMORY
            DemHealingCycleCounter = 40
            DemHealingCycleRef = DEM_IGNITION
            DemOperationCycleRef = DEM_IGNITION
            DemPredebounceAlgorithmClass
              DemPreDebounceCounterBased: DemCountInStepSize=0, DemCountOutStepSize=0, DemJumpDown=false, DemJumpUp=true, DemPreDebounceName=DEM_PRE_DEBOUNCE_COUNTER_BASED
        CTC_0xD31D00: DemEventID=3, DemEventKind=DEM_EVENT_KIND_SWC, DemImportedEvent=true, DemDTCClassRef=DtcClass54, DemFreezeFrameClassRef=Snapshot_44
          DemEventClass:
            DemEventPriority = 0
            DemFFPrestorageSupported = false
            DemHealingAllowed = true
            DemEventDestination = DEM_DTC_ORIGIN_PRIMARY_MEMORY
            DemHealingCycleCounter = 40
            DemHealingCycleRef = DEM_IGNITION
            DemOperationCycleRef = DEM_IGNITION
            DemPredebounceAlgorithmClass
              DemPreDebounceCounterBased: DemCountInStepSize=0, DemCountOutStepSize=0, DemJumpDown=false, DemJumpUp=true, DemPreDebounceName=DEM_PRE_DEBOUNCE_COUNTER_BASED
        CTC_0xD31D82: DemEventID=2, DemEventKind=DEM_EVENT_KIND_SWC, DemImportedEvent=true, DemDTCClassRef=DtcClass55, DemFreezeFrameClassRef=Snapshot_45
          DemEventClass:
            DemEventPriority = 0
            DemFFPrestorageSupported = false
            DemHealingAllowed = true
            DemEventDestination = DEM_DTC_ORIGIN_PRIMARY_MEMORY
            DemHealingCycleCounter = 40
            DemHealingCycleRef = DEM_IGNITION
            DemOperationCycleRef = DEM_IGNITION
            DemPredebounceAlgorithmClass
              DemPreDebounceCounterBased: DemCountInStepSize=0, DemCountOutStepSize=0, DemJumpDown=false, DemJumpUp=true, DemPreDebounceName=DEM_PRE_DEBOUNCE_COUNTER_BASED
        CTC_0xD31D83: DemEventID=1, DemEventKind=DEM_EVENT_KIND_SWC, DemImportedEvent=true, DemDTCClassRef=DtcClass56, DemFreezeFrameClassRef=Snapshot_46
          DemEventClass:
            DemEventPriority = 0
            DemFFPrestorageSupported = false
            DemHealingAllowed = true
            DemEventDestination = DEM_DTC_ORIGIN_PRIMARY_MEMORY
            DemHealingCycleCounter = 40
            DemHealingCycleRef = DEM_IGNITION
            DemOperationCycleRef = DEM_IGNITION
            DemPredebounceAlgorithmClass
              DemPreDebounceCounterBased: DemCountInStepSize=0, DemCountOutStepSize=0, DemJumpDown=false, DemJumpUp=true, DemPreDebounceName=DEM_PRE_DEBOUNCE_COUNTER_BASED
        CANTRCV_E_NO_TRCV_CONTROL: DemEventID=48, DemEventKind=DEM_EVENT_KIND_BSW, DemImportedEvent=false, DemDTCClassRef=DtcClass0
          DemEventClass:
            DemEventPriority = 0
            DemFFPrestorageSupported = false
            DemHealingAllowed = false
            DemHealingCycleCounter = 1
            DemHealingCycleRef = (unset)
            DemOperationCycleRef = DEM_IGNITION
            DemPredebounceAlgorithmClass
              DemPreDebounceCounterBased: DemCountInStepSize=1, DemCountOutStepSize=1, DemJumpDown=false, DemJumpUp=true, DemPreDebounceName=DEM_PRE_DEBOUNCE_COUNTER_BASED
        PDUR_E_PDU_INSTANCE_LOST: DemEventID=49, DemEventKind=DEM_EVENT_KIND_BSW, DemImportedEvent=false, DemDTCClassRef=DtcClass1
          DemEventClass:
            DemEventPriority = 0
            DemFFPrestorageSupported = false
            DemHealingAllowed = false
            DemHealingCycleCounter = 1
            DemHealingCycleRef = (unset)
            DemOperationCycleRef = DEM_IGNITION
            DemPredebounceAlgorithmClass
              DemPreDebounceCounterBased: DemCountInStepSize=1, DemCountOutStepSize=1, DemJumpDown=false, DemJumpUp=true, DemPreDebounceName=DEM_PRE_DEBOUNCE_COUNTER_BASED
        PDUR_E_INIT_FAILED: DemEventID=50, DemEventKind=DEM_EVENT_KIND_BSW, DemImportedEvent=false, DemDTCClassRef=DtcClass2
          DemEventClass:
            DemEventPriority = 0
            DemFFPrestorageSupported = false
            DemHealingAllowed = false
            DemHealingCycleCounter = 1
            DemHealingCycleRef = (unset)
            DemOperationCycleRef = DEM_IGNITION
            DemPredebounceAlgorithmClass
              DemPreDebounceCounterBased: DemCountInStepSize=1, DemCountOutStepSize=1, DemJumpDown=false, DemJumpUp=true, DemPreDebounceName=DEM_PRE_DEBOUNCE_COUNTER_BASED
        COMM_E_NET_START_IND_CHANNEL_0: DemEventID=51, DemEventKind=DEM_EVENT_KIND_BSW, DemImportedEvent=false, DemDTCClassRef=DtcClass3
          DemEventClass:
            DemEventPriority = 0
            DemFFPrestorageSupported = false
            DemHealingAllowed = false
            DemHealingCycleCounter = 1
            DemHealingCycleRef = (unset)
            DemOperationCycleRef = DEM_IGNITION
            DemPredebounceAlgorithmClass
              DemPreDebounceCounterBased: DemCountInStepSize=1, DemCountOutStepSize=1, DemJumpDown=false, DemJumpUp=true, DemPreDebounceName=DEM_PRE_DEBOUNCE_COUNTER_BASED
        CAN_E_TIMEOUT: DemEventID=52, DemEventKind=DEM_EVENT_KIND_BSW, DemImportedEvent=false, DemDTCClassRef=DtcClass4
          DemEventClass:
            DemEventPriority = 0
            DemFFPrestorageSupported = false
            DemHealingAllowed = false
            DemHealingCycleCounter = 1
            DemHealingCycleRef = (unset)
            DemOperationCycleRef = DEM_IGNITION
            DemPredebounceAlgorithmClass
              DemPreDebounceCounterBased: DemCountInStepSize=1, DemCountOutStepSize=1, DemJumpDown=false, DemJumpUp=true, DemPreDebounceName=DEM_PRE_DEBOUNCE_COUNTER_BASED
        CANIF_E_INVALID_DLC: DemEventID=53, DemEventKind=DEM_EVENT_KIND_BSW, DemImportedEvent=false, DemDTCClassRef=DtcClass5
          DemEventClass:
            DemEventPriority = 0
            DemFFPrestorageSupported = false
            DemHealingAllowed = false
            DemHealingCycleCounter = 1
            DemHealingCycleRef = (unset)
            DemOperationCycleRef = DEM_IGNITION
            DemPredebounceAlgorithmClass
              DemPreDebounceCounterBased: DemCountInStepSize=1, DemCountOutStepSize=1, DemJumpDown=false, DemJumpUp=true, DemPreDebounceName=DEM_PRE_DEBOUNCE_COUNTER_BASED
        CANSM_E_MODE_CHANGE_NETWORK_0: DemEventID=54, DemEventKind=DEM_EVENT_KIND_BSW, DemImportedEvent=false, DemDTCClassRef=DtcClass6
          DemEventClass:
            DemEventPriority = 0
            DemFFPrestorageSupported = false
            DemHealingAllowed = false
            DemHealingCycleCounter = 1
            DemHealingCycleRef = (unset)
            DemOperationCycleRef = DEM_IGNITION
            DemPredebounceAlgorithmClass
              DemPreDebounceCounterBased: DemCountInStepSize=1, DemCountOutStepSize=1, DemJumpDown=false, DemJumpUp=true, DemPreDebounceName=DEM_PRE_DEBOUNCE_COUNTER_BASED
        CANSM_E_MODE_CHANGE_NETWORK_1: DemEventID=55, DemEventKind=DEM_EVENT_KIND_BSW, DemImportedEvent=false, DemDTCClassRef=DtcClass7
          DemEventClass:
            DemEventPriority = 0
            DemFFPrestorageSupported = false
            DemHealingAllowed = false
            DemHealingCycleCounter = 1
            DemHealingCycleRef = (unset)
            DemOperationCycleRef = DEM_IGNITION
            DemPredebounceAlgorithmClass
              DemPreDebounceCounterBased: DemCountInStepSize=1, DemCountOutStepSize=1, DemJumpDown=false, DemJumpUp=true, DemPreDebounceName=DEM_PRE_DEBOUNCE_COUNTER_BASED
        CANSM_E_BUSOFF_NETWORK_0: DemEventID=56, DemEventKind=DEM_EVENT_KIND_BSW, DemImportedEvent=false, DemDTCClassRef=DtcClass8
          DemEventClass:
            DemEventPriority = 0
            DemFFPrestorageSupported = false
            DemHealingAllowed = false
            DemHealingCycleCounter = 1
            DemHealingCycleRef = (unset)
            DemOperationCycleRef = DEM_IGNITION
            DemPredebounceAlgorithmClass
              DemPreDebounceCounterBased: DemCountInStepSize=1, DemCountOutStepSize=1, DemJumpDown=false, DemJumpUp=true, DemPreDebounceName=DEM_PRE_DEBOUNCE_COUNTER_BASED
        CANSM_E_BUSOFF_NETWORK_1: DemEventID=57, DemEventKind=DEM_EVENT_KIND_BSW, DemImportedEvent=false, DemDTCClassRef=DtcClass9
          DemEventClass:
            DemEventPriority = 0
            DemFFPrestorageSupported = false
            DemHealingAllowed = false
            DemHealingCycleCounter = 1
            DemHealingCycleRef = (unset)
            DemOperationCycleRef = DEM_IGNITION
            DemPredebounceAlgorithmClass
              DemPreDebounceCounterBased: DemCountInStepSize=1, DemCountOutStepSize=1, DemJumpDown=false, DemJumpUp=true, DemPreDebounceName=DEM_PRE_DEBOUNCE_COUNTER_BASED
        CANSM_E_SETTRANSCEIVERMODE_NETWORK_0: DemEventID=58, DemEventKind=DEM_EVENT_KIND_BSW, DemImportedEvent=false, DemDTCClassRef=DtcClass10
          DemEventClass:
            DemEventPriority = 0
            DemFFPrestorageSupported = false
            DemHealingAllowed = false
            DemHealingCycleCounter = 1
            DemHealingCycleRef = (unset)
            DemOperationCycleRef = DEM_IGNITION
            DemPredebounceAlgorithmClass
              DemPreDebounceCounterBased: DemCountInStepSize=1, DemCountOutStepSize=1, DemJumpDown=false, DemJumpUp=true, DemPreDebounceName=DEM_PRE_DEBOUNCE_COUNTER_BASED
        CANSM_E_SETTRANSCEIVERMODE_NETWORK_1: DemEventID=59, DemEventKind=DEM_EVENT_KIND_BSW, DemImportedEvent=false, DemDTCClassRef=DtcClass11
          DemEventClass:
            DemEventPriority = 0
            DemFFPrestorageSupported = false
            DemHealingAllowed = false
            DemHealingCycleCounter = 1
            DemHealingCycleRef = (unset)
            DemOperationCycleRef = DEM_IGNITION
            DemPredebounceAlgorithmClass
              DemPreDebounceCounterBased: DemCountInStepSize=1, DemCountOutStepSize=1, DemJumpDown=false, DemJumpUp=true, DemPreDebounceName=DEM_PRE_DEBOUNCE_COUNTER_BASED
        LINSM_E_CONFIRMATION_TIMEOUT: DemEventID=60, DemEventKind=DEM_EVENT_KIND_BSW, DemImportedEvent=false, DemDTCClassRef=DtcClass12
          DemEventClass:
            DemEventPriority = 0
            DemFFPrestorageSupported = false
            DemHealingAllowed = false
            DemHealingCycleCounter = 1
            DemHealingCycleRef = (unset)
            DemOperationCycleRef = DEM_IGNITION
            DemPredebounceAlgorithmClass
              DemPreDebounceCounterBased: DemCountInStepSize=1, DemCountOutStepSize=1, DemJumpDown=false, DemJumpUp=true, DemPreDebounceName=DEM_PRE_DEBOUNCE_COUNTER_BASED
        COMM_E_NET_START_IND_CHANNEL_1: DemEventID=61, DemEventKind=DEM_EVENT_KIND_BSW, DemImportedEvent=false, DemDTCClassRef=DtcClass13
          DemEventClass:
            DemEventPriority = 0
            DemFFPrestorageSupported = false
            DemHealingAllowed = false
            DemHealingCycleCounter = 1
            DemHealingCycleRef = (unset)
            DemOperationCycleRef = DEM_IGNITION
            DemPredebounceAlgorithmClass
              DemPreDebounceCounterBased: DemCountInStepSize=1, DemCountOutStepSize=1, DemJumpDown=false, DemJumpUp=true, DemPreDebounceName=DEM_PRE_DEBOUNCE_COUNTER_BASED
        COMM_E_NET_START_IND_CHANNEL_2: DemEventID=62, DemEventKind=DEM_EVENT_KIND_BSW, DemImportedEvent=false, DemDTCClassRef=DtcClass14
          DemEventClass:
            DemEventPriority = 0
            DemFFPrestorageSupported = false
            DemHealingAllowed = false
            DemHealingCycleCounter = 1
            DemHealingCycleRef = (unset)
            DemOperationCycleRef = DEM_IGNITION
            DemPredebounceAlgorithmClass
              DemPreDebounceCounterBased: DemCountInStepSize=1, DemCountOutStepSize=1, DemJumpDown=false, DemJumpUp=true, DemPreDebounceName=DEM_PRE_DEBOUNCE_COUNTER_BASED
        ECUM_E_ALL_RUN_REQUESTS_KILLED: DemEventID=63, DemEventKind=DEM_EVENT_KIND_BSW, DemImportedEvent=false, DemDTCClassRef=DtcClass15
          DemEventClass:
            DemEventPriority = 0
            DemFFPrestorageSupported = false
            DemHealingAllowed = false
            DemHealingCycleCounter = 1
            DemHealingCycleRef = (unset)
            DemOperationCycleRef = DEM_IGNITION
            DemPredebounceAlgorithmClass
              DemPreDebounceCounterBased: DemCountInStepSize=1, DemCountOutStepSize=1, DemJumpDown=false, DemJumpUp=true, DemPreDebounceName=DEM_PRE_DEBOUNCE_COUNTER_BASED
        ECUM_E_RAM_CHECKED_FAILED: DemEventID=64, DemEventKind=DEM_EVENT_KIND_BSW, DemImportedEvent=false, DemDTCClassRef=DtcClass16
          DemEventClass:
            DemEventPriority = 0
            DemFFPrestorageSupported = false
            DemHealingAllowed = false
            DemHealingCycleCounter = 1
            DemHealingCycleRef = (unset)
            DemOperationCycleRef = DEM_IGNITION
            DemPredebounceAlgorithmClass
              DemPreDebounceCounterBased: DemCountInStepSize=1, DemCountOutStepSize=1, DemJumpDown=false, DemJumpUp=true, DemPreDebounceName=DEM_PRE_DEBOUNCE_COUNTER_BASED
        FLS_E_ERASE_FAILED: DemEventID=67, DemEventKind=DEM_EVENT_KIND_BSW, DemImportedEvent=false, DemDTCClassRef=DtcClass19
          DemEventClass:
            DemEventPriority = 0
            DemFFPrestorageSupported = false
            DemHealingAllowed = false
            DemHealingCycleCounter = 1
            DemHealingCycleRef = (unset)
            DemOperationCycleRef = DEM_IGNITION
            DemPredebounceAlgorithmClass
              DemPreDebounceCounterBased: DemCountInStepSize=1, DemCountOutStepSize=1, DemJumpDown=false, DemJumpUp=true, DemPreDebounceName=DEM_PRE_DEBOUNCE_COUNTER_BASED
        FLS_E_WRITE_FAILED: DemEventID=68, DemEventKind=DEM_EVENT_KIND_BSW, DemImportedEvent=false, DemDTCClassRef=DtcClass20
          DemEventClass:
            DemEventPriority = 0
            DemFFPrestorageSupported = false
            DemHealingAllowed = false
            DemHealingCycleCounter = 1
            DemHealingCycleRef = (unset)
            DemOperationCycleRef = DEM_IGNITION
            DemPredebounceAlgorithmClass
              DemPreDebounceCounterBased: DemCountInStepSize=1, DemCountOutStepSize=1, DemJumpDown=false, DemJumpUp=true, DemPreDebounceName=DEM_PRE_DEBOUNCE_COUNTER_BASED
        FLS_E_READ_FAILED: DemEventID=69, DemEventKind=DEM_EVENT_KIND_BSW, DemImportedEvent=false, DemDTCClassRef=DtcClass21
          DemEventClass:
            DemEventPriority = 0
            DemFFPrestorageSupported = false
            DemHealingAllowed = false
            DemHealingCycleCounter = 1
            DemHealingCycleRef = (unset)
            DemOperationCycleRef = DEM_IGNITION
            DemPredebounceAlgorithmClass
              DemPreDebounceCounterBased: DemCountInStepSize=1, DemCountOutStepSize=1, DemJumpDown=false, DemJumpUp=true, DemPreDebounceName=DEM_PRE_DEBOUNCE_COUNTER_BASED
        FLS_E_COMPARE_FAILED: DemEventID=70, DemEventKind=DEM_EVENT_KIND_BSW, DemImportedEvent=false, DemDTCClassRef=DtcClass22
          DemEventClass:
            DemEventPriority = 0
            DemFFPrestorageSupported = false
            DemHealingAllowed = false
            DemHealingCycleCounter = 1
            DemHealingCycleRef = (unset)
            DemOperationCycleRef = DEM_IGNITION
            DemPredebounceAlgorithmClass
              DemPreDebounceCounterBased: DemCountInStepSize=1, DemCountOutStepSize=1, DemJumpDown=false, DemJumpUp=true, DemPreDebounceName=DEM_PRE_DEBOUNCE_COUNTER_BASED
        FRIF_E_JLE_SYNC: DemEventID=71, DemEventKind=DEM_EVENT_KIND_BSW, DemImportedEvent=false, DemDTCClassRef=DtcClass23
          DemEventClass:
            DemEventPriority = 0
            DemFFPrestorageSupported = false
            DemHealingAllowed = false
            DemHealingCycleCounter = 1
            DemHealingCycleRef = (unset)
            DemOperationCycleRef = DEM_IGNITION
            DemPredebounceAlgorithmClass
              DemPreDebounceCounterBased: DemCountInStepSize=1, DemCountOutStepSize=1, DemJumpDown=false, DemJumpUp=true, DemPreDebounceName=DEM_PRE_DEBOUNCE_COUNTER_BASED
        FRNM_E_INIT_FAILED: DemEventID=72, DemEventKind=DEM_EVENT_KIND_BSW, DemImportedEvent=false, DemDTCClassRef=DtcClass24
          DemEventClass:
            DemEventPriority = 0
            DemFFPrestorageSupported = false
            DemHealingAllowed = false
            DemHealingCycleCounter = 1
            DemHealingCycleRef = (unset)
            DemOperationCycleRef = DEM_IGNITION
            DemPredebounceAlgorithmClass
              DemPreDebounceCounterBased: DemCountInStepSize=1, DemCountOutStepSize=1, DemJumpDown=false, DemJumpUp=true, DemPreDebounceName=DEM_PRE_DEBOUNCE_COUNTER_BASED
        FRSM_E_CLUSTER_STARTUP: DemEventID=73, DemEventKind=DEM_EVENT_KIND_BSW, DemImportedEvent=false, DemDTCClassRef=DtcClass25
          DemEventClass:
            DemEventPriority = 0
            DemFFPrestorageSupported = false
            DemHealingAllowed = false
            DemHealingCycleCounter = 1
            DemHealingCycleRef = (unset)
            DemOperationCycleRef = DEM_IGNITION
            DemPredebounceAlgorithmClass
              DemPreDebounceCounterBased: DemCountInStepSize=1, DemCountOutStepSize=1, DemJumpDown=false, DemJumpUp=true, DemPreDebounceName=DEM_PRE_DEBOUNCE_COUNTER_BASED
        FRTRCV_E_FR_NO_TRCV_CONTROL: DemEventID=74, DemEventKind=DEM_EVENT_KIND_BSW, DemImportedEvent=false, DemDTCClassRef=DtcClass26
          DemEventClass:
            DemEventPriority = 0
            DemFFPrestorageSupported = false
            DemHealingAllowed = false
            DemHealingCycleCounter = 1
            DemHealingCycleRef = (unset)
            DemOperationCycleRef = DEM_IGNITION
            DemPredebounceAlgorithmClass
              DemPreDebounceCounterBased: DemCountInStepSize=1, DemCountOutStepSize=1, DemJumpDown=false, DemJumpUp=true, DemPreDebounceName=DEM_PRE_DEBOUNCE_COUNTER_BASED
        CTC_0x050192: DemEventID=47, DemEventKind=DEM_EVENT_KIND_SWC, DemImportedEvent=true, DemDTCClassRef=DtcClass57, DemFreezeFrameClassRef=Snapshot
          DemEventClass:
            DemEventPriority = 0
            DemFFPrestorageSupported = false
            DemHealingAllowed = true
            DemEventDestination = DEM_DTC_ORIGIN_PRIMARY_MEMORY
            DemHealingCycleCounter = 40
            DemHealingCycleRef = DEM_IGNITION
            DemOperationCycleRef = DEM_IGNITION
            DemPredebounceAlgorithmClass
              DemPreDebounceCounterBased: DemCountInStepSize=0, DemCountOutStepSize=0, DemJumpDown=false, DemJumpUp=true, DemPreDebounceName=DEM_PRE_DEBOUNCE_COUNTER_BASED
        CTC_0x540781: DemEventID=32, DemEventKind=DEM_EVENT_KIND_SWC, DemImportedEvent=true, DemDTCClassRef=DtcClass58, DemFreezeFrameClassRef=Snapshot_15
          DemEventClass:
            DemEventPriority = 0
            DemFFPrestorageSupported = false
            DemHealingAllowed = true
            DemEventDestination = DEM_DTC_ORIGIN_PRIMARY_MEMORY
            DemHealingCycleCounter = 40
            DemHealingCycleRef = DEM_IGNITION
            DemOperationCycleRef = DEM_IGNITION
            DemPredebounceAlgorithmClass
              DemPreDebounceCounterBased: DemCountInStepSize=0, DemCountOutStepSize=0, DemJumpDown=false, DemJumpUp=true, DemPreDebounceName=DEM_PRE_DEBOUNCE_COUNTER_BASED
        CTC_0x540887: DemEventID=30, DemEventKind=DEM_EVENT_KIND_SWC, DemImportedEvent=true, DemDTCClassRef=DtcClass59, DemFreezeFrameClassRef=Snapshot_17
          DemEventClass:
            DemEventPriority = 0
            DemFFPrestorageSupported = false
            DemHealingAllowed = true
            DemEventDestination = DEM_DTC_ORIGIN_PRIMARY_MEMORY
            DemHealingCycleCounter = 40
            DemHealingCycleRef = DEM_IGNITION
            DemOperationCycleRef = DEM_IGNITION
            DemPredebounceAlgorithmClass
              DemPreDebounceCounterBased: DemCountInStepSize=0, DemCountOutStepSize=0, DemJumpDown=false, DemJumpUp=true, DemPreDebounceName=DEM_PRE_DEBOUNCE_COUNTER_BASED
      DEM_DTC_GROUP_EMISSION_REL_DTCS (DemGroupOfDTC): DemGroupDTCs=(unset)
      DEM_DTC_GROUP_POWERTRAIN_DTCS (DemGroupOfDTC): DemGroupDTCs=1
      16 x DemEventParameter, all with DemInitMonitorName=(unset), DemEventKind=DEM_EVENT_KIND_SWC, DemImportedEvent=true, DemExtendedDataRef=(unset):
        CTC_0x510A51: DemEventID=46, DemDTCClassRef=DtcClass60, DemFreezeFrameClassRef=Snapshot_1
          DemEventClass:
            DemEventPriority = 0
            DemFFPrestorageSupported = false
            DemHealingAllowed = true
            DemEventDestination = DEM_DTC_ORIGIN_PRIMARY_MEMORY
            DemHealingCycleCounter = 40
            DemHealingCycleRef = DEM_IGNITION
            DemOperationCycleRef = DEM_IGNITION
            DemPredebounceAlgorithmClass
              DemPreDebounceCounterBased: DemJumpUp=true, DemJumpDown=false, DemCountOutStepSize=0, DemCountInStepSize=0, DemPreDebounceName=DEM_PRE_DEBOUNCE_COUNTER_BASED
            DemIndicator0 (DemIndicatorAttribute): DemIndicatorBehaviour=1, DemLinkedIndicator=ETATDA2
        CTC_0x510BA1: DemEventID=45, DemDTCClassRef=DtcClass61, DemFreezeFrameClassRef=Snapshot_2
          DemEventClass:
            DemEventPriority = 0
            DemFFPrestorageSupported = false
            DemHealingAllowed = true
            DemEventDestination = DEM_DTC_ORIGIN_PRIMARY_MEMORY
            DemHealingCycleCounter = 40
            DemHealingCycleRef = DEM_IGNITION
            DemOperationCycleRef = DEM_IGNITION
            DemPredebounceAlgorithmClass
              DemPreDebounceCounterBased: DemJumpUp=true, DemJumpDown=false, DemCountOutStepSize=0, DemCountInStepSize=0, DemPreDebounceName=DEM_PRE_DEBOUNCE_COUNTER_BASED
        CTC_0x510BA2: DemEventID=44, DemDTCClassRef=DtcClass62, DemFreezeFrameClassRef=Snapshot_3
          DemEventClass:
            DemEventPriority = 0
            DemFFPrestorageSupported = false
            DemHealingAllowed = true
            DemEventDestination = DEM_DTC_ORIGIN_PRIMARY_MEMORY
            DemHealingCycleCounter = 40
            DemHealingCycleRef = DEM_IGNITION
            DemOperationCycleRef = DEM_IGNITION
            DemPredebounceAlgorithmClass
              DemPreDebounceCounterBased: DemJumpUp=true, DemJumpDown=false, DemCountOutStepSize=0, DemCountInStepSize=0, DemPreDebounceName=DEM_PRE_DEBOUNCE_COUNTER_BASED
            DemIndicator0 (DemIndicatorAttribute): DemIndicatorBehaviour=1, DemLinkedIndicator=ETATDA2
        CTC_0x510BA3: DemEventID=43, DemDTCClassRef=DtcClass63, DemFreezeFrameClassRef=Snapshot_4
          DemEventClass:
            DemEventPriority = 0
            DemFFPrestorageSupported = false
            DemHealingAllowed = true
            DemEventDestination = DEM_DTC_ORIGIN_PRIMARY_MEMORY
            DemHealingCycleCounter = 40
            DemHealingCycleRef = DEM_IGNITION
            DemOperationCycleRef = DEM_IGNITION
            DemPredebounceAlgorithmClass
              DemPreDebounceCounterBased: DemJumpUp=true, DemJumpDown=false, DemCountOutStepSize=0, DemCountInStepSize=0, DemPreDebounceName=DEM_PRE_DEBOUNCE_COUNTER_BASED
            DemIndicator0 (DemIndicatorAttribute): DemIndicatorBehaviour=1, DemLinkedIndicator=ETATDA2
        CTC_0x510C01: DemEventID=42, DemDTCClassRef=DtcClass64, DemFreezeFrameClassRef=Snapshot_5
          DemEventClass:
            DemEventPriority = 0
            DemFFPrestorageSupported = false
            DemHealingAllowed = true
            DemEventDestination = DEM_DTC_ORIGIN_PRIMARY_MEMORY
            DemHealingCycleCounter = 40
            DemHealingCycleRef = DEM_IGNITION
            DemOperationCycleRef = DEM_IGNITION
            DemPredebounceAlgorithmClass
              DemPreDebounceCounterBased: DemJumpUp=true, DemJumpDown=false, DemCountOutStepSize=0, DemCountInStepSize=0, DemPreDebounceName=DEM_PRE_DEBOUNCE_COUNTER_BASED
            DemIndicator0 (DemIndicatorAttribute): DemIndicatorBehaviour=1, DemLinkedIndicator=ETATDA2
        CTC_0x510C04: DemEventID=41, DemDTCClassRef=DtcClass65, DemFreezeFrameClassRef=Snapshot_6
          DemEventClass:
            DemEventPriority = 0
            DemFFPrestorageSupported = false
            DemHealingAllowed = true
            DemEventDestination = DEM_DTC_ORIGIN_PRIMARY_MEMORY
            DemHealingCycleCounter = 40
            DemHealingCycleRef = DEM_IGNITION
            DemOperationCycleRef = DEM_IGNITION
            DemPredebounceAlgorithmClass
              DemPreDebounceCounterBased: DemJumpUp=true, DemJumpDown=false, DemCountOutStepSize=0, DemCountInStepSize=0, DemPreDebounceName=DEM_PRE_DEBOUNCE_COUNTER_BASED
            DemIndicator0 (DemIndicatorAttribute): DemIndicatorBehaviour=1, DemLinkedIndicator=ETATDA2
        CTC_0x510C1C: DemEventID=40, DemDTCClassRef=DtcClass66, DemFreezeFrameClassRef=Snapshot_7
          DemEventClass:
            DemEventPriority = 0
            DemFFPrestorageSupported = false
            DemHealingAllowed = true
            DemEventDestination = DEM_DTC_ORIGIN_PRIMARY_MEMORY
            DemHealingCycleCounter = 40
            DemHealingCycleRef = DEM_IGNITION
            DemOperationCycleRef = DEM_IGNITION
            DemPredebounceAlgorithmClass
              DemPreDebounceCounterBased: DemJumpUp=true, DemJumpDown=false, DemCountOutStepSize=0, DemCountInStepSize=0, DemPreDebounceName=DEM_PRE_DEBOUNCE_COUNTER_BASED
            DemIndicator0 (DemIndicatorAttribute): DemIndicatorBehaviour=1, DemLinkedIndicator=ETATDA2
        CTC_0x510C43: DemEventID=39, DemDTCClassRef=DtcClass67, DemFreezeFrameClassRef=Snapshot_8
          DemEventClass:
            DemEventPriority = 0
            DemFFPrestorageSupported = false
            DemHealingAllowed = true
            DemEventDestination = DEM_DTC_ORIGIN_PRIMARY_MEMORY
            DemHealingCycleCounter = 40
            DemHealingCycleRef = DEM_IGNITION
            DemOperationCycleRef = DEM_IGNITION
            DemPredebounceAlgorithmClass
              DemPreDebounceCounterBased: DemJumpUp=true, DemJumpDown=false, DemCountOutStepSize=0, DemCountInStepSize=0, DemPreDebounceName=DEM_PRE_DEBOUNCE_COUNTER_BASED
            DemIndicator0 (DemIndicatorAttribute): DemIndicatorBehaviour=1, DemLinkedIndicator=ETATDA2
        CTC_0x510C62: DemEventID=38, DemDTCClassRef=DtcClass68, DemFreezeFrameClassRef=Snapshot_9
          DemEventClass:
            DemEventPriority = 0
            DemFFPrestorageSupported = false
            DemHealingAllowed = true
            DemEventDestination = DEM_DTC_ORIGIN_PRIMARY_MEMORY
            DemHealingCycleCounter = 40
            DemHealingCycleRef = DEM_IGNITION
            DemOperationCycleRef = DEM_IGNITION
            DemPredebounceAlgorithmClass
              DemPreDebounceCounterBased: DemJumpUp=true, DemJumpDown=false, DemCountOutStepSize=0, DemCountInStepSize=0, DemPreDebounceName=DEM_PRE_DEBOUNCE_COUNTER_BASED
            DemIndicator0 (DemIndicatorAttribute): DemIndicatorBehaviour=1, DemLinkedIndicator=ETATDA2
        CTC_0x510C96: DemEventID=37, DemDTCClassRef=DtcClass69, DemFreezeFrameClassRef=Snapshot_10
          DemEventClass:
            DemEventPriority = 0
            DemFFPrestorageSupported = false
            DemHealingAllowed = true
            DemEventDestination = DEM_DTC_ORIGIN_PRIMARY_MEMORY
            DemHealingCycleCounter = 40
            DemHealingCycleRef = DEM_IGNITION
            DemOperationCycleRef = DEM_IGNITION
            DemPredebounceAlgorithmClass
              DemPreDebounceCounterBased: DemJumpUp=true, DemJumpDown=false, DemCountOutStepSize=0, DemCountInStepSize=0, DemPreDebounceName=DEM_PRE_DEBOUNCE_COUNTER_BASED
            DemIndicator0 (DemIndicatorAttribute): DemIndicatorBehaviour=1, DemLinkedIndicator=ETATDA2
        CTC_0x510C98: DemEventID=36, DemDTCClassRef=DtcClass70, DemFreezeFrameClassRef=Snapshot_11
          DemEventClass:
            DemEventPriority = 0
            DemFFPrestorageSupported = false
            DemHealingAllowed = true
            DemEventDestination = DEM_DTC_ORIGIN_PRIMARY_MEMORY
            DemHealingCycleCounter = 40
            DemHealingCycleRef = DEM_IGNITION
            DemOperationCycleRef = DEM_IGNITION
            DemPredebounceAlgorithmClass
              DemPreDebounceCounterBased: DemJumpUp=true, DemJumpDown=false, DemCountOutStepSize=0, DemCountInStepSize=0, DemPreDebounceName=DEM_PRE_DEBOUNCE_COUNTER_BASED
            DemIndicator0 (DemIndicatorAttribute): DemIndicatorBehaviour=1, DemLinkedIndicator=ETATDA2
        CTC_0x539855: DemEventID=34, DemDTCClassRef=DtcClass71, DemFreezeFrameClassRef=Snapshot_13
          DemEventClass:
            DemEventPriority = 0
            DemFFPrestorageSupported = false
            DemHealingAllowed = true
            DemEventDestination = DEM_DTC_ORIGIN_PRIMARY_MEMORY
            DemHealingCycleCounter = 40
            DemHealingCycleRef = DEM_IGNITION
            DemOperationCycleRef = DEM_IGNITION
            DemPredebounceAlgorithmClass
              DemPreDebounceCounterBased: DemJumpUp=true, DemJumpDown=false, DemCountOutStepSize=0, DemCountInStepSize=0, DemPreDebounceName=DEM_PRE_DEBOUNCE_COUNTER_BASED
            DemIndicator0 (DemIndicatorAttribute): DemIndicatorBehaviour=1, DemLinkedIndicator=ETATDA2
        CTC_0x540C00: DemEventID=28, DemDTCClassRef=DtcClass72, DemFreezeFrameClassRef=Snapshot_19
          DemEventClass:
            DemEventPriority = 0
            DemFFPrestorageSupported = false
            DemHealingAllowed = true
            DemEventDestination = DEM_DTC_ORIGIN_PRIMARY_MEMORY
            DemHealingCycleCounter = 40
            DemHealingCycleRef = DEM_IGNITION
            DemOperationCycleRef = DEM_IGNITION
            DemPredebounceAlgorithmClass
              DemPreDebounceCounterBased: DemJumpUp=true, DemJumpDown=false, DemCountOutStepSize=0, DemCountInStepSize=0, DemPreDebounceName=DEM_PRE_DEBOUNCE_COUNTER_BASED
        CTC_0x55668F: DemEventID=26, DemDTCClassRef=DtcClass73, DemFreezeFrameClassRef=Snapshot_21
          DemEventClass:
            DemEventPriority = 0
            DemFFPrestorageSupported = false
            DemHealingAllowed = true
            DemEventDestination = DEM_DTC_ORIGIN_PRIMARY_MEMORY
            DemHealingCycleCounter = 40
            DemHealingCycleRef = DEM_IGNITION
            DemOperationCycleRef = DEM_IGNITION
            DemPredebounceAlgorithmClass
              DemPreDebounceCounterBased: DemJumpUp=true, DemJumpDown=false, DemCountOutStepSize=0, DemCountInStepSize=0, DemPreDebounceName=DEM_PRE_DEBOUNCE_COUNTER_BASED
        CTC_0x540D00: DemEventID=27, DemDTCClassRef=DtcClass74, DemFreezeFrameClassRef=Snapshot_20
          DemEventClass:
            DemEventPriority = 0
            DemFFPrestorageSupported = false
            DemHealingAllowed = true
            DemEventDestination = DEM_DTC_ORIGIN_PRIMARY_MEMORY
            DemHealingCycleCounter = 40
            DemHealingCycleRef = DEM_IGNITION
            DemOperationCycleRef = DEM_IGNITION
            DemPredebounceAlgorithmClass
              DemPreDebounceCounterBased: DemJumpUp=true, DemJumpDown=false, DemCountOutStepSize=0, DemCountInStepSize=0, DemPreDebounceName=DEM_PRE_DEBOUNCE_COUNTER_BASED
        CTC_0x564404: DemEventID=24, DemDTCClassRef=DtcClass75, DemFreezeFrameClassRef=Snapshot_23
          DemEventClass:
            DemEventPriority = 0
            DemFFPrestorageSupported = false
            DemHealingAllowed = true
            DemEventDestination = DEM_DTC_ORIGIN_PRIMARY_MEMORY
            DemHealingCycleCounter = 40
            DemHealingCycleRef = DEM_IGNITION
            DemOperationCycleRef = DEM_IGNITION
            DemPredebounceAlgorithmClass
              DemPreDebounceCounterBased: DemJumpUp=true, DemJumpDown=false, DemCountOutStepSize=0, DemCountInStepSize=0, DemPreDebounceName=DEM_PRE_DEBOUNCE_COUNTER_BASED
    DemGeneral:
      DemBswErrorBufferSize = 52
      DemDevErrorDetect = true
      DemDtcStatusAvailabilityMask = 255
      DemFFDataIDLength = 2
      DemMaxNumberEventEntryMir = 20
      DemMaxNumberEventEntryPrm = 35
      DemMaxNumberEventEntrySec = 0
      DemNvmAccessRetry = 0
      DemNvmAccessRetryTimeDelay = 0
      DemVersionInfoApi = true
      DemAddErrorBufferSize = 1
      DemSnapshotsPerDTC = 1
      DemUseRte = true
      DemPostbuildStartAddress = 0
      DemUseDcmCompatiblePorts = false
      DemUserConfigFile = (unset)
      DemVariantModeSelection = SIMPLE_ECU
      DemPreInitHasConfigParam = false
      DemSoftwareComponentName = Dem
      DemSupportGetEventIdApi = false
      DemMaxNumberPrestoredFF = 0
      DemTaskTime = 10
      DemTypeOfDTCSupported = 1
      DemTimeBasedDebouncingDataType = TIME_BASED_DEBOUNCING_16_BIT
      Snapshot (DemFreezeFrameClass):
        DemFreezeFrameKind = (unset)
        DemFreezeFrameRecordNum = 1
        DemFreezeFrameIdClassRef = DID_0xd401
        DemFreezeFrameIdClassRef = DID_0xd{403..405}
        DemFreezeFrameIdClassRef = DID_0xd{407..409}
        DemFreezeFrameIdClassRef = DID_0xd40b
        DemFreezeFrameIdClassRef = DID_0xd40c
        DemFreezeFrameIdClassRef = DID_0xd40d
        DemFreezeFrameIdClassRef = DID_0xd40f
        DemFreezeFrameIdClassRef = DID_0xd410
        DemFreezeFrameIdClassRef = DID_0xd412
        DemFreezeFrameIdClassRef = DID_0xd414
        DemFreezeFrameIdClassRef = DID_0xd415
        DemFreezeFrameIdClassRef = DID_0xd418
        DemFreezeFrameIdClassRef = DID_0xd41b
      4 x DemOperationCycleTgt:
        DEM_IGNITION: DemOperationCycle=DEM_IGNITION
        DEM_OBD_DCY: DemOperationCycle=DEM_OBD_DCY
        DEM_POWER: DemOperationCycle=DEM_POWER
        DEM_WARMUP: DemOperationCycle=DEM_WARMUP
      46 x DemFreezeFrameClass, all with DemFreezeFrameKind=(unset), DemFreezeFrameRecordNum=1, DemFreezeFrameIdClassRef=DID_0xd401, DemFreezeFrameIdClassRef=DID_0xd403, DemFreezeFrameIdClassRef=DID_0xd404, DemFreezeFrameIdClassRef=DID_0xd405, DemFreezeFrameIdClassRef=DID_0xd407, DemFreezeFrameIdClassRef=DID_0xd408, DemFreezeFrameIdClassRef=DID_0xd409, DemFreezeFrameIdClassRef=DID_0xd40b, DemFreezeFrameIdClassRef=DID_0xd40c, DemFreezeFrameIdClassRef=DID_0xd40d, DemFreezeFrameIdClassRef=DID_0xd40f, DemFreezeFrameIdClassRef=DID_0xd410, DemFreezeFrameIdClassRef=DID_0xd412, DemFreezeFrameIdClassRef=DID_0xd414, DemFreezeFrameIdClassRef=DID_0xd415, DemFreezeFrameIdClassRef=DID_0xd418, DemFreezeFrameIdClassRef=DID_0xd41b:
        Snapshot_{1..46}
      12 x DemFreezeFrameIdClass, all with DemCreatePortInterface=true:
        DID_0xd401: DemDataID=54273, DemFreezeFrameIdDataSize=3
          DemGetDataValByDataIdTgt: DemGetDataValByDataIdTgtRef=CBValByDID_0xd401
        DID_0xd403: DemDataID=54275, DemFreezeFrameIdDataSize=2
          DemGetDataValByDataIdTgt: DemGetDataValByDataIdTgtRef=CBValByDID_0xd403
        DID_0xd404: DemDataID=54276, DemFreezeFrameIdDataSize=1
          DemGetDataValByDataIdTgt: DemGetDataValByDataIdTgtRef=CBValByDID_0xd404
        DID_0xd405: DemDataID=54277, DemFreezeFrameIdDataSize=1
          DemGetDataValByDataIdTgt: DemGetDataValByDataIdTgtRef=CBValByDID_0xd405
        DID_0xd407: DemDataID=54279, DemFreezeFrameIdDataSize=1
          DemGetDataValByDataIdTgt: DemGetDataValByDataIdTgtRef=CBValByDID_0xd407
        DID_0xd408: DemDataID=54280, DemFreezeFrameIdDataSize=1
          DemGetDataValByDataIdTgt: DemGetDataValByDataIdTgtRef=CBValByDID_0xd408
        DID_0xd409: DemDataID=54281, DemFreezeFrameIdDataSize=1
          DemGetDataValByDataIdTgt: DemGetDataValByDataIdTgtRef=CBValByDID_0xd409
        DID_0xd40b: DemDataID=54283, DemFreezeFrameIdDataSize=3
          DemGetDataValByDataIdTgt: DemGetDataValByDataIdTgtRef=CBValByDID_0xd40b
        DID_0xd40d: DemDataID=54285, DemFreezeFrameIdDataSize=2
          DemGetDataValByDataIdTgt: DemGetDataValByDataIdTgtRef=CBValByDID_0xd40d
        DID_0xd40f: DemDataID=54287, DemFreezeFrameIdDataSize=1
          DemGetDataValByDataIdTgt: DemGetDataValByDataIdTgtRef=CBValByDID_0xd40f
        DID_0xd410: DemDataID=54288, DemFreezeFrameIdDataSize=1
          DemGetDataValByDataIdTgt: DemGetDataValByDataIdTgtRef=CBValByDID_0xd410
        DID_0xd414: DemDataID=54292, DemFreezeFrameIdDataSize=1
          DemGetDataValByDataIdTgt: DemGetDataValByDataIdTgtRef=CBValByDID_0xd414
      12 x DemGetDataValByDataId:
        CBValByDID_0xd401: DemGetDataValByDataIdListFnc=CBValByDID_0xd401
        CBValByDID_0xd{403..405}: DemGetDataValByDataIdListFnc=CBValByDID_0xd{403..405}
        CBValByDID_0xd{407..409}: DemGetDataValByDataIdListFnc=CBValByDID_0xd{407..409}
        CBValByDID_0xd40b: DemGetDataValByDataIdListFnc=CBValByDID_0xd40b
        CBValByDID_0xd40d: DemGetDataValByDataIdListFnc=CBValByDID_0xd40d
        CBValByDID_0xd40f: DemGetDataValByDataIdListFnc=CBValByDID_0xd40f
        CBValByDID_0xd410: DemGetDataValByDataIdListFnc=CBValByDID_0xd410
        CBValByDID_0xd414: DemGetDataValByDataIdListFnc=CBValByDID_0xd414
      ETATDA2 (DemIndicator): DemIndicatorID=0
      NVM_BLOCK_DEM_CTCSTRG (DemNvramBlockId): DemNvramBlockIdUsageType=DEM_NVRAM_BLOCK_CORE, DemNvramBlockIdRef=NvM/NVM_BLOCK_DEM_CTCSTRG
      CBDTCStatusChange_FaultLog (DemTriggerOnDTCStatusTgt): DemTrigOnDTCStatusFnc=CBDTCStatusChange_FaultLog
      CBDTCStatusChange_DemIf (DemTriggerOnDTCStatusTgt): DemTrigOnDTCStatusFnc=CBDTCStatusChange_DemIf
      5 x DemFreezeFrameIdClass, all with DemCreatePortInterface=true:
        DID_0xd40c: DemFreezeFrameIdDataSize=1, DemDataID=54284
          DemGetDataValByDataIdTgt: DemGetDataValByDataIdTgtRef=CBValByDID_0xd40c
        DID_0xd412: DemFreezeFrameIdDataSize=1, DemDataID=54290
          DemGetDataValByDataIdTgt: DemGetDataValByDataIdTgtRef=CBValByDID_0xd412
        DID_0xd415: DemFreezeFrameIdDataSize=1, DemDataID=54293
          DemGetDataValByDataIdTgt: DemGetDataValByDataIdTgtRef=CBValByDID_0xd415
        DID_0xd418: DemFreezeFrameIdDataSize=2, DemDataID=54296
          DemGetDataValByDataIdTgt: DemGetDataValByDataIdTgtRef=CBValByDID_0xd418
        DID_0xd41b: DemFreezeFrameIdDataSize=1, DemDataID=54299
          DemGetDataValByDataIdTgt: DemGetDataValByDataIdTgtRef=CBValByDID_0xd41b
      5 x DemGetDataValByDataId:
        CBValByDID_0xd40c: DemGetDataValByDataIdListFnc=CBValByDID_0xd40c
        CBValByDID_0xd412: DemGetDataValByDataIdListFnc=CBValByDID_0xd412
        CBValByDID_0xd415: DemGetDataValByDataIdListFnc=CBValByDID_0xd415
        CBValByDID_0xd418: DemGetDataValByDataIdListFnc=CBValByDID_0xd418
        CBValByDID_0xd41b: DemGetDataValByDataIdListFnc=CBValByDID_0xd41b
    VectorCommonData: BswmdVersion=2.14.00
  module config Mcu: implementation-config-variant=VARIANT-POST-BUILD, module-description=Mcu_Impl  # Configuration of the Mcu (Microcontroler Unit) module.
    McuGeneralConfiguration:
      McuBank0Pwr = ActiveMode
      McuBank1Pwr = ActiveMode
      McuBank{2..6}Pwr = SleepMode
      McuBank7Pwr = ActiveMode
      McuDevErrorDetect = false
      McuPerformResetApi = true
      McuVersionInfoApi = true
      McuDoParamCheck = true
      McuCheckParamConfig = true
      McuCheckParamMode = true
      McuCheckParamClock = true
      McuCheckParamRamSection = true
      McuCheckVersionInfo = true
      McuCheckUninit = true
      McuCheckPllStatus = true
      McuDevErrorReport = true
      McuErrorHook = Det_ReportError
      McuIncludeDet = Det.h
      McuProdErrorReport = true
      McuUseInitRamApi = false
      McuCopyTrimFromOtp = true
      McuSraEnabled = true
      McuSraOnlyForWrite = true
      McuSraOnlyForPrivModeRegs = true
      McuSraNotInInit = false
      McuErrataFmzPll17Workaround = false
      McuIrqHandling = SuspendAllInterrupts
      McuMemInit:
        McuInitMibSpiP1Ram = true
        McuInitMibSpiP3Ram = true
        McuInitMibSpiP5Ram = true
        McuInitDcan{1..3}Ram = true
        McuInitMibAdc1Ram = true
        McuInitMibAdc2Ram = true
        McuInitNhet1Ram = true
        McuInitNhet2Ram = true
        McuInitHetTu1Ram = true
        McuInitHetTu2Ram = true
        McuInitDmaRam = true
        McuInitVimRam = false
        McuInitFlexRayTuRam = true
      McuPeripheralSelect:
        McuUseMibSpiP1 = true
        McuUseSpiP2 = true
        McuUseMibSpiP3 = true
        McuUseSpiP4 = true
        McuUseMibSpiP5 = true
        McuUseLin = true
        McuUseSci = true
        McuUseDcan{1..3} = true
        McuUseI2c = true
        McuUseFlexRay = true
        McuUseFlexRayTu = true
        McuUseMibAdc1 = true
        McuUseMibAdc2 = true
        McuUseGio = true
        McuUseNhet1 = true
        McuUseNhet2 = true
        McuUseHetTu1 = true
        McuUseHetTu2 = true
        McuUseDmm = false
    McuModuleConfiguration: McuClockSrcFailureNotification=DISABLED
      McuClockSettingConfig
        McuClockReferencePoint: McuClockReferencePointFrequency=20
        McuLpo:
          McuLpoEnableBias = true
          McuLpoTrimLow = Trim100Comma00Percent
          McuLpoTrimHigh = Trim100Comma00Percent
          McuLpoLowref = 80
          McuLpoHighref = 100
          McuLpoLowfreq = 0.08
          McuLpoHighfreq = 10
        PLL (McuPllConfig):
          McuPllRefClkDiv = 6
          McuPllOdDiv = 2
          McuPllRDiv = 1
          McuPllMul = 96
          McuPllIntClk = 2.5
          McuPllOutputClk = 320
          McuPllFreq = 160
          McuPllFmBwadj = 8
          McuPllFmMode = FM_Disabled
          McuPllFmNs = 1
          McuPllFmFs = 1.667
          McuPllFmNv = 1
          McuPllFmDepth = 0
          McuPllResetOnPllSlip = true
          McuPllBypassOnPllSlip = true
          McuPllResetOnOsciFail = true
        PLL2 (McuPll2Config): McuPll2RefClkDiv=5, McuPll2OdDiv=5, McuPll2RDiv=1, McuPll2Mul=100, McuPll2IntClk=4, McuPll2OutputClk=400, McuPll2Freq=80
        ExtClkIn (McuExtClocks): McuExtClk1Freq=80, McuExtClk2Freq=80
        McuClocks
          McuClockSrc:
            McuUseOsciClk = true
            McuUsePllClk = true
            McuUse32KhzOsciClk = false
            McuUseExtClk1 = false
            McuUseLpoLow = true
            McuUseLpoHigh = true
            McuUsePll2Clk = false
            McuUseExtClk2 = false
            McuUseGclk = true
            McuUseHclk = true
            McuUseVclkp = true
            McuUseVclk2 = true
            McuUseVclka1 = true
            McuUseVclka2 = true
            McuUseRtiClk1 = true
            McuUseVclk3 = true
            McuUseVclka4 = true
            McuUseVclka4Pre = false
            McuVclka1 = Vclk
            McuVclka2 = Vclk
            McuVclka4 = Vclk
            McuVclka4r = DivderbyOne
            McuRti1Div = DivderbyOne
            McuAVclk1Freq = 80
            McuAVclk2Freq = 80
            McuAVclk4sFreq = 80
            McuAVclk4divrFreq = 80
            McuRTI1Freq = 80
            McuRti1Src = Vclk
          ClockDomains (McuClockDomains):
            McuEclkSelector = VCLK
            McuEclkPrescaler = 0
            McuEclkSuspendMode = true
            McuGclkFreq = 160
            McuHclkFreq = 160
            McuVclkFreq = 80
            McuVclk2Freq = 80
            McuVclk3Freq = 80
            McuFrdCntlAswsten = 1
            McuFrdCntlRwait = 3
            McuGhvwake = PLL
            McuHvlpm = PLL
            McuGhvsrc = PLL
            McuTreeVclkDiv = 2
            McuTreeVclk2Div = 2
            McuTreeVclk3Div = 2
      McuModeConf (McuModeSettingConf): McuPowerMode=DozeMode, McuMode=0
      McuRamConf (McuRamSectorSettingConf): McuRamDefaultValue=0, McuRamBaseAddress=134217728, McuRamSectionSize=81920, McuCopyRomToRam=false, McuRomBaseAddress=0
  module config EtDmpFw: implementation-config-variant=VARIANT-POST-BUILD  # Configuration of the Nexteer EtDmpFw module.
    EtDmpFwGeneral
    CommonPublishedInformation: ArMajorVersion=3, ArMinorVersion=2, ArPatchVersion=0, SwMajorVersion=0, SwMinorVersion=0, SwPatchVersion=0, ModuleId=0, VendorId=0
  module config BkCpPc: implementation-config-variant=VARIANT-POST-BUILD  # Configuration of the Nexteer BkCpPc module.
    BkCpPcGeneral: BkCpPcPwrDiscConfiguration=1
    CommonPublishedInformation: ArMajorVersion=3, ArMinorVersion=2, ArPatchVersion=0, SwMajorVersion=0, SwMinorVersion=0, SwPatchVersion=0, ModuleId=0, VendorId=0
  module config NvMMgr: implementation-config-variant=VARIANT-POST-BUILD  # Configuration of the Nexteer NvM Manager module.
    NvMMgrGeneral: EcuStartupApp=Ap_6, NvMandMemIfApp=Ap_6
    CommonPublishedInformation: ArMajorVersion=3, ArMinorVersion=2, ArPatchVersion=0, SwMajorVersion=0, SwMinorVersion=0, SwPatchVersion=0, ModuleId=0, VendorId=0
  module config DigMSB: implementation-config-variant=VARIANT-POST-BUILD  # Configuration of the Nexteer DigMSB module.
    DigMSBGeneral
    CommonPublishedInformation: ArMajorVersion=3, ArMinorVersion=2, ArPatchVersion=0, SwMajorVersion=0, SwMinorVersion=0, SwPatchVersion=0, ModuleId=0, VendorId=0
  module config DigMSBSigCorr: implementation-config-variant=VARIANT-POST-BUILD  # Configuration of the Nexteer DigMSBSigCorr module.
    DigMSBSigCorrGeneral
    CommonPublishedInformation: ArMajorVersion=3, ArMinorVersion=2, ArPatchVersion=0, SwMajorVersion=0, SwMinorVersion=0, SwPatchVersion=0, ModuleId=0, VendorId=0
  module config DigHwTrqSENT: implementation-config-variant=VARIANT-POST-BUILD  # Configuration of the Nexteer DigHwTrqSENT module.
    DigHwTrqSENTGeneral
    CommonPublishedInformation: ArMajorVersion=3, ArMinorVersion=2, ArPatchVersion=0, SwMajorVersion=0, SwMinorVersion=0, SwPatchVersion=0, ModuleId=0, VendorId=0
  module config AbsHwPos: implementation-config-variant=VARIANT-POST-BUILD  # Configuration of the Nexteer AbsHwPos module.
    AbsHwPosGeneral
    CommonPublishedInformation: ArMajorVersion=3, ArMinorVersion=2, ArPatchVersion=0, SwMajorVersion=0, SwMinorVersion=0, SwPatchVersion=0, ModuleId=0, VendorId=0
  module config Sweep: implementation-config-variant=VARIANT-POST-BUILD  # Configuration of the Nexteer Sweep module.
    SweepGeneral
    CommonPublishedInformation: ArMajorVersion=3, ArMinorVersion=2, ArPatchVersion=0, SwMajorVersion=0, SwMinorVersion=0, SwPatchVersion=0, ModuleId=0, VendorId=0
  module config Sweep2: implementation-config-variant=VARIANT-POST-BUILD  # Configuration of the Nexteer Sweep2 module.
    Sweep2General
    CommonPublishedInformation: ArMajorVersion=3, ArMinorVersion=2, ArPatchVersion=0, SwMajorVersion=0, SwMinorVersion=0, SwPatchVersion=0, ModuleId=0, VendorId=0
  module config SpiNxt: implementation-config-variant=VARIANT-PRE-COMPILE  # Configuration of the Nexteer SPI handler driver module
    SpiNxtGeneral: SpiNxtUseWith=D_SPINXT_USEWITHDIGMSB, SpiNxtUseDMA=STD_ON
  module config ComplErr: implementation-config-variant=VARIANT-POST-BUILD  # Configuration of the Nexteer ComplErr module.
    ComplErrGeneral
    CommonPublishedInformation: ArMajorVersion=3, ArMinorVersion=2, ArPatchVersion=0, SwMajorVersion=0, SwMinorVersion=0, SwPatchVersion=0, ModuleId=0, VendorId=0
  module config VehDyn: implementation-config-variant=VARIANT-POST-BUILD  # Configuration of the Nexteer VehDyn module.
    VehDynGeneral
    CommonPublishedInformation: ArMajorVersion=3, ArMinorVersion=2, ArPatchVersion=0, SwMajorVersion=0, SwMinorVersion=0, SwPatchVersion=0, ModuleId=0, VendorId=0
  module config ApXcp: implementation-config-variant=VARIANT-POST-BUILD  # Configuration of the Nexteer Xcp module.
    XcpGeneral: ExternalEEPROMAccess=STD_OFF, XcpIncludes=NtWrap.h, XcpRteEvents=XcpEventChannel_2ms_DAQ_2
    XcpMemoryAccess
      Flash (InternalMemoryRng): IntMemRngLow=0, IntMemRngHigh=786431
      RAM (InternalMemoryRng): IntMemRngLow=134217728, IntMemRngHigh=134348799
    RamCopy
    TuneOnTheFly: TuneOnTheFlySupport=STD_ON, RamBlockSize=9216, TuneOnTheFlyIncludes=CalConstants.h
      Seg0_Pers: Seg0Enable=STD_OFF, MaxPerCopy=1, CalConstNumOfPerSymbol=D_NUMOFPERS_CNT_U16, TuneOnTheFlyPersLkup=STD_OFF
      Seg1_Sets: Seg1Enable=STD_ON, MaxSetCopy=1, CalConstNumOfSetSymbol=D_NUMOFTUNSETS_CNT_U16, TuneOnTheFlySetLkup=STD_OFF
      Seg2_Common: Seg2Enable=STD_OFF
      Seg3_SetAndPer: Seg3Enable=STD_OFF
      Seg4_SetAndPerAndCommon: Seg4Enable=STD_OFF
    CommonPublishedInformation: ArMajorVersion=3, ArMinorVersion=2, ArPatchVersion=0, SwMajorVersion=0, SwMinorVersion=0, SwPatchVersion=0, ModuleId=0, VendorId=0
  module config NvMProxy: implementation-config-variant=VARIANT-PRE-COMPILE  # Configuration of the NvM Proxy module
    NvMProxyConfigSet
      21 x NvMProxyBlock:
        ShCurrCal: NvmRamBlockDataAddressSecure=Rte_CmMtrCurr_ShCurrCal, InitBlockHandling=CRC16, InitCheckFailResponse=SetNTC_0x07_LoadROMDefaults, ROMDefault_Or_NotificationFunction_Symbol=T_ShCurrCalInit_Cnt_str, NvMRamGlobalShared=false, NvmBlockDescriptorRef=Rte_NvmBlock_CmMtrCurr_ShCurrCal
        TorqueCmdSF: NvmRamBlockDataAddressSecure=Rte_TrqCmdScl_TorqueCmdSF_Uls_f32, InitBlockHandling=Redundant, InitCheckFailResponse=SetNTC_0x07_LoadROMDefaults, ROMDefault_Or_NotificationFunction_Symbol=T_TorqueCmdSFInit_Uls_f32, NvMRamGlobalShared=false, NvmBlockDescriptorRef=Rte_NvmBlock_TrqCmdScl_TorqueCmdSF_Uls_f32
        Polarity: NvmRamBlockDataAddressSecure=Rte_Polarity_Polarity_Cnt_Str, InitBlockHandling=None, InitCheckFailResponse=N/A, ROMDefault_Or_NotificationFunction_Symbol=NULL_PTR, NvMRamGlobalShared=false, NvmBlockDescriptorRef=Rte_NvmBlock_Polarity_Polarity_Cnt_Str
        CloseCheckData: NvmRamBlockDataAddressSecure=CloseCheck_Cnt_u32, InitBlockHandling=None, InitCheckFailResponse=N/A, ROMDefault_Or_NotificationFunction_Symbol=NULL_PTR, NvMRamGlobalShared=false, NvmBlockDescriptorRef=Rte_NvmBlock_StaMd_CloseCheckData
        TypeHRamBuffer: NvmRamBlockDataAddressSecure=TypeHData_Cnt_u08, InitBlockHandling=None, InitCheckFailResponse=N/A, ROMDefault_Or_NotificationFunction_Symbol=NULL_PTR, NvMRamGlobalShared=true, NvmBlockDescriptorRef=Rte_NvmBlock_StaMd_TypeHRamBuffer
        CogTrqCal: NvmRamBlockDataAddressSecure=Rte_TrqCanc_CogTrqCal, InitBlockHandling=CRC16, InitCheckFailResponse=SetNTC_0x07_LoadROMDefaults, ROMDefault_Or_NotificationFunction_Symbol=T_CogTrqCalInit_Cnt_u16, NvMRamGlobalShared=false, NvmBlockDescriptorRef=Rte_NvmBlock_TrqCanc_CogTrqCal
        EOLNomMtrParam: NvmRamBlockDataAddressSecure=Rte_CurrParamComp_EOLNomMtrParam, InitBlockHandling=None, InitCheckFailResponse=N/A, ROMDefault_Or_NotificationFunction_Symbol=NULL_PTR, NvMRamGlobalShared=false, NvmBlockDescriptorRef=Rte_NvmBlock_CurrParamComp_EOLNomMtrParam
        DigTrqTrim: NvmRamBlockDataAddressSecure=Rte_DigHwTrqSENT_DigTrqTrim, InitBlockHandling=CRC16, InitCheckFailResponse=SetNTC_0x0A, ROMDefault_Or_NotificationFunction_Symbol=NULL_PTR, NvMRamGlobalShared=false, NvmBlockDescriptorRef=Rte_NvmBlock_DigHwTrqSENT_DigTrqTrim
        DigMSBEOLData: NvmRamBlockDataAddressSecure=Rte_DigMSB_DigMSBEOLData, InitBlockHandling=None, InitCheckFailResponse=N/A, ROMDefault_Or_NotificationFunction_Symbol=NULL_PTR, NvMRamGlobalShared=false, NvmBlockDescriptorRef=Rte_NvmBlock_DigMSB_DigMSBEOLData
        EOLVehCntrOffset: NvmRamBlockDataAddressSecure=Rte_AbsHwPos_EOLVehCntrOffset, InitBlockHandling=ZeroData, InitCheckFailResponse=N/A, ROMDefault_Or_NotificationFunction_Symbol=NULL_PTR, NvMRamGlobalShared=false, NvmBlockDescriptorRef=Rte_NvmBlock_AbsHwPos_EOLVehCntrOffset
        CogTrqRplComp: NvmRamBlockDataAddressSecure=Rte_TrqCanc_CogTrqRplComp, InitBlockHandling=CRC16, InitCheckFailResponse=SetNTC_0x07_LoadROMDefaults, ROMDefault_Or_NotificationFunction_Symbol=T_CogTrqRplCompInit_Cnt_u16, NvMRamGlobalShared=false, NvmBlockDescriptorRef=Rte_NvmBlock_TrqCanc_CogTrqRplComp
        CurrTempOffset: NvmRamBlockDataAddressSecure=Rte_CmMtrCurr_CurrTempOffset, InitBlockHandling=ZeroData, InitCheckFailResponse=N/A, ROMDefault_Or_NotificationFunction_Symbol=NULL_PTR, NvMRamGlobalShared=false, NvmBlockDescriptorRef=Rte_NvmBlock_CmMtrCurr_CurrTempOffset
        SteerAsstDefeat: NvmRamBlockDataAddressSecure=Rte_AstLmt_SteerAsstDefeat, InitBlockHandling=ZeroData, InitCheckFailResponse=N/A, ROMDefault_Or_NotificationFunction_Symbol=NULL_PTR, NvMRamGlobalShared=false, NvmBlockDescriptorRef=Rte_NvmBlock_AstLmt_SteerAsstDefeat
        LearnedEOT: NvmRamBlockDataAddressSecure=Rte_LrnEOT_LearnedEOT, InitBlockHandling=CRC16, InitCheckFailResponse=SetNTC_0x06_LoadROMDefaults, ROMDefault_Or_NotificationFunction_Symbol=T_LearnedEOTInit_Cnt_str, NvMRamGlobalShared=false, NvmBlockDescriptorRef=Rte_NvmBlock_LrnEOT_LearnedEOT
        AvgFricLrnData: NvmRamBlockDataAddressSecure=Rte_AvgFricLrn_AvgFricLrnData, InitBlockHandling=CRC16, InitCheckFailResponse=SetNTC_0x06_LoadROMDefaults, ROMDefault_Or_NotificationFunction_Symbol=T_AvgFricLrnDataInit_Cnt_str, NvMRamGlobalShared=false, NvmBlockDescriptorRef=Rte_NvmBlock_AvgFricLrn_AvgFricLrnData
        OvervoltageData: NvmRamBlockDataAddressSecure=Rte_BatteryVoltage_OvervoltageData, InitBlockHandling=None, InitCheckFailResponse=N/A, ROMDefault_Or_NotificationFunction_Symbol=NULL_PTR, NvMRamGlobalShared=false, NvmBlockDescriptorRef=Rte_NvmBlock_BatteryVoltage_OvervoltageData
        FltStVal: NvmRamBlockDataAddressSecure=Rte_ThrmlDutyCycle_ThrmlDutyCycle_FltStVal, InitBlockHandling=None, InitCheckFailResponse=N/A, ROMDefault_Or_NotificationFunction_Symbol=NULL_PTR, NvMRamGlobalShared=false, NvmBlockDescriptorRef=Rte_NvmBlock_ThrmlDutyCycle_ThrmlDutyCycle_FltStVal
        MotPosReset: NvmRamBlockDataAddressSecure=Rte_VehDyn_MotPosReset, InitBlockHandling=None, InitCheckFailResponse=N/A, ROMDefault_Or_NotificationFunction_Symbol=NULL_PTR, NvMRamGlobalShared=false, NvmBlockDescriptorRef=Rte_NvmBlock_VehDyn_MotPosReset
        VVHTYPEData: NvmRamBlockDataAddressSecure=Rte_SrlComInput_VVHTYPEData, InitBlockHandling=None, InitCheckFailResponse=N/A, ROMDefault_Or_NotificationFunction_Symbol=NULL_PTR, NvMRamGlobalShared=false, NvmBlockDescriptorRef=Rte_NvmBlock_SrlComInput_VVHTYPEData
        ElecIntData: NvmRamBlockDataAddressSecure=Rte_SrlComInput_ElecIntData, InitBlockHandling=None, InitCheckFailResponse=N/A, ROMDefault_Or_NotificationFunction_Symbol=NULL_PTR, NvMRamGlobalShared=false, NvmBlockDescriptorRef=Rte_NvmBlock_SrlComInput_ElecIntData
        ShutdownTimeData: NvmRamBlockDataAddressSecure=Rte_SrlComInput_ShutdownTimeData, InitBlockHandling=None, InitCheckFailResponse=N/A, ROMDefault_Or_NotificationFunction_Symbol=NULL_PTR, NvMRamGlobalShared=false, NvmBlockDescriptorRef=Rte_NvmBlock_SrlComInput_ShutdownTimeData
    NvMProxyGeneral: NvMProxyIncludes=Ap_StaMd_Cfg.h, FailureAPI=NxtrDiagMgr10_ReportNTCStatus, NvMProxyDevErrorDetect=false
    CommonPublishedInformation: ArMajorVersion=1, ArMinorVersion=2, ArPatchVersion=0, SwMajorVersion=1, SwMinorVersion=0, SwPatchVersion=0, ModuleId=104, VendorId=0
  module config GenyBaseEnv: module-description=GenyBaseEnv_Impl
    GenyBaseEnvGeneral: GenyBaseEnvUserConfigFile=..\..\..\Tools\AsrProject\Config\User\Dem_User.cfg, ProjectType=2, NumberOfSubProjects=1
  module config PosServo: implementation-config-variant=VARIANT-POST-BUILD  # Configuration of the Nexteer PosServo module.
    PosServoGeneral
    CommonPublishedInformation: ArMajorVersion=3, ArMinorVersion=2, ArPatchVersion=0, SwMajorVersion=0, SwMinorVersion=0, SwPatchVersion=0, ModuleId=0, VendorId=0
  module config EcuC_Cfg: definition=EcuC
    PduCollection
